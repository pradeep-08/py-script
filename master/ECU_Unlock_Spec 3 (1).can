/*@!Encoding:65001*/
includes
{  

  #include "..\..\Lib_new\SysTS_10033630_GWM_IFV410_Customer_DID_APP.CIN"
  #include "..\..\Lib_new\SysTS_10035024_GWM_IFV410_Common_Library.cin"
  #include "..\..\Lib_new\GM_Common_Lib.cin"
  #include "..\..\Lib_new\Tenma_NW_NOD_IGN.can"
  #include "..\..\Lib_new\TR_Lib_KHO.cin"
  #include "..\..\Lib_new\TR_Description_BZA.cin"
}




variables
{
  int in,h,sum,seeds=0;
  byte X;
  byte Y;
  float mas;
  
}


testcase TC1_PGS_200624()
  {
    char logPath[256] = "C:\\Users\\GID_GMSDV_ITV\\Documents\\ECU_Unlock_logs\\PGS_200624.asc"; // Change this to your desired path
    setLogFileName("Test Logs",logPath);
    startLogging("Test Logs");
    
    /*-------------------------------Test Step 1--------------------------------------*/ 
    /*-----------------------------ACTION: set Battery voltage to 12v -----------------------------------*/
   
    Set_Bat_Vol(12);
    
    /*-------------------------------Test Step 2--------------------------------------*/ 
    /*-----------------------------ACTION: Read MEC -----------------------------------------*/   
    
    Read_MEC();
    
    /*-------------------------------Test Step 3--------------------------------------*/ 
    /*-----------------------------ACTION: Set powermode to OFF -----------------------------------------*/
    @IgnitionSwitch=0;
    Read_PowerMode();
    
    /*-------------------------------Test Step 4--------------------------------------*/ 
    /*-----------------------------ACTION: Enter Default Session ----------------------------------------*/
    Default_Session_Phy();
    
    /*-------------------------------Test Step 5--------------------------------------*/ 
    /*-----------------------------ACTION: Enter Extended Session ---------------------------------------*/
    Extended_Session_Phy();

    /*-------------------------------Test Step 6--------------------------------------*/ 
    /*-----------------------------ACTION: Disable Communication-----------------------------------------*/
    Dis_Comm_phy();
    
    /*-------------------------------Test Step 7--------------------------------------*/ 
    /*-----------------------------ACTION: Disable DTC---------------------------------------------------*/
    Dis_DTC_Phy();
    
    /*-------------------------------Test Step 8--------------------------------------*/ 
    /*-----------------------------ACTION: Activating Tester Present for every 2sec----------------------*/
   
    Tester_Present_Per_Start_Fun(2000);
    
    /*-------------------------------Test Step 9--------------------------------------*/ 
    /*-----------------------------ACTION: Security unlock Level 1----------------------------------------*/
    ACTION("Checking whether a valid Seed [non-zero, non-FF] for Security Level 01 is recieved or not");
    Security_Unlock_With_Key_lvl_1_Phy();
    
    testWaitForTimeout(2000);
    /*-------------------------------Test Step 10--------------------------------------*/ 
    /*-----------------------------ACTION: Enter Programming_Session-------------------------------------*/
     Programming_Session_Phy();
    
    /*-------------------------------Test Step 11--------------------------------------*/ 
    /*-----------------------------ACTION: Enter Programming_Session-------------------------------------*/
    
    STEP();
    ACTION("Enter Programming_Session"); 
    send_on_CAN(0x02,0x10,0x02,0x55,0x55,0x55,0x55,0x55);
    testWaitForTimeout(100);
    Expect(0x03,0x7F,0x10,0x33,0x55,0x55,0x55,0x55);
    EXPECTED_DATA("",E_Resp,0X08);
    OBSERVED_DATA("",O_Resp,0X08);
    Check(E_Resp,O_Resp);  
    Clear_Buffer();   

    testWaitForTimeout(1000);
    
    /*-------------------------------Test Step 12--------------------------------------*/ 
    /*-----------------------------ACTION: Setting ECU to Normal mode -----------------------------------*/
    
    Back_To_Normal();

    stopLogging("Test Logs");
  }
  
testcase TC2_PGS_200623()
  {
    char logPath[256] = "C:\\Users\\GID_GMSDV_ITV\\Documents\\ECU_Unlock_logs\\PGS_200623.asc"; // Change this to your desired path
    setLogFileName("Test Logs",logPath);
    startLogging("Test Logs");
    
    /*-------------------------------Test Step 1--------------------------------------*/ 
    /*-----------------------------ACTION: set Battery voltage to 12v -----------------------------------*/
    
    Set_Bat_Vol(12);
    
    /*-------------------------------Test Step 2--------------------------------------*/ 
    /*-----------------------------ACTION: Read MEC -----------------------------------------*/   
    
    Read_MEC();
    
    /*-------------------------------Test Step 3--------------------------------------*/ 
    /*-----------------------------ACTION: Set powermode to OFF -----------------------------------------*/
    
    @IgnitionSwitch=0;
    Read_PowerMode();
    
    /*-------------------------------Test Step 4--------------------------------------*/ 
    /*-----------------------------ACTION: Enter Extended Session ---------------------------------------*/
   
    Extended_Session_Phy();
    
    /*-------------------------------Test Step 5--------------------------------------*/ 
    /*-----------------------------ACTION: Activating Tester Present for every 2sec----------------------*/
   
    Tester_Present_Per_Start_Fun(2000);
    
    /*-------------------------------Test Step 6--------------------------------------*/ 
    /*-----------------------------ACTION: Security unlock Level 9----------------------------------------*/
    ACTION("Checking whether a valid Seed [non-zero, non-FF] for Security Level 09 is recieved or not");
    Security_Unlock_With_Key_lvl_9_Phy();
    
    testWaitForTimeout(1000);
    /*-------------------------------Test Step 7--------------------------------------*/ 
    /*-----------------------------ACTION: Writing DID F080  --------------------------------------------*/
    
    
    STEP();
    ACTION("Write DID F080 "); //Write DID F080  
    send_on_CAN(0x04,0x2E,0xF0,0x80,0x00,0x55,0x55,0x55);                           //We can able to write only one time if we want to check again then need to flash and Regionalization the ECU.
    testWaitForTimeout(100);
    Expect(0x03,0x6E,0xF0,0x80,0xAA,0xAA,0xAA,0xAA);
    EXPECTED_DATA("",E_Resp,0X08);
    OBSERVED_DATA("",O_Resp,0X08);
    Check(E_Resp,O_Resp);  
    Clear_Buffer();   

    testWaitForTimeout(1000);
    
    /*-------------------------------Test Step 8--------------------------------------*/ 
    /*-----------------------------ACTION: Enter Extended Session ---------------------------------------*/
    
    Extended_Session_Phy();
    
    /*-------------------------------Test Step 9--------------------------------------*/ 
    /*-----------------------------ACTION: Writing DID F080  --------------------------------------------*/
  
    
    STEP();
    ACTION("Write DID F080 "); //Write DID F080  
    send_on_CAN(0x04,0x2E,0xF0,0x80,0x00,0x55,0x55,0x55);
    testWaitForTimeout(100);
    Expect(0x03,0x7F,0x2E,0x33,0xAA,0xAA,0xAA,0xAA);
    EXPECTED_DATA("",E_Resp,0X08);
    OBSERVED_DATA("",O_Resp,0X08);
    Check(E_Resp,O_Resp);  
    Clear_Buffer();   

    testWaitForTimeout(1000);
    
    /*-------------------------------Test Step 10--------------------------------------*/ 
    /*-----------------------------ACTION: Setting ECU to Normal mode -----------------------------------*/
    
    Back_To_Normal();
  }

testcase TC3_PGS_200622_Lvl_1()
  {
    /*-------------------------------Test Step 1--------------------------------------*/ 
    /*-----------------------------ACTION: set Battery voltage to 12v -----------------------------------*/
    
    Set_Bat_Vol(12);
    
    /*-------------------------------Test Step 2--------------------------------------*/ 
    /*-----------------------------ACTION: Read MEC -----------------------------------------*/   
    
    Read_MEC();
    
    /*-------------------------------Test Step 3--------------------------------------*/ 
    /*-----------------------------ACTION: Set powermode to OFF -----------------------------------------*/
    
    @IgnitionSwitch=0;
    Read_PowerMode();
    
    
    /*-------------------------------Test Step 4--------------------------------------*/ 
    /*-----------------------------ACTION: Enter Extended Session ---------------------------------------*/
   
    Extended_Session_Phy();
    
    /*-------------------------------Test Step 5--------------------------------------*/ 
    /*-----------------------------ACTION: Activating Tester Present for every 2sec----------------------*/
   
    Tester_Present_Per_Start_Fun(2000);
    
    /*-------------------------------Test Step 6--------------------------------------*/ 
    /*-----------------------------ACTION: Security unlock Level 1----------------------------------------*/
    ACTION("Checking whether a valid Seed [non-zero, non-FF] for Security Level 01 is recieved or not");
    Security_Unlock_With_Key_lvl_1_Phy();
    
    testWaitForTimeout(5000);
    /*-------------------------------Test Step 6--------------------------------------*/ 
    /*-----------------------------ACTION: Writing DID which support Security level 1 --------------------*/
    STEP();
    ACTION("Write DID F199 ");                                                    //Write DID which support Security level 1 refer DID PDT
    send_on_CAN(0x07,0x2E,0xF1,0x99,0x20,0x25,0x09,0x24);                         
    testWaitForTimeout(200);
    Expect(0x03,0x6E,0xF1,0x99,0xAA,0xAA,0xAA,0xAA);
    EXPECTED_DATA("",E_Resp,0X08);
    OBSERVED_DATA("",O_Resp,0X08);
    Check(E_Resp,O_Resp);  
    Clear_Buffer();   

    testWaitForTimeout(1000);
    
    /*-------------------------------Test Step 7--------------------------------------*/ 
    /*-----------------------------ACTION: Enter Default Session ----------------------------------------*/
    Default_Session_Phy();
    
    /*-------------------------------Test Step 8--------------------------------------*/ 
    /*-----------------------------ACTION: Enter Extended Session ---------------------------------------*/
    Extended_Session_Phy();
    
    /*-------------------------------Test Step 9--------------------------------------*/ 
    /*-----------------------------ACTION: Writing DID which support Security level 1 --------------------*/
    STEP();
    ACTION("Write DID F199 ");                                                    //Write DID which support Security level 1  
    send_on_CAN(0x07,0x2E,0xF1,0x99,0x20,0x25,0x09,0x24);
    testWaitForTimeout(100);
    Expect(0x03,0x7F,0x2E,0x33,0xAA,0xAA,0xAA,0xAA);
    EXPECTED_DATA("",E_Resp,0X08);
    OBSERVED_DATA("",O_Resp,0X08);
    Check(E_Resp,O_Resp);  
    Clear_Buffer();   

    testWaitForTimeout(1000);
    
    /*-------------------------------Test Step 10--------------------------------------*/ 
    /*-----------------------------ACTION: Setting ECU to Normal mode -----------------------------------*/
    
    Back_To_Normal();
}  
    
testcase TC4_PGS_200622_Lvl_3()
  {
    /*-------------------------------Test Step 1--------------------------------------*/ 
    /*-----------------------------ACTION: set Battery voltage to 12v -----------------------------------*/
    
    Set_Bat_Vol(12);
    
    /*-------------------------------Test Step 2--------------------------------------*/ 
    /*-----------------------------ACTION: Read MEC -----------------------------------------*/   
    
    Read_MEC();
    
    /*-------------------------------Test Step 3--------------------------------------*/ 
    /*-----------------------------ACTION: Set powermode to OFF -----------------------------------------*/
    
    @IgnitionSwitch=0;
    Read_PowerMode();
    
    
    /*-------------------------------Test Step 4--------------------------------------*/ 
    /*-----------------------------ACTION: Enter Extended Session ---------------------------------------*/
   
    Extended_Session_Phy();
    
    /*-------------------------------Test Step 5--------------------------------------*/ 
    /*-----------------------------ACTION: Activating Tester Present for every 2sec----------------------*/
   
    Tester_Present_Per_Start_Fun(2000);
    
    /*-------------------------------Test Step 6--------------------------------------*/ 
    /*-----------------------------ACTION: Security unlock Level 3----------------------------------------*/
    ACTION("Checking whether a valid Seed [non-zero, non-FF] for Security Level 03 is recieved or not");
    Security_Unlock_With_Key_lvl_3_Phy();
    
    testWaitForTimeout(5000);
    /*-------------------------------Test Step 6--------------------------------------*/ 
    /*-----------------------------ACTION: Writing DID which support Security level 3 --------------------*/
    STEP();
    ACTION("Write DID F199 ");                                                    //Write DID which support Security level 3 refer DID PDT
    send_on_CAN(0x07,0x2E,0xF1,0x99,0x20,0x25,0x09,0x24);                         
    testWaitForTimeout(200);
    Expect(0x03,0x6E,0xF1,0x99,0xAA,0xAA,0xAA,0xAA);
    EXPECTED_DATA("",E_Resp,0X08);
    OBSERVED_DATA("",O_Resp,0X08);
    Check(E_Resp,O_Resp);  
    Clear_Buffer();   

    testWaitForTimeout(1000);
    
    /*-------------------------------Test Step 7--------------------------------------*/ 
    /*-----------------------------ACTION: Enter Default Session ----------------------------------------*/
    Default_Session_Phy();
    
    /*-------------------------------Test Step 8--------------------------------------*/ 
    /*-----------------------------ACTION: Enter Extended Session ---------------------------------------*/
    Extended_Session_Phy();
    
    /*-------------------------------Test Step 9--------------------------------------*/ 
    /*-----------------------------ACTION: Writing DID which support Security level 3 --------------------*/
    STEP();
    ACTION("Write DID F199 ");                                                    //Write DID which support Security level 3  
    send_on_CAN(0x07,0x2E,0xF1,0x99,0x20,0x25,0x09,0x24);
    testWaitForTimeout(100);
    Expect(0x03,0x7F,0x2E,0x33,0xAA,0xAA,0xAA,0xAA);
    EXPECTED_DATA("",E_Resp,0X08);
    OBSERVED_DATA("",O_Resp,0X08);
    Check(E_Resp,O_Resp);  
    Clear_Buffer();   

    testWaitForTimeout(1000);
    
    /*-------------------------------Test Step 10--------------------------------------*/ 
    /*-----------------------------ACTION: Setting ECU to Normal mode -----------------------------------*/
    
    Back_To_Normal();
} 

testcase TC5_PGS_200622_Lvl_5()
  {
    /*-------------------------------Test Step 1--------------------------------------*/ 
    /*-----------------------------ACTION: set Battery voltage to 12v -----------------------------------*/
    
    Set_Bat_Vol(12);
    
    /*-------------------------------Test Step 2--------------------------------------*/ 
    /*-----------------------------ACTION: Read MEC -----------------------------------------*/   
    
    Read_MEC();
    
    /*-------------------------------Test Step 3--------------------------------------*/ 
    /*-----------------------------ACTION: Set powermode to OFF -----------------------------------------*/
    
    @IgnitionSwitch=0;
    Read_PowerMode();
    
    
    /*-------------------------------Test Step 4--------------------------------------*/ 
    /*-----------------------------ACTION: Enter Extended Session ---------------------------------------*/
   
    Extended_Session_Phy();
    
    /*-------------------------------Test Step 5--------------------------------------*/ 
    /*-----------------------------ACTION: Activating Tester Present for every 2sec----------------------*/
   
    Tester_Present_Per_Start_Fun(2000);
    
    /*-------------------------------Test Step 6--------------------------------------*/ 
    /*-----------------------------ACTION: Security unlock Level 5----------------------------------------*/
    ACTION("Checking whether a valid Seed [non-zero, non-FF] for Security Level 05 is recieved or not");
    Security_Unlock_With_Key_lvl_5_Phy();
    
    testWaitForTimeout(5000);
    /*-------------------------------Test Step 6--------------------------------------*/ 
    /*-----------------------------ACTION: Writing DID which support Security level 5 --------------------*/
    STEP();
    ACTION("Write DID F199 ");                                                    //Write DID which support Security level 5 refer DID PDT
    send_on_CAN(0x07,0x2E,0xF1,0x99,0x20,0x25,0x09,0x24);                         
    testWaitForTimeout(200);
    Expect(0x03,0x6E,0xF1,0x99,0xAA,0xAA,0xAA,0xAA);
    EXPECTED_DATA("",E_Resp,0X08);
    OBSERVED_DATA("",O_Resp,0X08);
    Check(E_Resp,O_Resp);  
    Clear_Buffer();   

    testWaitForTimeout(1000);
    
    /*-------------------------------Test Step 7--------------------------------------*/ 
    /*-----------------------------ACTION: Enter Default Session ----------------------------------------*/
    Default_Session_Phy();
    
    /*-------------------------------Test Step 8--------------------------------------*/ 
    /*-----------------------------ACTION: Enter Extended Session ---------------------------------------*/
    Extended_Session_Phy();
    
    /*-------------------------------Test Step 9--------------------------------------*/ 
    /*-----------------------------ACTION: Writing DID which support Security level 5 --------------------*/
    STEP();
    ACTION("Write DID F199 ");                                                    //Write DID which support Security level 5  
    send_on_CAN(0x07,0x2E,0xF1,0x99,0x20,0x25,0x09,0x24);
    testWaitForTimeout(100);
    Expect(0x03,0x7F,0x2E,0x33,0xAA,0xAA,0xAA,0xAA);
    EXPECTED_DATA("",E_Resp,0X08);
    OBSERVED_DATA("",O_Resp,0X08);
    Check(E_Resp,O_Resp);  
    Clear_Buffer();   

    testWaitForTimeout(1000);
    
    /*-------------------------------Test Step 10--------------------------------------*/ 
    /*-----------------------------ACTION: Setting ECU to Normal mode -----------------------------------*/
    
    Back_To_Normal();
} 

testcase TC6_PGS_200622_Lvl_9()
  {
    /*-------------------------------Test Step 1--------------------------------------*/ 
    /*-----------------------------ACTION: set Battery voltage to 12v -----------------------------------*/
    
    Set_Bat_Vol(12);
    
    /*-------------------------------Test Step 2--------------------------------------*/ 
    /*-----------------------------ACTION: Read MEC -----------------------------------------*/   
    
    Read_MEC();
    
    /*-------------------------------Test Step 3--------------------------------------*/ 
    /*-----------------------------ACTION: Set powermode to OFF -----------------------------------------*/
    
    @IgnitionSwitch=0;
    Read_PowerMode();
    
    
    /*-------------------------------Test Step 4--------------------------------------*/ 
    /*-----------------------------ACTION: Enter Extended Session ---------------------------------------*/
   
    Extended_Session_Phy();
    
    /*-------------------------------Test Step 5--------------------------------------*/ 
    /*-----------------------------ACTION: Activating Tester Present for every 2sec----------------------*/
   
    Tester_Present_Per_Start_Fun(2000);
    
    /*-------------------------------Test Step 6--------------------------------------*/ 
    /*-----------------------------ACTION: Security unlock Level 9----------------------------------------*/
    ACTION("Checking whether a valid Seed [non-zero, non-FF] for Security Level 09 is recieved or not");
    Security_Unlock_With_Key_lvl_9_Phy();
    
    testWaitForTimeout(5000);
    /*-------------------------------Test Step 6--------------------------------------*/ 
    /*-----------------------------ACTION: Reading DID which support Security level 9 --------------------*/
    STEP();
    ACTION("Read DID F0A7 ");                                                    //Read DID which support Security level 9 refer DID PDT
    send_on_CAN(0x03,0x22,0xF0,0xA7,0x55,0x55,0x55,0x55);                         
    testWaitForTimeout(200);
    Expect(0x04,0x62,0xF0,0xA7,0x00,0xAA,0xAA,0xAA);
    EXPECTED_DATA("",E_Resp,0X08);
    OBSERVED_DATA("",O_Resp,0X08);
    Check(E_Resp,O_Resp);  
    Clear_Buffer();   

    testWaitForTimeout(1000);
    
    /*-------------------------------Test Step 7--------------------------------------*/ 
    /*-----------------------------ACTION: Enter Default Session ----------------------------------------*/
    Default_Session_Phy();
    
    /*-------------------------------Test Step 8--------------------------------------*/ 
    /*-----------------------------ACTION: Enter Extended Session ---------------------------------------*/
    Extended_Session_Phy();
    
    /*-------------------------------Test Step 9--------------------------------------*/ 
    /*-----------------------------ACTION: Writing DID which support Security level 9 --------------------*/
    STEP();
    ACTION("Write DID F0A7 ");                                                    //Read DID which support Security level 9  
    send_on_CAN(0x03,0x22,0xF0,0xA7,0x55,0x55,0x55,0x55);  
    testWaitForTimeout(100);
    Expect(0x03,0x7F,0x22,0x33,0xAA,0xAA,0xAA,0xAA);
    EXPECTED_DATA("",E_Resp,0X08);
    OBSERVED_DATA("",O_Resp,0X08);
    Check(E_Resp,O_Resp);  
    Clear_Buffer();   

    testWaitForTimeout(1000);
    
    /*-------------------------------Test Step 10--------------------------------------*/ 
    /*-----------------------------ACTION: Setting ECU to Normal mode -----------------------------------*/
    
    Back_To_Normal();
} 

testcase TC7_PGS_200622_Lvl_0B()
  {
    /*-------------------------------Test Step 1--------------------------------------*/ 
    /*-----------------------------ACTION: set Battery voltage to 12v -----------------------------------*/
    
    Set_Bat_Vol(12);
    
    /*-------------------------------Test Step 2--------------------------------------*/ 
    /*-----------------------------ACTION: Read MEC -----------------------------------------*/   
    
    Read_MEC();
    
    /*-------------------------------Test Step 3--------------------------------------*/ 
    /*-----------------------------ACTION: Set powermode to OFF -----------------------------------------*/
    
    @IgnitionSwitch=0;
    Read_PowerMode();
    
    
    /*-------------------------------Test Step 4--------------------------------------*/ 
    /*-----------------------------ACTION: Enter Extended Session ---------------------------------------*/
   
    Extended_Session_Phy();
    
    /*-------------------------------Test Step 5--------------------------------------*/ 
    /*-----------------------------ACTION: Activating Tester Present for every 2sec----------------------*/
   
    Tester_Present_Per_Start_Fun(2000);
    
    /*-------------------------------Test Step 6--------------------------------------*/ 
    /*-----------------------------ACTION: Security unlock Level 0B----------------------------------------*/
    ACTION("Checking whether a valid Seed [non-zero, non-FF] for Security Level 0B is recieved or not");
    Security_Unlock_With_Key_lvl_0B_Phy();
    
    testWaitForTimeout(5000);
    /*-------------------------------Test Step 6--------------------------------------*/ 
    /*-----------------------------ACTION: Reading DID which support Security level 0B --------------------*/
    STEP();
    ACTION("Read DID F0A7 ");                                                    //Read DID which support Security level 0B refer DID PDT
    send_on_CAN(0x03,0x22,0xF0,0xA7,0x55,0x55,0x55,0x55);                         
    testWaitForTimeout(200);
    Expect(0x04,0x62,0xF0,0xA7,0x00,0xAA,0xAA,0xAA);
    EXPECTED_DATA("",E_Resp,0X08);
    OBSERVED_DATA("",O_Resp,0X08);
    Check(E_Resp,O_Resp);  
    Clear_Buffer();   

    testWaitForTimeout(1000);
    
    /*-------------------------------Test Step 7--------------------------------------*/ 
    /*-----------------------------ACTION: Enter Default Session ----------------------------------------*/
    Default_Session_Phy();
    
    /*-------------------------------Test Step 8--------------------------------------*/ 
    /*-----------------------------ACTION: Enter Extended Session ---------------------------------------*/
    Extended_Session_Phy();
    
    /*-------------------------------Test Step 9--------------------------------------*/ 
    /*-----------------------------ACTION: Writing DID which support Security level 0B --------------------*/
    STEP();
    ACTION("Write DID F0A7 ");                                                    //Read DID which support Security level 0B 
    send_on_CAN(0x03,0x22,0xF0,0xA7,0x55,0x55,0x55,0x55);  
    testWaitForTimeout(100);
    Expect(0x03,0x7F,0x22,0x33,0xAA,0xAA,0xAA,0xAA);
    EXPECTED_DATA("",E_Resp,0X08);
    OBSERVED_DATA("",O_Resp,0X08);
    Check(E_Resp,O_Resp);  
    Clear_Buffer();   

    testWaitForTimeout(1000);
    
    /*-------------------------------Test Step 10--------------------------------------*/ 
    /*-----------------------------ACTION: Setting ECU to Normal mode -----------------------------------*/
    
    Back_To_Normal();
}

testcase TC8_PGS_200622_Lvl_0D()
  {
    /*-------------------------------Test Step 1--------------------------------------*/ 
    /*-----------------------------ACTION: set Battery voltage to 12v -----------------------------------*/
    
    Set_Bat_Vol(12);
    
    /*-------------------------------Test Step 2--------------------------------------*/ 
    /*-----------------------------ACTION: Read MEC -----------------------------------------*/   
    
    Read_MEC();
    
    /*-------------------------------Test Step 3--------------------------------------*/ 
    /*-----------------------------ACTION: Set powermode to OFF -----------------------------------------*/
    
    @IgnitionSwitch=0;
    Read_PowerMode();
    
    
    /*-------------------------------Test Step 4--------------------------------------*/ 
    /*-----------------------------ACTION: Enter Extended Session ---------------------------------------*/
   
    Extended_Session_Phy();
    
    /*-------------------------------Test Step 5--------------------------------------*/ 
    /*-----------------------------ACTION: Activating Tester Present for every 2sec----------------------*/
   
    Tester_Present_Per_Start_Fun(2000);
    
    /*-------------------------------Test Step 6--------------------------------------*/ 
    /*-----------------------------ACTION: Security unlock Level 0D----------------------------------------*/
    ACTION("Checking whether a valid Seed [non-zero, non-FF] for Security Level 0D is recieved or not");
    Security_Unlock_With_Key_lvl_0D_Phy();
    
    testWaitForTimeout(5000);
    /*-------------------------------Test Step 6--------------------------------------*/ 
    /*-----------------------------ACTION: Reading DID which support Security level 0D --------------------*/
    STEP();
    ACTION("Read DID F0A7 ");                                                    //Read DID which support Security level 0D refer DID PDT
    send_on_CAN(0x03,0x22,0xF0,0xA7,0x55,0x55,0x55,0x55);                         
    testWaitForTimeout(200);
    Expect(0x04,0x62,0xF0,0xA7,0x00,0xAA,0xAA,0xAA);
    EXPECTED_DATA("",E_Resp,0X08);
    OBSERVED_DATA("",O_Resp,0X08);
    Check(E_Resp,O_Resp);  
    Clear_Buffer();   

    testWaitForTimeout(1000);
    
    /*-------------------------------Test Step 7--------------------------------------*/ 
    /*-----------------------------ACTION: Enter Default Session ----------------------------------------*/
    Default_Session_Phy();
    
    /*-------------------------------Test Step 8--------------------------------------*/ 
    /*-----------------------------ACTION: Enter Extended Session ---------------------------------------*/
    Extended_Session_Phy();
    
    /*-------------------------------Test Step 9--------------------------------------*/ 
    /*-----------------------------ACTION: Writing DID which support Security level 0D --------------------*/
    STEP();
    ACTION("Write DID F0A7 ");                                                    //Read DID which support Security level 0D 
    send_on_CAN(0x03,0x22,0xF0,0xA7,0x55,0x55,0x55,0x55);  
    testWaitForTimeout(100);
    Expect(0x03,0x7F,0x22,0x33,0xAA,0xAA,0xAA,0xAA);
    EXPECTED_DATA("",E_Resp,0X08);
    OBSERVED_DATA("",O_Resp,0X08);
    Check(E_Resp,O_Resp);  
    Clear_Buffer();   

    testWaitForTimeout(1000);
    
    /*-------------------------------Test Step 10--------------------------------------*/ 
    /*-----------------------------ACTION: Setting ECU to Normal mode -----------------------------------*/
    
    Back_To_Normal();
}

testcase TC9_PGS_200622_Lvl_11()
  {
    /*-------------------------------Test Step 1--------------------------------------*/ 
    /*-----------------------------ACTION: set Battery voltage to 12v -----------------------------------*/
    
    Set_Bat_Vol(12);
    
    /*-------------------------------Test Step 2--------------------------------------*/ 
    /*-----------------------------ACTION: Read MEC -----------------------------------------*/   
    
    Read_MEC();
    
    /*-------------------------------Test Step 3--------------------------------------*/ 
    /*-----------------------------ACTION: Set powermode to OFF -----------------------------------------*/
    
    @IgnitionSwitch=0;
    Read_PowerMode();
    
    
    /*-------------------------------Test Step 4--------------------------------------*/ 
    /*-----------------------------ACTION: Enter Extended Session ---------------------------------------*/
   
    Extended_Session_Phy();
    
    /*-------------------------------Test Step 5--------------------------------------*/ 
    /*-----------------------------ACTION: Activating Tester Present for every 2sec----------------------*/
   
    Tester_Present_Per_Start_Fun(2000);
    
    /*-------------------------------Test Step 6--------------------------------------*/ 
    /*-----------------------------ACTION: Security unlock Level 11----------------------------------------*/
    ACTION("Checking whether a valid Seed [non-zero, non-FF] for Security Level 11 is recieved or not");
    Security_Unlock_With_Key_lvl_11_Phy();
    
    testWaitForTimeout(5000);
    /*-------------------------------Test Step 6--------------------------------------*/ 
    /*-----------------------------ACTION: Writing DID which support Security level 11 --------------------*/
    STEP();
    ACTION("Write DID F199 ");                                                    //Write DID which support Security level 11 refer DID PDT
    send_on_CAN(0x07,0x2E,0xF1,0x99,0x20,0x25,0x09,0x24);                         
    testWaitForTimeout(200);
    Expect(0x03,0x6E,0xF1,0x99,0xAA,0xAA,0xAA,0xAA);
    EXPECTED_DATA("",E_Resp,0X08);
    OBSERVED_DATA("",O_Resp,0X08);
    Check(E_Resp,O_Resp);  
    Clear_Buffer();   

    testWaitForTimeout(1000);
    
    /*-------------------------------Test Step 7--------------------------------------*/ 
    /*-----------------------------ACTION: Enter Default Session ----------------------------------------*/
    Default_Session_Phy();
    
    /*-------------------------------Test Step 8--------------------------------------*/ 
    /*-----------------------------ACTION: Enter Extended Session ---------------------------------------*/
    Extended_Session_Phy();
    
    /*-------------------------------Test Step 9--------------------------------------*/ 
    /*-----------------------------ACTION: Writing DID which support Security level 11 --------------------*/
    STEP();
    ACTION("Write DID F199 ");                                                    //Write DID which support Security level 11  
    send_on_CAN(0x07,0x2E,0xF1,0x99,0x20,0x25,0x09,0x24);
    testWaitForTimeout(100);
    Expect(0x03,0x7F,0x2E,0x33,0xAA,0xAA,0xAA,0xAA);
    EXPECTED_DATA("",E_Resp,0X08);
    OBSERVED_DATA("",O_Resp,0X08);
    Check(E_Resp,O_Resp);  
    Clear_Buffer();   

    testWaitForTimeout(1000);
    
    /*-------------------------------Test Step 10--------------------------------------*/ 
    /*-----------------------------ACTION: Setting ECU to Normal mode -----------------------------------*/
    
    Back_To_Normal();
} 

testcase TC10_PGS_200622_Lvl_13()
  {
    /*-------------------------------Test Step 1--------------------------------------*/ 
    /*-----------------------------ACTION: set Battery voltage to 12v -----------------------------------*/
    
    Set_Bat_Vol(12);
    
    /*-------------------------------Test Step 2--------------------------------------*/ 
    /*-----------------------------ACTION: Read MEC -----------------------------------------*/   
    
    Read_MEC();
    
    /*-------------------------------Test Step 3--------------------------------------*/ 
    /*-----------------------------ACTION: Set powermode to OFF -----------------------------------------*/
    
    @IgnitionSwitch=0;
    Read_PowerMode();
    
    
    /*-------------------------------Test Step 4--------------------------------------*/ 
    /*-----------------------------ACTION: Enter Extended Session ---------------------------------------*/
   
    Extended_Session_Phy();
    
    /*-------------------------------Test Step 5--------------------------------------*/ 
    /*-----------------------------ACTION: Activating Tester Present for every 2sec----------------------*/
   
    Tester_Present_Per_Start_Fun(2000);
    
    /*-------------------------------Test Step 6--------------------------------------*/ 
    /*-----------------------------ACTION: Security unlock Level 13----------------------------------------*/
    ACTION("Checking whether a valid Seed [non-zero, non-FF] for Security Level 13 is recieved or not");
    Security_Unlock_With_Key_lvl_13_Phy();
    
    testWaitForTimeout(5000);
    /*-------------------------------Test Step 6--------------------------------------*/ 
    /*-----------------------------ACTION: Writing DID which support Security level 13 --------------------*/
    STEP();
    ACTION("Write DID F199 ");                                                    //Write DID which support Security level 13 refer DID PDT
    send_on_CAN(0x07,0x2E,0xF1,0x99,0x20,0x25,0x09,0x24);                         
    testWaitForTimeout(200);
    Expect(0x03,0x6E,0xF1,0x99,0xAA,0xAA,0xAA,0xAA);
    EXPECTED_DATA("",E_Resp,0X08);
    OBSERVED_DATA("",O_Resp,0X08);
    Check(E_Resp,O_Resp);  
    Clear_Buffer();   

    testWaitForTimeout(1000);
    
    /*-------------------------------Test Step 7--------------------------------------*/ 
    /*-----------------------------ACTION: Enter Default Session ----------------------------------------*/
    Default_Session_Phy();
    
    /*-------------------------------Test Step 8--------------------------------------*/ 
    /*-----------------------------ACTION: Enter Extended Session ---------------------------------------*/
    Extended_Session_Phy();
    
    /*-------------------------------Test Step 9--------------------------------------*/ 
    /*-----------------------------ACTION: Writing DID which support Security level 13 --------------------*/
    STEP();
    ACTION("Write DID F199 ");                                                    //Write DID which support Security level 13  
    send_on_CAN(0x07,0x2E,0xF1,0x99,0x20,0x25,0x09,0x24);
    testWaitForTimeout(100);
    Expect(0x03,0x7F,0x2E,0x33,0xAA,0xAA,0xAA,0xAA);
    EXPECTED_DATA("",E_Resp,0X08);
    OBSERVED_DATA("",O_Resp,0X08);
    Check(E_Resp,O_Resp);  
    Clear_Buffer();   

    testWaitForTimeout(1000);
    
    /*-------------------------------Test Step 10--------------------------------------*/ 
    /*-----------------------------ACTION: Setting ECU to Normal mode -----------------------------------*/
    
    Back_To_Normal();
}  

testcase TC11_PGS_200622_Lvl_15()
  {
    /*-------------------------------Test Step 1--------------------------------------*/ 
    /*-----------------------------ACTION: set Battery voltage to 12v -----------------------------------*/
    
    Set_Bat_Vol(12);
    
    /*-------------------------------Test Step 2--------------------------------------*/ 
    /*-----------------------------ACTION: Read MEC -----------------------------------------*/   
    
    Read_MEC();
    
    /*-------------------------------Test Step 3--------------------------------------*/ 
    /*-----------------------------ACTION: Set powermode to OFF -----------------------------------------*/
    
    @IgnitionSwitch=0;
    Read_PowerMode();
    
    
    /*-------------------------------Test Step 4--------------------------------------*/ 
    /*-----------------------------ACTION: Enter Extended Session ---------------------------------------*/
   
    Extended_Session_Phy();
    
    /*-------------------------------Test Step 5--------------------------------------*/ 
    /*-----------------------------ACTION: Activating Tester Present for every 2sec----------------------*/
   
    Tester_Present_Per_Start_Fun(2000);
    
    /*-------------------------------Test Step 6--------------------------------------*/ 
    /*-----------------------------ACTION: Security unlock Level 15----------------------------------------*/
    ACTION("Checking whether a valid Seed [non-zero, non-FF] for Security Level 15 is recieved or not");
    Security_Unlock_With_Key_lvl_15_Phy();
    
    testWaitForTimeout(5000);
    /*-------------------------------Test Step 6--------------------------------------*/ 
    /*-----------------------------ACTION: Writing DID which support Security level 15 --------------------*/
    STEP();
    ACTION("Write DID F199 ");                                                    //Write DID which support Security level 15 refer DID PDT
    send_on_CAN(0x07,0x2E,0xF1,0x99,0x20,0x25,0x09,0x24);                         
    testWaitForTimeout(200);
    Expect(0x03,0x6E,0xF1,0x99,0xAA,0xAA,0xAA,0xAA);
    EXPECTED_DATA("",E_Resp,0X08);
    OBSERVED_DATA("",O_Resp,0X08);
    Check(E_Resp,O_Resp);  
    Clear_Buffer();   

    testWaitForTimeout(1000);
    
    /*-------------------------------Test Step 7--------------------------------------*/ 
    /*-----------------------------ACTION: Enter Default Session ----------------------------------------*/
    Default_Session_Phy();
    
    /*-------------------------------Test Step 8--------------------------------------*/ 
    /*-----------------------------ACTION: Enter Extended Session ---------------------------------------*/
    Extended_Session_Phy();
    
    /*-------------------------------Test Step 9--------------------------------------*/ 
    /*-----------------------------ACTION: Writing DID which support Security level 15 --------------------*/
    STEP();
    ACTION("Write DID F199 ");                                                    //Write DID which support Security level 15  
    send_on_CAN(0x07,0x2E,0xF1,0x99,0x20,0x25,0x09,0x24);
    testWaitForTimeout(100);
    Expect(0x03,0x7F,0x2E,0x33,0xAA,0xAA,0xAA,0xAA);
    EXPECTED_DATA("",E_Resp,0X08);
    OBSERVED_DATA("",O_Resp,0X08);
    Check(E_Resp,O_Resp);  
    Clear_Buffer();   

    testWaitForTimeout(1000);
    
    /*-------------------------------Test Step 10--------------------------------------*/ 
    /*-----------------------------ACTION: Setting ECU to Normal mode -----------------------------------*/
    
    Back_To_Normal();
}  

testcase TC12_PGS_200625() //need to run in multiCG tool 
  {
    /*-------------------------------Test Step 1--------------------------------------*/ 
    /*-----------------------------ACTION: set Battery voltage to 12v -----------------------------------*/
    
    Set_Bat_Vol(12);
    
    /*-------------------------------Test Step 2--------------------------------------*/ 
    /*-----------------------------ACTION: Read MEC -----------------------------------------*/   
    
    Read_MEC();
    
    /*-------------------------------Test Step 3--------------------------------------*/ 
    /*-----------------------------ACTION: Set powermode to OFF -----------------------------------------*/
    
    @IgnitionSwitch=0;
    Read_PowerMode();
    
    
    /*-------------------------------Test Step 4--------------------------------------*/ 
    /*-----------------------------ACTION: Enter Extended Session ---------------------------------------*/
   
    Extended_Session_Phy();
    
    /*-------------------------------Test Step 5--------------------------------------*/ 
    /*-----------------------------ACTION: Activating Tester Present for every 2sec----------------------*/
   
    Tester_Present_Per_Start_Fun(2000);
    
    /*-------------------------------Test Step 6--------------------------------------*/ 
    /*-----------------------------ACTION: Security unlock Level 1----------------------------------------*/
    ACTION("Checking whether a valid Seed [non-zero, non-FF] for Security Level 01 is recieved or not");
    Security_Unlock_With_Key_lvl_1_Phy();
  
    /*-------------------------------Test Step 7--------------------------------------*/ 
    /*-----------------------------ACTION: Write RID 21E ----------------------------------------*/
    Write_RID_21E();
    
    /*-------------------------------Test Step 8--------------------------------------*/ 
    /*-----------------------------ACTION: Security unlock Level 11----------------------------------------*/
    ACTION("Checking whether a valid Seed [non-zero, non-FF] for Security Level 11 is recieved or not");
    Security_Unlock_With_Key_lvl_11_Phy();
    
    /*-------------------------------Test Step 9--------------------------------------*/ 
    /*-----------------------------ACTION: Enter Default Session ----------------------------------------*/
    Default_Session_Phy();
    
    /*-------------------------------Test Step 10--------------------------------------*/ 
    /*-----------------------------ACTION: Setting ECU to Normal mode -----------------------------------*/
    Back_To_Normal();
    
  }  
  
testcase TC13_PGS_200626() //need to run in multiCG tool 
  {
    /*-------------------------------Test Step 1--------------------------------------*/ 
    /*-----------------------------ACTION: set Battery voltage to 12v -----------------------------------*/
    
    Set_Bat_Vol(12);
    
    /*-------------------------------Test Step 2--------------------------------------*/ 
    /*-----------------------------ACTION: Read MEC -----------------------------------------*/   
    
    Read_MEC();
    
    /*-------------------------------Test Step 3--------------------------------------*/ 
    /*-----------------------------ACTION: Set powermode to OFF -----------------------------------------*/
    
    @IgnitionSwitch=0;
    Read_PowerMode();
    
    
    /*-------------------------------Test Step 4--------------------------------------*/ 
    /*-----------------------------ACTION: Enter Extended Session ---------------------------------------*/
   
    Extended_Session_Phy();
    
    /*-------------------------------Test Step 5--------------------------------------*/ 
    /*-----------------------------ACTION: Activating Tester Present for every 2sec----------------------*/
   
    Tester_Present_Per_Start_Fun(2000);
    
    /*-------------------------------Test Step 6--------------------------------------*/ 
    /*-----------------------------ACTION: Security unlock Level 3----------------------------------------*/
    ACTION("Checking whether a valid Seed [non-zero, non-FF] for Security Level 03 is recieved or not");
    Security_Unlock_With_Key_lvl_3_Phy();
    
    /*-------------------------------Test Step 7--------------------------------------*/ 
    /*-----------------------------ACTION: Write RID 21E ----------------------------------------*/
    Write_RID_21E();   //InitialRefalshFlag
    
    /*-------------------------------Test Step 8--------------------------------------*/ 
    /*-----------------------------ACTION: Security unlock Level 13----------------------------------------*/
    ACTION("Checking whether a valid Seed [non-zero, non-FF] for Security Level 13 is recieved or not");
    Security_Unlock_With_Key_lvl_13_Phy();
    
    /*-------------------------------Test Step 9--------------------------------------*/ 
    /*-----------------------------ACTION: Enter Default Session ----------------------------------------*/
    Default_Session_Phy();
    
    /*-------------------------------Test Step 10--------------------------------------*/ 
    /*-----------------------------ACTION: Setting ECU to Normal mode -----------------------------------*/
    Back_To_Normal();    
  }  
 
testcase TC14_PGS_200627() //need to run in multiCG tool 
  {
    /*-------------------------------Test Step 1--------------------------------------*/ 
    /*-----------------------------ACTION: set Battery voltage to 12v -----------------------------------*/
    
    Set_Bat_Vol(12);
    
    /*-------------------------------Test Step 2--------------------------------------*/ 
    /*-----------------------------ACTION: Read MEC -----------------------------------------*/   
    
    Read_MEC();
    
    /*-------------------------------Test Step 3--------------------------------------*/ 
    /*-----------------------------ACTION: Set powermode to OFF -----------------------------------------*/
    
    @IgnitionSwitch=0;
    Read_PowerMode();
    
    
    /*-------------------------------Test Step 4--------------------------------------*/ 
    /*-----------------------------ACTION: Enter Extended Session ---------------------------------------*/
   
    Extended_Session_Phy();
    
    /*-------------------------------Test Step 5--------------------------------------*/ 
    /*-----------------------------ACTION: Activating Tester Present for every 2sec----------------------*/
   
    Tester_Present_Per_Start_Fun(2000);
    
    /*-------------------------------Test Step 6--------------------------------------*/ 
    /*-----------------------------ACTION: Security unlock Level 5----------------------------------------*/
    ACTION("Checking whether a valid Seed [non-zero, non-FF] for Security Level 05 is recieved or not");
    Security_Unlock_With_Key_lvl_5_Phy();
    
    /*-------------------------------Test Step 7--------------------------------------*/ 
    /*-----------------------------ACTION: Write RID 21E ----------------------------------------*/
    Write_RID_21E();   //InitialRefalshFlag
    
    /*-------------------------------Test Step 8--------------------------------------*/ 
    /*-----------------------------ACTION: Security unlock Level 15----------------------------------------*/
    ACTION("Checking whether a valid Seed [non-zero, non-FF] for Security Level 15 is recieved or not");
    Security_Unlock_With_Key_lvl_13_Phy();
    
    /*-------------------------------Test Step 9--------------------------------------*/ 
    /*-----------------------------ACTION: Enter Default Session ----------------------------------------*/
    Default_Session_Phy();
    
    /*-------------------------------Test Step 10--------------------------------------*/ 
    /*-----------------------------ACTION: Setting ECU to Normal mode -----------------------------------*/
    Back_To_Normal(); 
    
  }
  
testcase TC15_PGS_200631()
  {  
    /*-------------------------------Test Step 1--------------------------------------*/ 
    /*-----------------------------ACTION: set Battery voltage to 12v -----------------------------------*/
   
    Set_Bat_Vol(12);
    
    /*-------------------------------Test Step 2--------------------------------------*/ 
    /*-----------------------------ACTION: Read MEC -----------------------------------------*/   
    
    Read_MEC();
    
    /*-------------------------------Test Step 3--------------------------------------*/ 
    /*-----------------------------ACTION: Set powermode to OFF -----------------------------------------*/
    @IgnitionSwitch=0;
    Read_PowerMode();
    
    /*-------------------------------Test Step 4--------------------------------------*/ 
    /*-----------------------------ACTION: Enter Default Session ----------------------------------------*/
    Default_Session_Phy();
    
    /*-------------------------------Test Step 5--------------------------------------*/ 
    /*-----------------------------ACTION: Enter Extended Session ---------------------------------------*/
    Extended_Session_Phy();
    
    /*-------------------------------Test Step 6--------------------------------------*/ 
    /*-----------------------------ACTION: Activating Tester Present for every 2sec----------------------*/
   
    Tester_Present_Per_Start_Fun(2000);
    
    /*-------------------------------Test Step 7--------------------------------------*/ 
    /*-----------------------------ACTION: Security unlock Level 1----------------------------------------*/
    ACTION("Checking whether a valid Seed [non-zero, non-FF] for Security Level 01 is recieved or not");
    Security_Unlock_With_Key_lvl_1_Phy();
    
    testWaitForTimeout(5000);
    
    /*-------------------------------Test Step 8--------------------------------------*/ 
    /*-----------------------------ACTION: Writing DID which support Security level 1 --------------------*/
    STEP();
    ACTION("Write DID F199 ");                                                    //Write DID which support Security level 1 refer DID PDT
    send_on_CAN(0x07,0x2E,0xF1,0x99,0x20,0x25,0x09,0x24);                         
    testWaitForTimeout(200);
    Expect(0x03,0x6E,0xF1,0x99,0xAA,0xAA,0xAA,0xAA);
    EXPECTED_DATA("",E_Resp,0X08);
    OBSERVED_DATA("",O_Resp,0X08);
    Check(E_Resp,O_Resp);  
    Clear_Buffer();   

    testWaitForTimeout(1000);    
    
    /*-------------------------------Test Step 7--------------------------------------*/ 
    /*-----------------------------ACTION: Security unlock Level 9 with Invalid Key----------------------------------------*/  // NEED TO VERIFY
    ACTION("Security Level 9 Tried Unlocked with Invalid key ");
    Security_Unlock_With_Key_lvl_1_Phy();
    
    testWaitForTimeout(2000);
    
    /*-------------------------------Test Step 6--------------------------------------*/ 
    /*-----------------------------ACTION: Reading DID which support Security level 9 --------------------*/
    STEP();
    ACTION("Read DID F0A7 ");                                                    //Read DID which support Security level 9 refer DID PDT
    send_on_CAN(0x03,0x22,0xF0,0xA7,0x55,0x55,0x55,0x55);                         
    testWaitForTimeout(200);
    Expect(0x04,0x62,0xF0,0xA7,0x00,0xAA,0xAA,0xAA);
    EXPECTED_DATA("",E_Resp,0X08);
    OBSERVED_DATA("",O_Resp,0X08);
    Check(E_Resp,O_Resp);  
    Clear_Buffer();   

    testWaitForTimeout(1000);
  }
  
testcase TC16_PGS_153419()
  {
    /*-------------------------------Test Step 1--------------------------------------*/ 
    /*-----------------------------ACTION: set Battery voltage to 12v -----------------------------------*/
   
    Set_Bat_Vol(12);
    
    /*-------------------------------Test Step 2--------------------------------------*/ 
    /*-----------------------------ACTION: Read MEC -----------------------------------------*/   
    
    Read_MEC();
    
    /*-------------------------------Test Step 3--------------------------------------*/ 
    /*-----------------------------ACTION: Set powermode to OFF -----------------------------------------*/
    @IgnitionSwitch=0;
    Read_PowerMode();
    
    /*-------------------------------Test Step 4--------------------------------------*/ 
    /*-----------------------------ACTION: Enter Default Session ----------------------------------------*/
    Default_Session_Phy();
    
    /*-------------------------------Test Step 5--------------------------------------*/ 
    /*-----------------------------ACTION: Read DID E0B5        ----------------------------------------*/
    
// Need to work.......................................... 
//    STEP();
//    ACTION("Read DID E0B5 ");
//    send_on_CAN(0x03,0x22,0xE0,0xB5,0x55,0x55,0x55,0x55);
//    testWaitForTimeout(200);
//                Expect1(O_Resp[0],O_Resp[1],O_Resp[2],O_Resp[3],O_Resp[4],O_Resp[5],O_Resp[6],O_Resp[7]);
//                testWaitForTimeout(50);
//                Expect2(O_Resp[8],O_Resp[9],O_Resp[10],O_Resp[11],O_Resp[12],O_Resp[13],O_Resp[14],O_Resp[15]);
//                testWaitForTimeout(50);
//                Expect3(O_Resp[16],O_Resp[17],O_Resp[18],O_Resp[19],O_Resp[20],O_Resp[21],O_Resp[22],O_Resp[23]);
//                testWaitForTimeout(50);
//                Expect4(O_Resp[24],O_Resp[25],O_Resp[26],O_Resp[27],O_Resp[28],O_Resp[29],O_Resp[30],O_Resp[31]);
//                testWaitForTimeout(50);
//                Expect5(O_Resp[32],O_Resp[33],O_Resp[34],O_Resp[35],O_Resp[36],O_Resp[37],O_Resp[38],O_Resp[39]);
//                testWaitForTimeout(50);
//    EXPECTED_DATA("",E_Resp,0X40);
//    OBSERVED_DATA("",O_Resp,0X40);
//    Check(E_Resp,O_Resp);  
//    Clear_Buffer();   

    /*-------------------------------Test Step 6--------------------------------------*/ 
    /*-----------------------------ACTION: Activating Tester Present for every 2sec----------------------*/
   
    Tester_Present_Per_Start_Fun(2000);
    
    /*-------------------------------Test Step 7--------------------------------------*/ 
    /*-----------------------------ACTION: Enter Extended Session ---------------------------------------*/
    Extended_Session_Phy();
    
    /*-------------------------------Test Step 8--------------------------------------*/ 
    /*-----------------------------ACTION: Security unlock Level 3----------------------------------------*/
    ACTION("Checking whether a valid Seed [non-zero, non-FF] for Security Level 03 is recieved or not");
    Security_Unlock_With_Key_lvl_3_Phy();
    testWaitForTimeout(5000);
    
    /*-------------------------------Test Step 9--------------------------------------*/ 
    /*-----------------------------ACTION: Enter Extended Session ---------------------------------------*/
    Extended_Session_Phy();
    
    /*-------------------------------Test Step 10--------------------------------------*/ 
    /*-----------------------------ACTION: Security unlock Level 3----------------------------------------*/
    ACTION("Checking whether a valid Seed [non-zero, non-FF] for Security Level 03 is recieved or not");
    Security_Unlock_With_Key_lvl_3_Phy();

    /*-------------------------------Test Step 11--------------------------------------*/ 
    /*-----------------------------ACTION: Verify both seeds or diff or not ------------------------------*/
          for(h=22;h<40;h++)
            {
                if(Cmp_Resp1[h]!=Cmp_Resp2[h])
                  {
                    sum++;
                  }
            }
          
          if(sum==15)
            
              {
                STEP();
                ACTION("Checking the both seed whether both or diff or not [ECU ID-16,RN - 15]");
                AddToReport(PASSED);
              }
          else
              
              {
                STEP();
                ACTION("Checking the both seed whether both or diff or not [ECU ID-16,RN - 15] ");
                AddToReport(FAILED);
              }
      
    /*-------------------------------Test Step 12--------------------------------------*/ 
    /*-----------------------------ACTION: Setting ECU to Normal mode -----------------------------------*/
    
    Back_To_Normal();
  }
  
testcase TC17_PGS_202212()
  {
    /*-------------------------------Test Step 1--------------------------------------*/ 
    /*-----------------------------ACTION: set Battery voltage to 12v -----------------------------------*/
    
    Set_Bat_Vol(12);
    
    /*-------------------------------Test Step 2--------------------------------------*/ 
    /*-----------------------------ACTION: Read MEC -----------------------------------------*/   
    
    Read_MEC();
    
    /*-------------------------------Test Step 3--------------------------------------*/ 
    /*-----------------------------ACTION: Set powermode to OFF -----------------------------------------*/
    
    @IgnitionSwitch=0;
    Read_PowerMode();
    
    /*-------------------------------Test Step 4--------------------------------------*/ 
    /*-----------------------------ACTION: Enter Extended Session ---------------------------------------*/
   
    Extended_Session_Phy();
    
    /*-------------------------------Test Step 5--------------------------------------*/ 
    /*-----------------------------ACTION: Activating Tester Present for every 2sec----------------------*/
   
    Tester_Present_Per_Start_Fun(2000);
    
    /*-------------------------------Test Step 6--------------------------------------*/ 
    /*-----------------------------ACTION: Disable Communication----------------------*/
    
    Dis_Comm_phy();
    
    /*-------------------------------Test Step 7--------------------------------------*/ 
    /*-----------------------------ACTION: Security unlock Level 3----------------------------------------*/
    
    ACTION("Checking whether a valid Seed [non-zero, non-FF] for Security Level 03 is recieved or not");
    Security_Unlock_With_Key_lvl_3_Phy();
    testWaitForTimeout(5000);
    
    /*-------------------------------Test Step 8--------------------------------------*/ 
    /*-----------------------------ACTION: Write RID 21E ------------------------------------------------*/
    
    Write_RID_21E();
  
    /*-------------------------------Test Step 9--------------------------------------*/ 
    /*-----------------------------ACTION: Hard Reset   ------------------------------------------------*/
    
    Hard_Reset_Phy();
    
    /*-------------------------------Test Step 10--------------------------------------*/ 
    /*-----------------------------ACTION: Enter Extended Session ---------------------------------------*/
   
    Extended_Session_Phy();
    
    /*-------------------------------Test Step 11--------------------------------------*/ 
    /*-----------------------------ACTION: Activating Tester Present for every 2sec----------------------*/
   
    Tester_Present_Per_Start_Fun(2000);
    
    /*-------------------------------Test Step 12--------------------------------------*/ 
    /*-----------------------------ACTION: Write RID 21E ------------------------------------------------*/
    
    STEP();
    ACTION("Writing RID 21E"); //Writing RID 21E                                    
    send_on_CAN(0x04,0x31,0x01,0x02,0x1E,0x00,0x00,0x00);
    testWaitForTimeout(100);
    Expect(0x03,0x7F,0x31,0x33,0xAA,0xAA,0xAA,0xAA);
    EXPECTED_DATA("",E_Resp,8);
    OBSERVED_DATA("",O_Resp,8);
    Check(E_Resp,O_Resp);  
    Clear_Buffer();   
    
    
    testWaitForTimeout(500);
    
    /*-------------------------------Test Step 12--------------------------------------*/ 
    /*-----------------------------ACTION: Setting ECU to Normal mode -----------------------------------*/
    
    Back_To_Normal();
  }

testcase TC18_PGS_153437()
  {
    /*-------------------------------Test Step 1--------------------------------------*/ 
    /*-----------------------------ACTION: set Battery voltage to 12v -----------------------------------*/
    
    Set_Bat_Vol(12);
    
    /*-------------------------------Test Step 2--------------------------------------*/ 
    /*-----------------------------ACTION: Read MEC -----------------------------------------*/   
    
    Read_MEC();
    
    /*-------------------------------Test Step 3--------------------------------------*/ 
    /*-----------------------------ACTION: Set powermode to OFF -----------------------------------------*/
    
    @IgnitionSwitch=0;
    Read_PowerMode();
    
    /*-------------------------------Test Step 4--------------------------------------*/ 
    /*-----------------------------ACTION: Enter Extended Session ---------------------------------------*/
   
    Extended_Session_Phy();
    
    /*-------------------------------Test Step 5--------------------------------------*/ 
    /*-----------------------------ACTION: Activating Tester Present for every 2sec----------------------*/
   
    Tester_Present_Per_Start_Fun(2000);
    
    /*-------------------------------Test Step 6--------------------------------------*/ 
    /*-----------------------------ACTION: Security unlock Level 3----------------------------------------*/
    
    ACTION("Checking whether a valid Seed [non-zero, non-FF] for Security Level 03 is recieved or not");
    Security_Unlock_With_Key_lvl_3_Phy();
    testWaitForTimeout(5000);
    
    /*-------------------------------Test Step 7--------------------------------------*/ 
    /*-----------------------------ACTION: Write DID 4987 ------------------------------------------------*/
    
    STEP();
    ACTION("write DID 4987"); 
    send_on_CAN(0x10,0x0C,0x2E,0x49,0x87,0x01,0x02,0x03);
    testWaitForTimeout(50);
    send_on_CAN(0x21,0x04,0x05,0x06,0x07,0x08,0x09,0x55);
    testWaitForTimeout(350);
    Expect(0x03,0x6E,0x49,0x87,0xAA,0xAA,0xAA,0xAA);
    testWaitForTimeout(50);
    
    EXPECTED_DATA("",E_Resp,16);
    OBSERVED_DATA("",O_Resp,8);
    Check(E_Resp,O_Resp);  
    Clear_Buffer();   

    testWaitForTimeout(500);

    /*-------------------------------Test Step 8--------------------------------------*/ 
    /*-----------------------------ACTION: Enter Default Session ----------------------------------------*/
    Default_Session_Phy();
    
    /*-------------------------------Test Step 9--------------------------------------*/ 
    /*-----------------------------ACTION: Enter Extended Session ---------------------------------------*/
    Extended_Session_Phy();
    
    /*-------------------------------Test Step 10--------------------------------------*/ 
    /*-----------------------------ACTION: Write DID 4987 ------------------------------------------------*/
    
    STEP();
    ACTION("write DID 4987"); 
    send_on_CAN(0x10,0x0C,0x2E,0x49,0x87,0x09,0x08,0x07);
    testWaitForTimeout(50);
    send_on_CAN(0x21,0x06,0x05,0x04,0x03,0x02,0x01,0x55);
    testWaitForTimeout(50);
    Expect(0x03,0x7F,0x2E,0x33,0xAA,0xAA,0xAA,0xAA);
    testWaitForTimeout(50);
    
    EXPECTED_DATA("",E_Resp,16);
    OBSERVED_DATA("",O_Resp,8);
    Check(E_Resp,O_Resp);  
    Clear_Buffer();   

    testWaitForTimeout(500);
    
    
    /*-------------------------------Test Step 12--------------------------------------*/ 
    /*-----------------------------ACTION: Setting ECU to Normal mode -----------------------------------*/
    
    Back_To_Normal();    
    
  }
  
testcase TC19_PGS_153618()
  {
    /*-------------------------------Test Step 1--------------------------------------*/ 
    /*-----------------------------ACTION: set Battery voltage to 12v -----------------------------------*/
   
    Set_Bat_Vol(12);
    
    /*-------------------------------Test Step 2--------------------------------------*/ 
    /*-----------------------------ACTION: Read MEC -----------------------------------------*/   
    
    Read_MEC();
    
    /*-------------------------------Test Step 3--------------------------------------*/ 
    /*-----------------------------ACTION: Set powermode to OFF -----------------------------------------*/
    @IgnitionSwitch=0;
    Read_PowerMode();
    
    /*-------------------------------Test Step 4--------------------------------------*/ 
    /*-----------------------------ACTION: Enter Default Session ----------------------------------------*/
    Default_Session_Phy();
    
    /*-------------------------------Test Step 5--------------------------------------*/ 
    /*-----------------------------ACTION: Enter Extended Session ---------------------------------------*/
    Extended_Session_Phy();
    
    /*-------------------------------Test Step 6--------------------------------------*/ 
    /*-----------------------------ACTION: Activating Tester Present for every 2sec----------------------*/
   
    Tester_Present_Per_Start_Fun(2000);
    
    /*-------------------------------Test Step 7--------------------------------------*/ 
    /*-----------------------------ACTION: Security unlock Level 9----------------------------------------*/
    ACTION("Checking whether a valid Seed [non-zero, non-FF] for Security Level 09 is recieved or not");
    Security_Unlock_With_Key_lvl_9_Phy();
    
    testWaitForTimeout(2000);
    
    /*-------------------------------Test Step 8--------------------------------------*/ 
    /*-----------------------------ACTION: Reading DID which support Security level 9 --------------------*/
    STEP();
    ACTION("Read DID F0A7 ");                                                    //Read DID which support Security level 9 refer DID PDT
    send_on_CAN(0x03,0x22,0xF0,0xA7,0x55,0x55,0x55,0x55);                         
    testWaitForTimeout(200);
    Expect(0x04,0x62,0xF0,0xA7,0x00,0xAA,0xAA,0xAA);
    EXPECTED_DATA("",E_Resp,0X08);
    OBSERVED_DATA("",O_Resp,0X08);
    Check(E_Resp,O_Resp);  
    Clear_Buffer();   

    testWaitForTimeout(1000);
    
    /*-------------------------------Test Step 9--------------------------------------*/ 
    /*-----------------------------ACTION: Security unlock Level 3----------------------------------------*/   
      Security_Unlock_Seed_lvl_03_Phy();
      testWaitForTimeout(500);
    
      STEP();
      ACTION("Unlock Security Level 3 with Invalid key"); //Unlock Security Level 3 with Invalid key
      send_on_CAN(0x10,0x0E,0x27,0x04,0x00,0x00,0x00,0x00);
      testWaitForTimeout(50);
      send_on_CAN(0x21,0x00,0x00,0x00,0x00,0x00,0x00,0x00);
      testWaitForTimeout(50);
      send_on_CAN(0x22,0x00,0x00,0xAA,0xAA,0xAA,0xAA,0xAA);     
      testWaitForTimeout(200);
      Expect(0x03,0x7F,0x27,0x35,0xAA,0xAA,0xAA,0xAA);
      testWaitForTimeout(50);
      EXPECTED_DATA("",E_Resp,8);
      OBSERVED_DATA("",O_Resp,8);
      Check(E_Resp,O_Resp);  
      Clear_Buffer(); 
    
      testWaitForTimeout(1000);
    
    /*-------------------------------Test Step 10--------------------------------------*/ 
    /*-----------------------------ACTION: Write RID 21E ------------------------------------------------*/
    
    STEP();
    ACTION("Writing RID 21E"); //Writing RID 21E                                    
    send_on_CAN(0x04,0x31,0x01,0x02,0x1E,0x00,0x00,0x00);
    testWaitForTimeout(100);
    Expect(0x03,0x7F,0x31,0x33,0xAA,0xAA,0xAA,0xAA);
    EXPECTED_DATA("",E_Resp,8);
    OBSERVED_DATA("",O_Resp,8);
    Check(E_Resp,O_Resp);  
    Clear_Buffer();   
    
    
    testWaitForTimeout(500);   
    
    /*-------------------------------Test Step 11--------------------------------------*/ 
    /*-----------------------------ACTION: Security unlock Level 3----------------------------------------*/
    ACTION("Checking whether a valid Seed [non-zero, non-FF] for Security Level 03 is recieved or not");
    Security_Unlock_With_Key_lvl_3_Phy();
    
    testWaitForTimeout(5000);    
   
    /*-------------------------------Test Step 12--------------------------------------*/ 
    /*-----------------------------ACTION: Setting ECU to Normal mode -----------------------------------*/
    
    Back_To_Normal(); 
  }
  
testcase TC20_PGS_153654()
  {
    /*-------------------------------Test Step 1--------------------------------------*/ 
    /*-----------------------------ACTION: set Battery voltage to 12v -----------------------------------*/
   
    Set_Bat_Vol(12);
    
    /*-------------------------------Test Step 2--------------------------------------*/ 
    /*-----------------------------ACTION: Read MEC -----------------------------------------*/   
    
    Read_MEC();
    
    /*-------------------------------Test Step 3--------------------------------------*/ 
    /*-----------------------------ACTION: Set powermode to OFF -----------------------------------------*/
    @IgnitionSwitch=0;
    Read_PowerMode();
    
    /*-------------------------------Test Step 4--------------------------------------*/ 
    /*-----------------------------ACTION: Enter Default Session ----------------------------------------*/
    Default_Session_Phy();
    
    /*-------------------------------Test Step 5--------------------------------------*/ 
    /*-----------------------------ACTION: Enter Extended Session ---------------------------------------*/
    Extended_Session_Phy();
    
    /*-------------------------------Test Step 6--------------------------------------*/ 
    /*-----------------------------ACTION: Activating Tester Present for every 2sec----------------------*/
   
    Tester_Present_Per_Start_Fun(2000);
    
    /*-------------------------------Test Step 7--------------------------------------*/ 
    /*-----------------------------ACTION: Security unlock Level 1----------------------------------------*/
    ACTION("Checking whether a valid Seed [non-zero, non-FF] for Security Level 01 is recieved or not");
    Security_Unlock_With_Key_lvl_1_Phy();
    
    testWaitForTimeout(4000);
    
    /*-------------------------------Test Step 8--------------------------------------*/ 
    /*-----------------------------ACTION: Write RID 21E ----------------------------------------*/
    Write_RID_21E();   //InitialRefalshFlag
    
    /*-------------------------------Test Step 9--------------------------------------*/ 
    /*-----------------------------ACTION: Enter Default Session ----------------------------------------*/
    Default_Session_Phy();
    
    /*-------------------------------Test Step 10--------------------------------------*/ 
    /*-----------------------------ACTION: Enter Extended Session ---------------------------------------*/
    Extended_Session_Phy();
    
    /*-------------------------------Test Step 11--------------------------------------*/ 
    /*-----------------------------ACTION: Security unlock Level 3----------------------------------------*/
    ACTION("Checking whether a valid Seed [non-zero, non-FF] for Security Level 03 is recieved or not");
    Security_Unlock_With_Key_lvl_3_Phy();
    
    testWaitForTimeout(2000);
    
    /*-------------------------------Test Step 12--------------------------------------*/ 
    /*-----------------------------ACTION: Write RID 21E ----------------------------------------*/
    Write_RID_21E();   //InitialRefalshFlag
    
        /*-------------------------------Test Step 13--------------------------------------*/ 
    /*-----------------------------ACTION: Enter Default Session ----------------------------------------*/
    Default_Session_Phy();
    
    /*-------------------------------Test Step 14--------------------------------------*/ 
    /*-----------------------------ACTION: Enter Extended Session ---------------------------------------*/
    Extended_Session_Phy();
    
    /*-------------------------------Test Step 15--------------------------------------*/ 
    /*-----------------------------ACTION: Security unlock Level 5----------------------------------------*/
    ACTION("Checking whether a valid Seed [non-zero, non-FF] for Security Level 05 is recieved or not");
    Security_Unlock_With_Key_lvl_5_Phy();
    
    testWaitForTimeout(2000);
    
    /*-------------------------------Test Step 16--------------------------------------*/ 
    /*-----------------------------ACTION: Write RID 21E ----------------------------------------*/
    Write_RID_21E();   //InitialRefalshFlag
    
    /*-------------------------------Test Step 17--------------------------------------*/ 
    /*-----------------------------ACTION: Setting ECU to Normal mode -----------------------------------*/
    Back_To_Normal(); 
  }
  
testcase TC21_PGS_153677()
  {
    /*-------------------------------Test Step 1--------------------------------------*/ 
    /*-----------------------------ACTION: set Battery voltage to 12v -----------------------------------*/
   
    Set_Bat_Vol(12);
    
    /*-------------------------------Test Step 2--------------------------------------*/ 
    /*-----------------------------ACTION: Read MEC -----------------------------------------*/   
    
    Read_MEC();
    
    /*-------------------------------Test Step 3--------------------------------------*/ 
    /*-----------------------------ACTION: Set powermode to OFF -----------------------------------------*/
    @IgnitionSwitch=0;
    Read_PowerMode();
    
    /*-------------------------------Test Step 4--------------------------------------*/ 
    /*-----------------------------ACTION: Enter Default Session ----------------------------------------*/
    Default_Session_Phy();
    
    /*-------------------------------Test Step 5--------------------------------------*/ 
    /*-----------------------------ACTION: Enter Extended Session ---------------------------------------*/
    Extended_Session_Phy();
    
    /*-------------------------------Test Step 6--------------------------------------*/ 
    /*-----------------------------ACTION: Activating Tester Present for every 2sec----------------------*/
   
    Tester_Present_Per_Start_Fun(2000);
    
    /*-------------------------------Test Step 7--------------------------------------*/ 
    /*-----------------------------ACTION: Security unlock Level 9----------------------------------------*/
    ACTION("Checking whether a valid Seed [non-zero, non-FF] for Security Level 09 is recieved or not");
    Security_Unlock_With_Key_lvl_9_Phy();
    
    testWaitForTimeout(2000);
    
    /*-------------------------------Test Step 8--------------------------------------*/ 
    /*-----------------------------ACTION: Write RID 21E ----------------------------------------*/
    STEP();
    ACTION("Writing RID 21E"); //Writing RID 21E                                    
    send_on_CAN(0x04,0x31,0x01,0x02,0x1E,0x00,0x00,0x00);
    testWaitForTimeout(100);
    Expect(0x03,0x7F,0x31,0x33,0xAA,0xAA,0xAA,0xAA);
    EXPECTED_DATA("",E_Resp,8);
    OBSERVED_DATA("",O_Resp,8);
    Check(E_Resp,O_Resp);  
    Clear_Buffer();   
    
    
    testWaitForTimeout(500);
  
    /*-------------------------------Test Step 9--------------------------------------*/ 
    /*-----------------------------ACTION: Security unlock Level 0B----------------------------------------*/
    ACTION("Checking whether a valid Seed [non-zero, non-FF] for Security Level 0B is recieved or not");
    Security_Unlock_With_Key_lvl_0B_Phy();
    
    testWaitForTimeout(4000);
    
    /*-------------------------------Test Step 10--------------------------------------*/ 
    /*-----------------------------ACTION: Write RID 21E ----------------------------------------*/
    STEP();
    ACTION("Writing RID 21E"); //Writing RID 21E                                    
    send_on_CAN(0x04,0x31,0x01,0x02,0x1E,0x00,0x00,0x00);
    testWaitForTimeout(100);
    Expect(0x03,0x7F,0x31,0x33,0xAA,0xAA,0xAA,0xAA);
    EXPECTED_DATA("",E_Resp,8);
    OBSERVED_DATA("",O_Resp,8);
    Check(E_Resp,O_Resp);  
    Clear_Buffer();   
    
    
    testWaitForTimeout(500);
    
    /*-------------------------------Test Step 11--------------------------------------*/ 
    /*-----------------------------ACTION: Security unlock Level 0D----------------------------------------*/
    ACTION("Checking whether a valid Seed [non-zero, non-FF] for Security Level 0D is recieved or not");
    Security_Unlock_With_Key_lvl_0D_Phy();
    
    testWaitForTimeout(4000);
    
    /*-------------------------------Test Step 12--------------------------------------*/ 
    /*-----------------------------ACTION: Write RID 21E ----------------------------------------*/
    STEP();
    ACTION("Writing RID 21E"); //Writing RID 21E                                    
    send_on_CAN(0x04,0x31,0x01,0x02,0x1E,0x00,0x00,0x00);
    testWaitForTimeout(100);
    Expect(0x03,0x7F,0x31,0x33,0xAA,0xAA,0xAA,0xAA);
    EXPECTED_DATA("",E_Resp,8);
    OBSERVED_DATA("",O_Resp,8);
    Check(E_Resp,O_Resp);  
    Clear_Buffer();   
    
    
    testWaitForTimeout(500);
    
    /*-------------------------------Test Step 13--------------------------------------*/ 
    /*-----------------------------ACTION: Security unlock Level 11----------------------------------------*/
    ACTION("Checking whether a valid Seed [non-zero, non-FF] for Security Level 11 is recieved or not");
    Security_Unlock_With_Key_lvl_11_Phy();
    
    testWaitForTimeout(4000);
    
    /*-------------------------------Test Step 14--------------------------------------*/ 
    /*-----------------------------ACTION: Write RID 21E ----------------------------------------*/
    STEP();
    ACTION("Writing RID 21E"); //Writing RID 21E                                    
    send_on_CAN(0x04,0x31,0x01,0x02,0x1E,0x00,0x00,0x00);
    testWaitForTimeout(100);
    Expect(0x03,0x7F,0x31,0x33,0xAA,0xAA,0xAA,0xAA);
    EXPECTED_DATA("",E_Resp,8);
    OBSERVED_DATA("",O_Resp,8);
    Check(E_Resp,O_Resp);  
    Clear_Buffer();   
    
    
    testWaitForTimeout(500);
    
    /*-------------------------------Test Step 15--------------------------------------*/ 
    /*-----------------------------ACTION: Security unlock Level 13----------------------------------------*/
    ACTION("Checking whether a valid Seed [non-zero, non-FF] for Security Level 13 is recieved or not");
    Security_Unlock_With_Key_lvl_13_Phy();
    
    testWaitForTimeout(4000);
    
    /*-------------------------------Test Step 16--------------------------------------*/ 
    /*-----------------------------ACTION: Write RID 21E ----------------------------------------*/
    STEP();
    ACTION("Writing RID 21E"); //Writing RID 21E                                    
    send_on_CAN(0x04,0x31,0x01,0x02,0x1E,0x00,0x00,0x00);
    testWaitForTimeout(100);
    Expect(0x03,0x7F,0x31,0x33,0xAA,0xAA,0xAA,0xAA);
    EXPECTED_DATA("",E_Resp,8);
    OBSERVED_DATA("",O_Resp,8);
    Check(E_Resp,O_Resp);  
    Clear_Buffer();   
    
    
    testWaitForTimeout(500);
    
    /*-------------------------------Test Step 17--------------------------------------*/ 
    /*-----------------------------ACTION: Security unlock Level 15----------------------------------------*/
    ACTION("Checking whether a valid Seed [non-zero, non-FF] for Security Level 15 is recieved or not");
    Security_Unlock_With_Key_lvl_15_Phy();
    
    testWaitForTimeout(4000);
    
    /*-------------------------------Test Step 18--------------------------------------*/ 
    /*-----------------------------ACTION: Write RID 21E ----------------------------------------*/
    STEP();
    ACTION("Writing RID 21E"); //Writing RID 21E                                    
    send_on_CAN(0x04,0x31,0x01,0x02,0x1E,0x00,0x00,0x00);
    testWaitForTimeout(100);
    Expect(0x03,0x7F,0x31,0x33,0xAA,0xAA,0xAA,0xAA);
    EXPECTED_DATA("",E_Resp,8);
    OBSERVED_DATA("",O_Resp,8);
    Check(E_Resp,O_Resp);  
    Clear_Buffer();   
    
    
    testWaitForTimeout(500);
    
    /*-------------------------------Test Step 19--------------------------------------*/ 
    /*-----------------------------ACTION: Setting ECU to Normal mode -----------------------------------*/
    Back_To_Normal(); 
    
  }

  testcase TC22_PGS_154714()
  {

    /*-------------------------------Test Step 1--------------------------------------*/ 
    /*-----------------------------ACTION: set Battery voltage to 12v -----------------------------------*/
   
    Set_Bat_Vol(12);
    
    /*-------------------------------Test Step 2--------------------------------------*/ 
    /*-----------------------------ACTION: Read MEC -----------------------------------------*/   
    
    Read_MEC();
    
    /*-------------------------------Test Step 3--------------------------------------*/ 
    /*-----------------------------ACTION: Set powermode to OFF -----------------------------------------*/
    @IgnitionSwitch=0;
    testWaitForTimeout(100);
    Read_PowerMode();
    
    /*-------------------------------Test Step 4--------------------------------------*/ 
    /*-----------------------------ACTION: Enter Default Session ----------------------------------------*/
    Default_Session_Phy();
    
    /*-------------------------------Test Step 3--------------------------------------*/ 
    /*-----------------------------ACTION: Set powermode to RUN -----------------------------------------*/
    testWaitForTimeout(100);
    Read_PowerMode();
    
    /*-------------------------------Test Step 5--------------------------------------*/ 
    /*-----------------------------ACTION: Activating Tester Present for every 2sec----------------------*/
   
    Tester_Present_Per_Start_Fun(2000);
    
    /*-------------------------------Test Step 5--------------------------------------*/ 
    /*-----------------------------ACTION: Enter Extended Session ---------------------------------------*/
    Extended_Session_Phy();
    
    /*-------------------------------Test Step 6--------------------------------------*/ 
    /*-----------------------------ACTION: Security unlock Level 3----------------------------------------*/
    ACTION("Checking whether a valid Seed [non-zero, non-FF] for Security Level 03 is recieved or not");
    Security_Unlock_With_Key_lvl_3_Phy();
    
    testWaitForTimeout(5000);
    
    /*-------------------------------Test Step 18--------------------------------------*/ 
    /*-----------------------------ACTION: Write RID 21E ----------------------------------------*/
    STEP();
    ACTION("Writing RID 21E"); //Writing RID 21E                                    
    send_on_CAN(0x04,0x31,0x01,0x02,0x1E,0x00,0x00,0x00);
    testWaitForTimeout(100);
    Expect(0x03,0x7F,0x31,0x22,0xAA,0xAA,0xAA,0xAA);
    EXPECTED_DATA("",E_Resp,8);
    OBSERVED_DATA("",O_Resp,8);
    Check(E_Resp,O_Resp);  
    Clear_Buffer();   
    
    /*-------------------------------Test Step 3--------------------------------------*/ 
    /*-----------------------------ACTION: Set powermode to ACC -----------------------------------------*/
    @IgnitionSwitch=1;
    testWaitForTimeout(100);
    Read_PowerMode();
    
    testWaitForTimeout(500);
    
    /*-------------------------------Test Step 6--------------------------------------*/ 
    /*-----------------------------ACTION: Security unlock Level 1----------------------------------------*/
    ACTION("Checking whether a valid Seed [non-zero, non-FF] for Security Level 01 is recieved or not");
    Security_Unlock_With_Key_lvl_1_Phy();
    
    testWaitForTimeout(5000);
    
    /*-------------------------------Test Step 18--------------------------------------*/ 
    /*-----------------------------ACTION: Write RID 21E ----------------------------------------*/
    STEP();
    ACTION("Writing RID 21E"); //Writing RID 21E                                    
    send_on_CAN(0x04,0x31,0x01,0x02,0x1E,0x00,0x00,0x00);
    testWaitForTimeout(100);
    Expect(0x03,0x7F,0x31,0x22,0xAA,0xAA,0xAA,0xAA);
    EXPECTED_DATA("",E_Resp,8);
    OBSERVED_DATA("",O_Resp,8);
    Check(E_Resp,O_Resp);  
    Clear_Buffer(); 
    
    /*-------------------------------Test Step 3--------------------------------------*/ 
    /*-----------------------------ACTION: Set powermode to START -----------------------------------------*/
    @IgnitionSwitch=3;
    testWaitForTimeout(100);
    Read_PowerMode();
    
    testWaitForTimeout(500);
    
    /*-------------------------------Test Step 6--------------------------------------*/ 
    /*-----------------------------ACTION: Security unlock Level 5----------------------------------------*/
    ACTION("Checking whether a valid Seed [non-zero, non-FF] for Security Level 05 is recieved or not");
    Security_Unlock_With_Key_lvl_5_Phy();
    
    testWaitForTimeout(5000);
    
    /*-------------------------------Test Step 18--------------------------------------*/ 
    /*-----------------------------ACTION: Write RID 21E ----------------------------------------*/
    STEP();
    ACTION("Writing RID 21E"); //Writing RID 21E                                    
    send_on_CAN(0x04,0x31,0x01,0x02,0x1E,0x00,0x00,0x00);
    testWaitForTimeout(100);
    Expect(0x03,0x7F,0x31,0x22,0xAA,0xAA,0xAA,0xAA);
    EXPECTED_DATA("",E_Resp,8);
    OBSERVED_DATA("",O_Resp,8);
    Check(E_Resp,O_Resp);  
    Clear_Buffer(); 
    
    /*-------------------------------Test Step 3--------------------------------------*/ 
    /*-----------------------------ACTION: Set powermode to PROP -----------------------------------------*/
    @IgnitionSwitch=4;
    testWaitForTimeout(100);
    Read_PowerMode();
    
    testWaitForTimeout(500);
    
    /*-------------------------------Test Step 6--------------------------------------*/ 
    /*-----------------------------ACTION: Security unlock Level 3----------------------------------------*/
    ACTION("Checking whether a valid Seed [non-zero, non-FF] for Security Level 03 is recieved or not");
    Security_Unlock_With_Key_lvl_3_Phy();
    
    testWaitForTimeout(5000);
    
    /*-------------------------------Test Step 18--------------------------------------*/ 
    /*-----------------------------ACTION: Write RID 21E ----------------------------------------*/
    STEP();
    ACTION("Writing RID 21E"); //Writing RID 21E                                    
    send_on_CAN(0x04,0x31,0x01,0x02,0x1E,0x00,0x00,0x00);
    testWaitForTimeout(100);
    Expect(0x03,0x7F,0x31,0x22,0xAA,0xAA,0xAA,0xAA);
    EXPECTED_DATA("",E_Resp,8);
    OBSERVED_DATA("",O_Resp,8);
    Check(E_Resp,O_Resp);  
    Clear_Buffer(); 
    
    /*-------------------------------Test Step 3--------------------------------------*/ 
    /*-----------------------------ACTION: Set powermode to OFF -----------------------------------------*/
    @IgnitionSwitch=0;
    testWaitForTimeout(100);
    Read_PowerMode();
    
    testWaitForTimeout(500);
    
    /*-------------------------------Test Step 6--------------------------------------*/ 
    /*-----------------------------ACTION: Security unlock Level 5----------------------------------------*/
    ACTION("Checking whether a valid Seed [non-zero, non-FF] for Security Level 05 is recieved or not");
    Security_Unlock_With_Key_lvl_5_Phy();
    
    testWaitForTimeout(5000);
    
    /*-------------------------------Test Step 18--------------------------------------*/ 
    /*-----------------------------ACTION: Write RID 21E ----------------------------------------*/
    
    Write_RID_21E();
    
    testWaitForTimeout(500);
    
    /*-------------------------------Test Step 19--------------------------------------*/ 
    /*-----------------------------ACTION: Setting ECU to Normal mode -----------------------------------*/
    Back_To_Normal(); 
    
  }
  
  testcase TC23_PGS_154816()
  {
    char logPath[256] = "C:\\Users\\GID_GMSDV_ITV\\Documents\\ECU_Unlock_logs\\Autoamtion\\PGS_154816.asc"; // Change this to your desired path
    setLogFileName("Test Logs",logPath);
    startLogging("Test Logs");
    
    /*-------------------------------Test Step 1--------------------------------------*/ 
    /*-----------------------------ACTION: set Battery voltage to 12v -----------------------------------*/
   
    Set_Bat_Vol(12);
    
    /*-------------------------------Test Step 2--------------------------------------*/ 
    /*-----------------------------ACTION: Read MEC -----------------------------------------*/   
    
    Read_MEC();
    
    /*-------------------------------Test Step 3--------------------------------------*/ 
    /*-----------------------------ACTION: Set powermode to OFF -----------------------------------------*/
    @IgnitionSwitch=0;
    testWaitForTimeout(50);
    Read_PowerMode();
    
    /*-------------------------------Test Step 4--------------------------------------*/ 
    /*-----------------------------ACTION: Enter Default Session ----------------------------------------*/
    Default_Session_Phy();
    
    /*-------------------------------Test Step 5--------------------------------------*/ 
    /*-----------------------------ACTION: Enter Extended Session ---------------------------------------*/
    Extended_Session_Phy();
    
    /*-------------------------------Test Step 6--------------------------------------*/ 
    /*-----------------------------ACTION: Activating Tester Present for every 2sec----------------------*/
   
    Tester_Present_Per_Start_Fun(2000);
    
    /*-------------------------------Test Step 7--------------------------------------*/ 
    /*-----------------------------ACTION: Security unlock Level 11----------------------------------------*/
    ACTION("Checking whether a valid Seed [non-zero, non-FF] for Security Level 11 is recieved or not");
    Security_Unlock_With_Key_lvl_11_Phy();
    
    testWaitForTimeout(3000);
    
    /*-------------------------------Test Step 8--------------------------------------*/ 
    /*-----------------------------ACTION: Security unlock Level 13----------------------------------------*/
    ACTION("Checking whether a valid Seed [non-zero, non-FF] for Security Level 13 is recieved or not");
    Security_Unlock_With_Key_lvl_13_Phy();
    
    testWaitForTimeout(2000);
    
    /*-------------------------------Test Step 9--------------------------------------*/ 
    /*-----------------------------ACTION: Security unlock Level 15----------------------------------------*/
    ACTION("Checking whether a valid Seed [non-zero, non-FF] for Security Level 15 is recieved or not");
    Security_Unlock_With_Key_lvl_15_Phy();
    
    testWaitForTimeout(2000);
    
    /*-------------------------------Test Step 19--------------------------------------*/ 
    /*-----------------------------ACTION: Setting ECU to Normal mode -----------------------------------*/
    Back_To_Normal(); 
    
    stopLogging("Test Logs");
  }
  
  testcase TC24_PGS_154825()
  {
    char logPath[256] = "C:\\Users\\GID_GMSDV_ITV\\Documents\\ECU_Unlock_logs\\Autoamtion\\PGS_154825.asc"; // Change this to your desired path
    setLogFileName("Test Logs",logPath);
    startLogging("Test Logs");
    
    /*-------------------------------Test Step 1--------------------------------------*/ 
    /*-----------------------------ACTION: set Battery voltage to 12v -----------------------------------*/
   
    Set_Bat_Vol(12);
    
    /*-------------------------------Test Step 2--------------------------------------*/ 
    /*-----------------------------ACTION: Read MEC -----------------------------------------*/   
    
    Read_MEC();
    
   
    /*-------------------------------Test Step 3--------------------------------------*/ 
    /*-----------------------------ACTION: Enter Default Session ----------------------------------------*/
    Default_Session_Phy();
    
    /*-------------------------------Test Step 4--------------------------------------*/ 
    /*-----------------------------ACTION: Enter Extended Session ---------------------------------------*/
    Extended_Session_Phy();
    
    /*-------------------------------Test Step 5--------------------------------------*/ 
    /*-----------------------------ACTION: Set powermode to ACC -----------------------------------------*/
    Action("Change power mode to ACC");
    @IgnitionSwitch=1;
    testWaitForTimeout(250);
    Read_PowerMode();
    
    /*-------------------------------Test Step 6--------------------------------------*/ 
    /*-----------------------------ACTION: Activating Tester Present for every 2sec----------------------*/
   
    Tester_Present_Per_Start_Fun(2000);
    
    /*-------------------------------Test Step 7--------------------------------------*/ 
    /*-----------------------------ACTION: Security unlock Level 11----------------------------------------*/
    STEP();
    ACTION("Security unlock seed 11"); //Security unlock seed 11
    send_on_CAN(0x02,0x27,0x11,0x55,0x55,0x55,0x55,0x55);
    testWaitForTimeout(100);
                Expect1(0x03,0x7F,0x27,0x22,0xAA,0xAA,0xAA,0xAA);
                EXPECTED_DATA("",E_Resp,8);
                OBSERVED_DATA("",O_Resp,8);
                Check(E_Resp,O_Resp);
                Clear_Buffer();
    testWaitForTimeout(2000);
    
    /*-------------------------------Test Step 8--------------------------------------*/ 
    /*-----------------------------ACTION: Security unlock Level 13----------------------------------------*/
    STEP();
    ACTION("Security unlock seed 13"); //Security unlock seed 13
    send_on_CAN(0x02,0x27,0x13,0x55,0x55,0x55,0x55,0x55);
    testWaitForTimeout(100);
                Expect1(0x03,0x7F,0x27,0x22,0xAA,0xAA,0xAA,0xAA);
                EXPECTED_DATA("",E_Resp,8);
                OBSERVED_DATA("",O_Resp,8);
                Check(E_Resp,O_Resp);
                Clear_Buffer();
    testWaitForTimeout(2000);
    
    /*-------------------------------Test Step 9--------------------------------------*/ 
    /*-----------------------------ACTION: Security unlock Level 15----------------------------------------*/
    STEP();
    ACTION("Security unlock seed 15"); //Security unlock seed 15
    send_on_CAN(0x02,0x27,0x15,0x55,0x55,0x55,0x55,0x55);
    testWaitForTimeout(100);
                Expect1(0x03,0x7F,0x27,0x22,0xAA,0xAA,0xAA,0xAA);
                EXPECTED_DATA("",E_Resp,8);
                OBSERVED_DATA("",O_Resp,8);
                Check(E_Resp,O_Resp);
                Clear_Buffer();
    testWaitForTimeout(2000);
    
    /*-------------------------------Test Step 3--------------------------------------*/ 
    /*-----------------------------ACTION: Set powermode to RUN -----------------------------------------*/
    Action("Change power mode to RUN");
    @IgnitionSwitch=2;
    testWaitForTimeout(250);
    Read_PowerMode();
    
    /*-------------------------------Test Step 7--------------------------------------*/ 
    /*-----------------------------ACTION: Security unlock Level 11----------------------------------------*/
    STEP();
    ACTION("Security unlock seed 11"); //Security unlock seed 11
    send_on_CAN(0x02,0x27,0x11,0x55,0x55,0x55,0x55,0x55);
    testWaitForTimeout(100);
                Expect1(0x03,0x7F,0x27,0x22,0xAA,0xAA,0xAA,0xAA);
                EXPECTED_DATA("",E_Resp,8);
                OBSERVED_DATA("",O_Resp,8);
                Check(E_Resp,O_Resp);
                Clear_Buffer();
    testWaitForTimeout(2000);
    
    /*-------------------------------Test Step 8--------------------------------------*/ 
    /*-----------------------------ACTION: Security unlock Level 13----------------------------------------*/
    STEP();
    ACTION("Security unlock seed 13"); //Security unlock seed 13
    send_on_CAN(0x02,0x27,0x13,0x55,0x55,0x55,0x55,0x55);
    testWaitForTimeout(100);
                Expect1(0x03,0x7F,0x27,0x22,0xAA,0xAA,0xAA,0xAA);
                EXPECTED_DATA("",E_Resp,8);
                OBSERVED_DATA("",O_Resp,8);
                Check(E_Resp,O_Resp);
                Clear_Buffer();
    testWaitForTimeout(2000);
    
    /*-------------------------------Test Step 9--------------------------------------*/ 
    /*-----------------------------ACTION: Security unlock Level 15----------------------------------------*/
    STEP();
    ACTION("Security unlock seed 15"); //Security unlock seed 15
    send_on_CAN(0x02,0x27,0x15,0x55,0x55,0x55,0x55,0x55);
    testWaitForTimeout(100);
                Expect1(0x03,0x7F,0x27,0x22,0xAA,0xAA,0xAA,0xAA);
                EXPECTED_DATA("",E_Resp,8);
                OBSERVED_DATA("",O_Resp,8);
                Check(E_Resp,O_Resp);
                Clear_Buffer();
    testWaitForTimeout(2000);
    
    /*-------------------------------Test Step 3--------------------------------------*/ 
    /*-----------------------------ACTION: Set powermode to START -----------------------------------------*/
    Action("Change power mode to START");
    @IgnitionSwitch=3;
    testWaitForTimeout(250);
    Read_PowerMode();
    
    /*-------------------------------Test Step 7--------------------------------------*/ 
    /*-----------------------------ACTION: Security unlock Level 11----------------------------------------*/
    STEP();
    ACTION("Security unlock seed 11"); //Security unlock seed 11
    send_on_CAN(0x02,0x27,0x11,0x55,0x55,0x55,0x55,0x55);
    testWaitForTimeout(100);
                Expect1(0x03,0x7F,0x27,0x22,0xAA,0xAA,0xAA,0xAA);
                EXPECTED_DATA("",E_Resp,8);
                OBSERVED_DATA("",O_Resp,8);
                Check(E_Resp,O_Resp);
                Clear_Buffer();
    testWaitForTimeout(2000);
    
    /*-------------------------------Test Step 8--------------------------------------*/ 
    /*-----------------------------ACTION: Security unlock Level 13----------------------------------------*/
    STEP();
    ACTION("Security unlock seed 13"); //Security unlock seed 13
    send_on_CAN(0x02,0x27,0x13,0x55,0x55,0x55,0x55,0x55);
    testWaitForTimeout(100);
                Expect1(0x03,0x7F,0x27,0x22,0xAA,0xAA,0xAA,0xAA);
                EXPECTED_DATA("",E_Resp,8);
                OBSERVED_DATA("",O_Resp,8);
                Check(E_Resp,O_Resp);
                Clear_Buffer();
    testWaitForTimeout(2000);
    
    /*-------------------------------Test Step 9--------------------------------------*/ 
    /*-----------------------------ACTION: Security unlock Level 15----------------------------------------*/
    STEP();
    ACTION("Security unlock seed 15"); //Security unlock seed 15
    send_on_CAN(0x02,0x27,0x15,0x55,0x55,0x55,0x55,0x55);
    testWaitForTimeout(100);
                Expect1(0x03,0x7F,0x27,0x22,0xAA,0xAA,0xAA,0xAA);
                EXPECTED_DATA("",E_Resp,8);
                OBSERVED_DATA("",O_Resp,8);
                Check(E_Resp,O_Resp);
                Clear_Buffer();
    testWaitForTimeout(2000);
    
    /*-------------------------------Test Step 3--------------------------------------*/ 
    /*-----------------------------ACTION: Set powermode to PROP -----------------------------------------*/
    Action("Change power mode to PROP");
    @IgnitionSwitch=4;
    testWaitForTimeout(250);
    Read_PowerMode();
    
    /*-------------------------------Test Step 7--------------------------------------*/ 
    /*-----------------------------ACTION: Security unlock Level 11----------------------------------------*/
    STEP();
    ACTION("Security unlock seed 11"); //Security unlock seed 11
    send_on_CAN(0x02,0x27,0x11,0x55,0x55,0x55,0x55,0x55);
    testWaitForTimeout(100);
                Expect1(0x03,0x7F,0x27,0x22,0xAA,0xAA,0xAA,0xAA);
                EXPECTED_DATA("",E_Resp,8);
                OBSERVED_DATA("",O_Resp,8);
                Check(E_Resp,O_Resp);
                Clear_Buffer();
    testWaitForTimeout(2000);
    
    /*-------------------------------Test Step 8--------------------------------------*/ 
    /*-----------------------------ACTION: Security unlock Level 13----------------------------------------*/
    STEP();
    ACTION("Security unlock seed 13"); //Security unlock seed 13
    send_on_CAN(0x02,0x27,0x13,0x55,0x55,0x55,0x55,0x55);
    testWaitForTimeout(100);
                Expect1(0x03,0x7F,0x27,0x22,0xAA,0xAA,0xAA,0xAA);
                EXPECTED_DATA("",E_Resp,8);
                OBSERVED_DATA("",O_Resp,8);
                Check(E_Resp,O_Resp);
                Clear_Buffer();
    testWaitForTimeout(2000);
    
    /*-------------------------------Test Step 9--------------------------------------*/ 
    /*-----------------------------ACTION: Security unlock Level 15----------------------------------------*/
    STEP();
    ACTION("Security unlock seed 15"); //Security unlock seed 15
    send_on_CAN(0x02,0x27,0x15,0x55,0x55,0x55,0x55,0x55);
    testWaitForTimeout(100);
                Expect1(0x03,0x7F,0x27,0x22,0xAA,0xAA,0xAA,0xAA);
                EXPECTED_DATA("",E_Resp,8);
                OBSERVED_DATA("",O_Resp,8);
                Check(E_Resp,O_Resp);
                Clear_Buffer();
    testWaitForTimeout(2000);
    
    /*-------------------------------Test Step 19--------------------------------------*/ 
    /*-----------------------------ACTION: Setting ECU to Normal mode -----------------------------------*/
    Back_To_Normal(); 
    
    stopLogging("Test Logs");
  }
  
testcase TC25_PGS_153729()
  {
    char logPath[256] = "C:\\Users\\GID_GMSDV_ITV\\Documents\\ECU_Unlock_logs\\Autoamtion\\PGS_153729.asc"; // Change this to your desired path
    setLogFileName("PGS_153729",logPath);
    startLogging("PGS_153729");
    
    /*-------------------------------Test Step 1--------------------------------------*/ 
    /*-----------------------------ACTION: set Battery voltage to 12v -----------------------------------*/
   
    Set_Bat_Vol(12);
    
    /*-------------------------------Test Step 2--------------------------------------*/ 
    /*-----------------------------ACTION: Read MEC -----------------------------------------*/   
    
    Read_MEC();
    
    /*-------------------------------Test Step 3--------------------------------------*/ 
    /*-----------------------------ACTION: Set powermode to OFF -----------------------------------------*/
    Action("Change power mode to OFF");
    @IgnitionSwitch=0;
    testWaitForTimeout(250);
    Read_PowerMode();
    testWaitForTimeout(100);
    
    /*-------------------------------Test Step 4--------------------------------------*/ 
    /*-----------------------------ACTION: Enter Default Session ----------------------------------------*/
    Default_Session_Phy();
    
    /*-------------------------------Test Step 5--------------------------------------*/ 
    /*-----------------------------ACTION: Enter Extended Session ---------------------------------------*/
    Extended_Session_Phy();
    
    /*-------------------------------Test Step 6--------------------------------------*/ 
    /*-----------------------------ACTION: Activating Tester Present for every 2sec----------------------*/
   
    Tester_Present_Per_Start_Fun(2000);
    
    /*-------------------------------Test Step 7--------------------------------------*/ 
    /*-----------------------------ACTION: Security unlock Level 11----------------------------------------*/
    Description_DATA("Checking Security Level 11");
    Security_Unlock_Seed_lvl_11_Phy();
    
    /*-------------------------------Test Step 8--------------------------------------*/ 
    /*-----------------------------ACTION: Set powermode to ACC -----------------------------------------*/
    Action("Change power mode to ACC");
    @IgnitionSwitch=1;
    testWaitForTimeout(250);
    Read_PowerMode();
    testWaitForTimeout(100);
    
    /*-------------------------------Test Step 9--------------------------------------*/ 
    /*-----------------------------ACTION: Security unlock Level 11----------------------------------------*/
    STEP();
    ACTION("Sending Key to unlock security lvl 11"); 
    send_on_CAN(0x10,0x0E,0x27,0x12,0x00,0x00,0x00,0x00);
    testWaitForTimeout(50);
    send_on_CAN(0x21,0x00,0x00,0x00,0x00,0x00,0x00,0x00);
    testWaitForTimeout(50);
    send_on_CAN(0x22,0x00,0x00,0xAA,0xAA,0xAA,0xAA,0xAA);     
    testWaitForTimeout(200);
    Expect(0x03,0x7F,0x27,0x22,0xAA,0xAA,0xAA,0xAA);
    EXPECTED_DATA("",E_Resp,8);
    OBSERVED_DATA("",O_Resp,8);
    Check(E_Resp,O_Resp);
    Clear_Buffer();
    testWaitForTimeout(500);
    
    /*-------------------------------Test Step 10--------------------------------------*/ 
    /*-----------------------------ACTION: Set powermode to OFF -----------------------------------------*/
    Action("Change power mode to OFF");
    @IgnitionSwitch=0;
    testWaitForTimeout(250);
    Read_PowerMode();
    testWaitForTimeout(100);
    
    /*-------------------------------Test Step 11--------------------------------------*/ 
    /*-----------------------------ACTION: Security unlock Level 11----------------------------------------*/
    Security_Unlock_Seed_lvl_11_Phy();
    
    /*-------------------------------Test Step 12--------------------------------------*/ 
    /*-----------------------------ACTION: Set powermode to RUN -----------------------------------------*/
    Action("Change power mode to RUN");
    @IgnitionSwitch=2;
    testWaitForTimeout(250);
    Read_PowerMode();
    testWaitForTimeout(100);
    
    /*-------------------------------Test Step 13--------------------------------------*/ 
    /*-----------------------------ACTION: Security unlock Level 11----------------------------------------*/
    STEP();
    ACTION("Sending Key to unlock security lvl 11"); 
    send_on_CAN(0x10,0x0E,0x27,0x12,0x00,0x00,0x00,0x00);
    testWaitForTimeout(50);
    send_on_CAN(0x21,0x00,0x00,0x00,0x00,0x00,0x00,0x00);
    testWaitForTimeout(50);
    send_on_CAN(0x22,0x00,0x00,0xAA,0xAA,0xAA,0xAA,0xAA);     
    testWaitForTimeout(200);
    Expect(0x03,0x7F,0x27,0x22,0xAA,0xAA,0xAA,0xAA);
    EXPECTED_DATA("",E_Resp,8);
    OBSERVED_DATA("",O_Resp,8);
    Check(E_Resp,O_Resp);
    Clear_Buffer();
    testWaitForTimeout(500);
    
    /*-------------------------------Test Step 14--------------------------------------*/ 
    /*-----------------------------ACTION: Set powermode to OFF -----------------------------------------*/
    Action("Change power mode to OFF");
    @IgnitionSwitch=0;
    testWaitForTimeout(250);
    Read_PowerMode();
    testWaitForTimeout(100);
    
    /*-------------------------------Test Step 15--------------------------------------*/ 
    /*-----------------------------ACTION: Security unlock Level 11----------------------------------------*/
    Security_Unlock_Seed_lvl_11_Phy();
    
    /*-------------------------------Test Step 16--------------------------------------*/ 
    /*-----------------------------ACTION: Set powermode to START -----------------------------------------*/
    Action("Change power mode to START");
    @IgnitionSwitch=3;
    testWaitForTimeout(250);
    Read_PowerMode();
    testWaitForTimeout(100);
    
    /*-------------------------------Test Step 17--------------------------------------*/ 
    /*-----------------------------ACTION: Security unlock Level 11----------------------------------------*/
    STEP();
    ACTION("Sending Key to unlock security lvl 11"); 
    send_on_CAN(0x10,0x0E,0x27,0x12,0x00,0x00,0x00,0x00);
    testWaitForTimeout(50);
    send_on_CAN(0x21,0x00,0x00,0x00,0x00,0x00,0x00,0x00);
    testWaitForTimeout(50);
    send_on_CAN(0x22,0x00,0x00,0xAA,0xAA,0xAA,0xAA,0xAA);     
    testWaitForTimeout(200);
    Expect(0x03,0x7F,0x27,0x22,0xAA,0xAA,0xAA,0xAA);
    EXPECTED_DATA("",E_Resp,8);
    OBSERVED_DATA("",O_Resp,8);
    Check(E_Resp,O_Resp);
    Clear_Buffer();
    testWaitForTimeout(500);

    /*-------------------------------Test Step 18--------------------------------------*/ 
    /*-----------------------------ACTION: Set powermode to OFF -----------------------------------------*/
    Action("Change power mode to OFF");
    @IgnitionSwitch=0;
    testWaitForTimeout(250);
    Read_PowerMode();
    testWaitForTimeout(100);
    
    /*-------------------------------Test Step 19--------------------------------------*/ 
    /*-----------------------------ACTION: Security unlock Level 11----------------------------------------*/
    Security_Unlock_Seed_lvl_11_Phy();
    
    /*-------------------------------Test Step 20--------------------------------------*/ 
    /*-----------------------------ACTION: Set powermode to PROP -----------------------------------------*/
    Action("Change power mode to PROP");
    @IgnitionSwitch=4;
    testWaitForTimeout(250);
    Read_PowerMode();
    testWaitForTimeout(100);
    
    /*-------------------------------Test Step 21--------------------------------------*/ 
    /*-----------------------------ACTION: Security unlock Level 11----------------------------------------*/
    STEP();
    ACTION("Sending Key to unlock security lvl 11"); 
    send_on_CAN(0x10,0x0E,0x27,0x12,0x00,0x00,0x00,0x00);
    testWaitForTimeout(50);
    send_on_CAN(0x21,0x00,0x00,0x00,0x00,0x00,0x00,0x00);
    testWaitForTimeout(50);
    send_on_CAN(0x22,0x00,0x00,0xAA,0xAA,0xAA,0xAA,0xAA);     
    testWaitForTimeout(200);
    Expect(0x03,0x7F,0x27,0x22,0xAA,0xAA,0xAA,0xAA);
    EXPECTED_DATA("",E_Resp,8);
    OBSERVED_DATA("",O_Resp,8);
    Check(E_Resp,O_Resp);
    Clear_Buffer();
    testWaitForTimeout(500);
    
    /*-------------------------------Test Step 22--------------------------------------*/ 
    /*-----------------------------ACTION: Set powermode to OFF -----------------------------------------*/
    Action("Change power mode to OFF");
    @IgnitionSwitch=0;
    testWaitForTimeout(250);
    Read_PowerMode();
    testWaitForTimeout(100);
    
    /*-------------------------------Test Step 23--------------------------------------*/ 
    /*-----------------------------ACTION: Security unlock Level 13----------------------------------------*/
    Description_DATA("Checking Security Level 13");
    Security_Unlock_Seed_lvl_13_Phy();
    
    /*-------------------------------Test Step 24--------------------------------------*/ 
    /*-----------------------------ACTION: Set powermode to ACC -----------------------------------------*/
    Action("Change power mode to ACC");
    @IgnitionSwitch=1;
    testWaitForTimeout(250);
    Read_PowerMode();
    testWaitForTimeout(100);
    
    /*-------------------------------Test Step 25--------------------------------------*/ 
    /*-----------------------------ACTION: Security unlock Level 13----------------------------------------*/
    STEP();
    ACTION("Sending Key to unlock security lvl 13"); 
    send_on_CAN(0x10,0x0E,0x27,0x14,0x00,0x00,0x00,0x00);
    testWaitForTimeout(50);
    send_on_CAN(0x21,0x00,0x00,0x00,0x00,0x00,0x00,0x00);
    testWaitForTimeout(50);
    send_on_CAN(0x22,0x00,0x00,0xAA,0xAA,0xAA,0xAA,0xAA);     
    testWaitForTimeout(200);
    Expect(0x03,0x7F,0x27,0x22,0xAA,0xAA,0xAA,0xAA);
    EXPECTED_DATA("",E_Resp,8);
    OBSERVED_DATA("",O_Resp,8);
    Check(E_Resp,O_Resp);
    Clear_Buffer();
    testWaitForTimeout(500);
    
    /*-------------------------------Test Step 26--------------------------------------*/ 
    /*-----------------------------ACTION: Set powermode to OFF -----------------------------------------*/
    Action("Change power mode to OFF");
    @IgnitionSwitch=0;
    testWaitForTimeout(250);
    Read_PowerMode();
    testWaitForTimeout(100);
    
    /*-------------------------------Test Step 27--------------------------------------*/ 
    /*-----------------------------ACTION: Security unlock Level 13----------------------------------------*/
    Security_Unlock_Seed_lvl_13_Phy();
    
    /*-------------------------------Test Step 28--------------------------------------*/ 
    /*-----------------------------ACTION: Set powermode to RUN -----------------------------------------*/
    Action("Change power mode to RUN");
    @IgnitionSwitch=2;
    testWaitForTimeout(250);
    Read_PowerMode();
    testWaitForTimeout(100);
    
    /*-------------------------------Test Step 29--------------------------------------*/ 
    /*-----------------------------ACTION: Security unlock Level 13----------------------------------------*/
    STEP();
    ACTION("Sending Key to unlock security lvl 13"); 
    send_on_CAN(0x10,0x0E,0x27,0x14,0x00,0x00,0x00,0x00);
    testWaitForTimeout(50);
    send_on_CAN(0x21,0x00,0x00,0x00,0x00,0x00,0x00,0x00);
    testWaitForTimeout(50);
    send_on_CAN(0x22,0x00,0x00,0xAA,0xAA,0xAA,0xAA,0xAA);     
    testWaitForTimeout(200);
    Expect(0x03,0x7F,0x27,0x22,0xAA,0xAA,0xAA,0xAA);
    EXPECTED_DATA("",E_Resp,8);
    OBSERVED_DATA("",O_Resp,8);
    Check(E_Resp,O_Resp);
    Clear_Buffer();
    testWaitForTimeout(500);
    
    /*-------------------------------Test Step 30--------------------------------------*/ 
    /*-----------------------------ACTION: Set powermode to OFF -----------------------------------------*/
    Action("Change power mode to OFF");
    @IgnitionSwitch=0;
    testWaitForTimeout(250);
    Read_PowerMode();
    testWaitForTimeout(100);
    
    /*-------------------------------Test Step 31--------------------------------------*/ 
    /*-----------------------------ACTION: Security unlock Level 13----------------------------------------*/
    Security_Unlock_Seed_lvl_13_Phy();
    
    /*-------------------------------Test Step 32--------------------------------------*/ 
    /*-----------------------------ACTION: Set powermode to START -----------------------------------------*/
    Action("Change power mode to START");
    @IgnitionSwitch=3;
    testWaitForTimeout(250);
    Read_PowerMode();
    testWaitForTimeout(100);
    
    /*-------------------------------Test Step 33--------------------------------------*/ 
    /*-----------------------------ACTION: Security unlock Level 13----------------------------------------*/
    STEP();
    ACTION("Sending Key to unlock security lvl 13"); 
    send_on_CAN(0x10,0x0E,0x27,0x14,0x00,0x00,0x00,0x00);
    testWaitForTimeout(50);
    send_on_CAN(0x21,0x00,0x00,0x00,0x00,0x00,0x00,0x00);
    testWaitForTimeout(50);
    send_on_CAN(0x22,0x00,0x00,0xAA,0xAA,0xAA,0xAA,0xAA);     
    testWaitForTimeout(200);
    Expect(0x03,0x7F,0x27,0x22,0xAA,0xAA,0xAA,0xAA);
    EXPECTED_DATA("",E_Resp,8);
    OBSERVED_DATA("",O_Resp,8);
    Check(E_Resp,O_Resp);
    Clear_Buffer();
    testWaitForTimeout(500);

    /*-------------------------------Test Step 34--------------------------------------*/ 
    /*-----------------------------ACTION: Set powermode to OFF -----------------------------------------*/
    Action("Change power mode to OFF");
    @IgnitionSwitch=0;
    testWaitForTimeout(250);
    Read_PowerMode();
    testWaitForTimeout(100);
    
    /*-------------------------------Test Step 35--------------------------------------*/ 
    /*-----------------------------ACTION: Security unlock Level 13----------------------------------------*/
    Security_Unlock_Seed_lvl_13_Phy();
    
    /*-------------------------------Test Step 36--------------------------------------*/ 
    /*-----------------------------ACTION: Set powermode to PROP -----------------------------------------*/
    Action("Change power mode to PROP");
    @IgnitionSwitch=4;
    testWaitForTimeout(250);
    Read_PowerMode();
    testWaitForTimeout(100);
    
    /*-------------------------------Test Step 37--------------------------------------*/ 
    /*-----------------------------ACTION: Security unlock Level 13----------------------------------------*/
    STEP();
    ACTION("Sending Key to unlock security lvl 13"); 
    send_on_CAN(0x10,0x0E,0x27,0x14,0x00,0x00,0x00,0x00);
    testWaitForTimeout(50);
    send_on_CAN(0x21,0x00,0x00,0x00,0x00,0x00,0x00,0x00);
    testWaitForTimeout(50);
    send_on_CAN(0x22,0x00,0x00,0xAA,0xAA,0xAA,0xAA,0xAA);     
    testWaitForTimeout(200);
    Expect(0x03,0x7F,0x27,0x22,0xAA,0xAA,0xAA,0xAA);
    EXPECTED_DATA("",E_Resp,8);
    OBSERVED_DATA("",O_Resp,8);
    Check(E_Resp,O_Resp);
    Clear_Buffer();
    testWaitForTimeout(500);
    
    /*-------------------------------Test Step 38--------------------------------------*/ 
    /*-----------------------------ACTION: Set powermode to OFF -----------------------------------------*/
    Action("Change power mode to OFF");
    @IgnitionSwitch=0;
    testWaitForTimeout(250);
    Read_PowerMode();
    testWaitForTimeout(100);
    
    /*-------------------------------Test Step 39--------------------------------------*/ 
    /*-----------------------------ACTION: Security unlock Level 15----------------------------------------*/
    Description_DATA("Checking Security Level 15");
    Security_Unlock_Seed_lvl_15_Phy();
    
    /*-------------------------------Test Step 40--------------------------------------*/ 
    /*-----------------------------ACTION: Set powermode to ACC -----------------------------------------*/
    Action("Change power mode to ACC");
    @IgnitionSwitch=1;
    testWaitForTimeout(250);
    Read_PowerMode();
    testWaitForTimeout(100);
    
    /*-------------------------------Test Step 41--------------------------------------*/ 
    /*-----------------------------ACTION: Security unlock Level 15----------------------------------------*/
    STEP();
    ACTION("Sending Key to unlock security lvl 15"); 
    send_on_CAN(0x10,0x0E,0x27,0x16,0x00,0x00,0x00,0x00);
    testWaitForTimeout(50);
    send_on_CAN(0x21,0x00,0x00,0x00,0x00,0x00,0x00,0x00);
    testWaitForTimeout(50);
    send_on_CAN(0x22,0x00,0x00,0xAA,0xAA,0xAA,0xAA,0xAA);     
    testWaitForTimeout(200);
    Expect(0x03,0x7F,0x27,0x22,0xAA,0xAA,0xAA,0xAA);
    EXPECTED_DATA("",E_Resp,8);
    OBSERVED_DATA("",O_Resp,8);
    Check(E_Resp,O_Resp);
    Clear_Buffer();
    testWaitForTimeout(500);
    
    /*-------------------------------Test Step 42--------------------------------------*/ 
    /*-----------------------------ACTION: Set powermode to OFF -----------------------------------------*/
    Action("Change power mode to OFF");
    @IgnitionSwitch=0;
    testWaitForTimeout(250);
    Read_PowerMode();
    testWaitForTimeout(100);
    
    /*-------------------------------Test Step 43--------------------------------------*/ 
    /*-----------------------------ACTION: Security unlock Level 15----------------------------------------*/
    Security_Unlock_Seed_lvl_15_Phy();
    
    /*-------------------------------Test Step 44--------------------------------------*/ 
    /*-----------------------------ACTION: Set powermode to RUN -----------------------------------------*/
    Action("Change power mode to RUN");
    @IgnitionSwitch=2;
    testWaitForTimeout(250);
    Read_PowerMode();
    testWaitForTimeout(100);
    
    /*-------------------------------Test Step 45--------------------------------------*/ 
    /*-----------------------------ACTION: Security unlock Level 15----------------------------------------*/
    STEP();
    ACTION("Sending Key to unlock security lvl 15"); 
    send_on_CAN(0x10,0x0E,0x27,0x16,0x00,0x00,0x00,0x00);
    testWaitForTimeout(50);
    send_on_CAN(0x21,0x00,0x00,0x00,0x00,0x00,0x00,0x00);
    testWaitForTimeout(50);
    send_on_CAN(0x22,0x00,0x00,0xAA,0xAA,0xAA,0xAA,0xAA);     
    testWaitForTimeout(200);
    Expect(0x03,0x7F,0x27,0x22,0xAA,0xAA,0xAA,0xAA);
    EXPECTED_DATA("",E_Resp,8);
    OBSERVED_DATA("",O_Resp,8);
    Check(E_Resp,O_Resp);
    Clear_Buffer();
    testWaitForTimeout(500);
    
    /*-------------------------------Test Step 46--------------------------------------*/ 
    /*-----------------------------ACTION: Set powermode to OFF -----------------------------------------*/
    Action("Change power mode to OFF");
    @IgnitionSwitch=0;
    testWaitForTimeout(250);
    Read_PowerMode();
    testWaitForTimeout(100);
    
    /*-------------------------------Test Step 47--------------------------------------*/ 
    /*-----------------------------ACTION: Security unlock Level 15----------------------------------------*/
    Security_Unlock_Seed_lvl_15_Phy();
    
    /*-------------------------------Test Step 48--------------------------------------*/ 
    /*-----------------------------ACTION: Set powermode to START -----------------------------------------*/
    Action("Change power mode to START");
    @IgnitionSwitch=3;
    testWaitForTimeout(250);
    Read_PowerMode();
    testWaitForTimeout(100);
    
    /*-------------------------------Test Step 49--------------------------------------*/ 
    /*-----------------------------ACTION: Security unlock Level 15----------------------------------------*/
    STEP();
    ACTION("Sending Key to unlock security lvl 15"); 
    send_on_CAN(0x10,0x0E,0x27,0x16,0x00,0x00,0x00,0x00);
    testWaitForTimeout(50);
    send_on_CAN(0x21,0x00,0x00,0x00,0x00,0x00,0x00,0x00);
    testWaitForTimeout(50);
    send_on_CAN(0x22,0x00,0x00,0xAA,0xAA,0xAA,0xAA,0xAA);     
    testWaitForTimeout(200);
    Expect(0x03,0x7F,0x27,0x22,0xAA,0xAA,0xAA,0xAA);
    EXPECTED_DATA("",E_Resp,8);
    OBSERVED_DATA("",O_Resp,8);
    Check(E_Resp,O_Resp);
    Clear_Buffer();
    testWaitForTimeout(500);

    /*-------------------------------Test Step 50--------------------------------------*/ 
    /*-----------------------------ACTION: Set powermode to OFF -----------------------------------------*/
    Action("Change power mode to OFF");
    @IgnitionSwitch=0;
    testWaitForTimeout(250);
    Read_PowerMode();
    testWaitForTimeout(100);
    
    /*-------------------------------Test Step 51--------------------------------------*/ 
    /*-----------------------------ACTION: Security unlock Level 15----------------------------------------*/
    Security_Unlock_Seed_lvl_15_Phy();
    
    /*-------------------------------Test Step 52--------------------------------------*/ 
    /*-----------------------------ACTION: Set powermode to PROP -----------------------------------------*/
    Action("Change power mode to PROP");
    @IgnitionSwitch=4;
    testWaitForTimeout(250);
    Read_PowerMode();
    testWaitForTimeout(100);
    
    /*-------------------------------Test Step 53--------------------------------------*/ 
    /*-----------------------------ACTION: Security unlock Level 15----------------------------------------*/
    STEP();
    ACTION("Sending Key to unlock security lvl 15"); 
    send_on_CAN(0x10,0x0E,0x27,0x16,0x00,0x00,0x00,0x00);
    testWaitForTimeout(50);
    send_on_CAN(0x21,0x00,0x00,0x00,0x00,0x00,0x00,0x00);
    testWaitForTimeout(50);
    send_on_CAN(0x22,0x00,0x00,0xAA,0xAA,0xAA,0xAA,0xAA);     
    testWaitForTimeout(200);
    Expect(0x03,0x7F,0x27,0x22,0xAA,0xAA,0xAA,0xAA);
    EXPECTED_DATA("",E_Resp,8);
    OBSERVED_DATA("",O_Resp,8);
    Check(E_Resp,O_Resp);
    Clear_Buffer();
    testWaitForTimeout(500);
    
    /*-------------------------------Test Step 54--------------------------------------*/ 
    /*-----------------------------ACTION: Setting ECU to Normal mode -----------------------------------*/
    Back_To_Normal(); 
    
    stopLogging("Diagn_Data");
    
  }

testcase TC26_PGS_153741()
  {
    /*-------------------------------Test Step 1--------------------------------------*/ 
    /*-----------------------------ACTION: set Battery voltage to 12v -----------------------------------*/
   
    Set_Bat_Vol(12);
    
    /*-------------------------------Test Step 2--------------------------------------*/ 
    /*-----------------------------ACTION: Read MEC -----------------------------------------*/   
    
    Read_MEC();
    
    /*-------------------------------Test Step 3--------------------------------------*/ 
    /*-----------------------------ACTION: Set powermode to OFF -----------------------------------------*/
    @IgnitionSwitch=0;
    Read_PowerMode();
    
    /*-------------------------------Test Step 4--------------------------------------*/ 
    /*-----------------------------ACTION: Enter Default Session ----------------------------------------*/
    Default_Session_Phy();
    
    /*-------------------------------Test Step 5--------------------------------------*/ 
    /*-----------------------------ACTION: Enter Extended Session ---------------------------------------*/
    Extended_Session_Phy();
    
    /*-------------------------------Test Step 6--------------------------------------*/ 
    /*-----------------------------ACTION: Activating Tester Present for every 2sec----------------------*/
   
    Tester_Present_Per_Start_Fun(2000);
    
    /*-------------------------------Test Step 7--------------------------------------*/ 
    /*-----------------------------ACTION: Disable DTC---------------------------------------------------*/
    Dis_DTC_Phy();
    
    /*-------------------------------Test Step 8--------------------------------------*/ 
    /*-----------------------------ACTION: Disable Communication----------------------*/
    
    Dis_Comm_phy();
    
    /*-------------------------------Test Step 9--------------------------------------*/ 
    /*-----------------------------ACTION: Security unlock Level 1----------------------------------------*/
    ACTION("Checking whether a valid Seed [non-zero, non-FF] for Security Level 1 is recieved or not");
    Security_Unlock_With_Key_lvl_1_Phy();
    
    testWaitForTimeout(4000);
    
    /*-------------------------------Test Step 10--------------------------------------*/ 
    /*-----------------------------ACTION: Write RID 21E ----------------------------------------*/
    Write_RID_21E();   //InitialRefalshFlag
    
    /*-------------------------------Test Step 11--------------------------------------*/ 
    /*-----------------------------ACTION: Enter Programming_Session-------------------------------------*/
     Programming_Session_Phy();
    
    /*-------------------------------Test Step 12--------------------------------------*/ 
    /*-----------------------------ACTION: Enter Default Session ----------------------------------------*/
    STEP();
    ACTION("Enter Default Session"); //Default Session in boot P2 and P2* timer will be different 
    send_on_CAN(0x02,0x10,0x01,0x55,0x55,0x55,0x55,0x55);
    testWaitForTimeout(100);
    Expect(0x06,0x50,0x01,0x00,0x64,0x0B,0xB8,0x55);
    EXPECTED_DATA("",E_Resp,8);
    OBSERVED_DATA("",O_Resp,8);
    Check(E_Resp,O_Resp);  
    Clear_Buffer();   
    
    
    testWaitForTimeout(1000);
    
    /*-------------------------------Test Step 13--------------------------------------*/ 
    /*-----------------------------ACTION: Enter Extended Session ---------------------------------------*/
    Extended_Session_Phy();
    
    /*-------------------------------Test Step 14--------------------------------------*/ 
    /*-----------------------------ACTION: Security unlock Level 11----------------------------------------*/
    
    STEP();
    ACTION("Security unlock seed 11 checking RN received as FF "); //Security unlock seed 11
    send_on_CAN(0x02,0x27,0x11,0x55,0x55,0x55,0x55,0x55);
    testWaitForTimeout(300);
                Expect1(0x10,0x21,0x67,0x11,O_Resp[4],O_Resp[5],O_Resp[6],O_Resp[7]);
                testWaitForTimeout(50);
                Expect2(O_Resp[8],O_Resp[9],O_Resp[10],O_Resp[11],O_Resp[12],O_Resp[13],O_Resp[14],O_Resp[15]);
                testWaitForTimeout(50);
                Expect3(O_Resp[16],O_Resp[17],O_Resp[18],O_Resp[19],O_Resp[20],O_Resp[21],O_Resp[22],O_Resp[23]);
                testWaitForTimeout(50);
                Expect4(O_Resp[24],O_Resp[25],O_Resp[26],O_Resp[27],O_Resp[28],O_Resp[29],O_Resp[30],O_Resp[31]);
                testWaitForTimeout(50);
                Expect5(O_Resp[32],O_Resp[33],O_Resp[34],O_Resp[35],O_Resp[36],O_Resp[37],O_Resp[38],O_Resp[39]);
                testWaitForTimeout(50);
                EXPECTED_DATA("",E_Resp,40);
                OBSERVED_DATA("",O_Resp,40);
                      for(h=0; h<40; h++)
                          {
                             if(O_Resp[h]==0xFF)
                               {
                                 seeds++;
                               }    
                          }
                      if(seeds>=15)
                      {
                        AddToReport(PASSED);
                      }
                      else
                      {
                        AddToReport(FAILED);
                      }
                Clear_Buffer();
    testWaitForTimeout(5000);
                      
             
    /*-------------------------------Test Step 15--------------------------------------*/ 
    /*-----------------------------ACTION: Disable DTC---------------------------------------------------*/
    Dis_DTC_Phy();
    
    /*-------------------------------Test Step 16--------------------------------------*/ 
    /*-----------------------------ACTION: Disable Communication----------------------*/
    
    Dis_Comm_phy(); 
    
    /*-------------------------------Test Step 17--------------------------------------*/ 
    /*-----------------------------ACTION: Security unlock Level 3----------------------------------------*/
    ACTION("Checking whether a valid Seed [non-zero, non-FF] for Security Level 3 is recieved or not");
    Security_Unlock_With_Key_lvl_3_Phy();
    
    testWaitForTimeout(5000);                  
    
    /*-------------------------------Test Step 18--------------------------------------*/ 
    /*-----------------------------ACTION: Write RID 21E ----------------------------------------*/
    Write_RID_21E();   //InitialRefalshFlag
    
    /*-------------------------------Test Step 19--------------------------------------*/ 
    /*-----------------------------ACTION: Enter Programming_Session-------------------------------------*/
     Programming_Session_Phy();
    
    /*-------------------------------Test Step 20--------------------------------------*/ 
    /*-----------------------------ACTION: Enter Default Session ----------------------------------------*/
    STEP();
    ACTION("Enter Default Session"); //Default Session in boot P2 and P2* timer will be different 
    send_on_CAN(0x02,0x10,0x01,0x55,0x55,0x55,0x55,0x55);
    testWaitForTimeout(100);
    Expect(0x06,0x50,0x01,0x00,0x64,0x0B,0xB8,0x55);
    EXPECTED_DATA("",E_Resp,8);
    OBSERVED_DATA("",O_Resp,8);
    Check(E_Resp,O_Resp);  
    Clear_Buffer();   
    
    
    testWaitForTimeout(1000);
    
    /*-------------------------------Test Step 21--------------------------------------*/ 
    /*-----------------------------ACTION: Enter Extended Session ---------------------------------------*/
    Extended_Session_Phy();
    
    /*-------------------------------Test Step 22--------------------------------------*/ 
    /*-----------------------------ACTION: Security unlock Level 13----------------------------------------*/
    
    STEP();
    ACTION("Security unlock seed 13 checking RN received as FF "); //Security unlock seed 13
    send_on_CAN(0x02,0x27,0x13,0x55,0x55,0x55,0x55,0x55);
    testWaitForTimeout(300);
                Expect1(0x10,0x21,0x67,0x13,O_Resp[4],O_Resp[5],O_Resp[6],O_Resp[7]);
                testWaitForTimeout(50);
                Expect2(O_Resp[8],O_Resp[9],O_Resp[10],O_Resp[11],O_Resp[12],O_Resp[13],O_Resp[14],O_Resp[15]);
                testWaitForTimeout(50);
                Expect3(O_Resp[16],O_Resp[17],O_Resp[18],O_Resp[19],O_Resp[20],O_Resp[21],O_Resp[22],O_Resp[23]);
                testWaitForTimeout(50);
                Expect4(O_Resp[24],O_Resp[25],O_Resp[26],O_Resp[27],O_Resp[28],O_Resp[29],O_Resp[30],O_Resp[31]);
                testWaitForTimeout(50);
                Expect5(O_Resp[32],O_Resp[33],O_Resp[34],O_Resp[35],O_Resp[36],O_Resp[37],O_Resp[38],O_Resp[39]);
                testWaitForTimeout(50);
                EXPECTED_DATA("",E_Resp,40);
                OBSERVED_DATA("",O_Resp,40);
                      for(h=0; h<40; h++)
                          {
                             if(O_Resp[h]==0xFF)
                               {
                                 seeds++;
                               }    
                          }
                      if(seeds>=15)
                      {
                        AddToReport(PASSED);
                      }
                      else
                      {
                        AddToReport(FAILED);
                      }
                Clear_Buffer();
    testWaitForTimeout(2000);
    
    /*-------------------------------Test Step 23--------------------------------------*/ 
    /*-----------------------------ACTION: Set powermode to RUN -----------------------------------------*/
    @IgnitionSwitch=2;
    Read_PowerMode();  
    testWaitForTimeout(300); 
                      
    /*-------------------------------Test Step 24--------------------------------------*/ 
    /*-----------------------------ACTION: Set OTA PSF Flag to true -----------------------------------------*/                  
    STEP();
    ACTION("Set OTA PSF Flag to True"); // setting OTA PSF flag to true to unlock security level 05              
    setSignal(BSPMP_RmtProgmActvAuth,1);
    testWaitForTimeout(50);
                      
    /*-------------------------------Test Step 25--------------------------------------*/ 
    /*-----------------------------ACTION: Set powermode to OFF -----------------------------------------*/
    @IgnitionSwitch=0;
    testWaitForTimeout(200); 
    Read_PowerMode();   
    /*-------------------------------Test Step 26--------------------------------------*/ 
    /*-----------------------------ACTION: Disable DTC---------------------------------------------------*/
    Dis_DTC_Phy();
    
    /*-------------------------------Test Step 27--------------------------------------*/ 
    /*-----------------------------ACTION: Disable Communication------------------------------------------*/
    
    Dis_Comm_phy(); 
    
    /*-------------------------------Test Step 28--------------------------------------*/ 
    /*-----------------------------ACTION: Security unlock Level 5----------------------------------------*/
    ACTION("Checking whether a valid Seed [non-zero, non-FF] for Security Level 5 is recieved or not");
    Security_Unlock_With_Key_lvl_5_Phy();
    
    testWaitForTimeout(5000);                  
    
    /*-------------------------------Test Step 29--------------------------------------*/ 
    /*-----------------------------ACTION: Write RID 21E ----------------------------------------*/
    Write_RID_21E();   //InitialRefalshFlag
    
    /*-------------------------------Test Step 30--------------------------------------*/ 
    /*-----------------------------ACTION: Enter Programming_Session-------------------------------------*/
     Programming_Session_Phy();
    
    /*-------------------------------Test Step 31--------------------------------------*/ 
    /*-----------------------------ACTION: Enter Default Session ----------------------------------------*/
    STEP();
    ACTION("Enter Default Session"); //Default Session in boot P2 and P2* timer will be different 
    send_on_CAN(0x02,0x10,0x01,0x55,0x55,0x55,0x55,0x55);
    testWaitForTimeout(100);
    Expect(0x06,0x50,0x01,0x00,0x64,0x0B,0xB8,0x55);
    EXPECTED_DATA("",E_Resp,8);
    OBSERVED_DATA("",O_Resp,8);
    Check(E_Resp,O_Resp);  
    Clear_Buffer();   
    
    
    testWaitForTimeout(1000);
    
    /*-------------------------------Test Step 32--------------------------------------*/ 
    /*-----------------------------ACTION: Enter Extended Session ---------------------------------------*/
    Extended_Session_Phy();
    
    /*-------------------------------Test Step 33--------------------------------------*/ 
    /*-----------------------------ACTION: Security unlock Level 15----------------------------------------*/
    
    STEP();
    ACTION("Security unlock seed 15 checking RN received as FF "); //Security unlock seed 15
    send_on_CAN(0x02,0x27,0x15,0x55,0x55,0x55,0x55,0x55);
    testWaitForTimeout(300);
                Expect1(0x10,0x21,0x67,0x13,O_Resp[4],O_Resp[5],O_Resp[6],O_Resp[7]);
                testWaitForTimeout(50);
                Expect2(O_Resp[8],O_Resp[9],O_Resp[10],O_Resp[11],O_Resp[12],O_Resp[13],O_Resp[14],O_Resp[15]);
                testWaitForTimeout(50);
                Expect3(O_Resp[16],O_Resp[17],O_Resp[18],O_Resp[19],O_Resp[20],O_Resp[21],O_Resp[22],O_Resp[23]);
                testWaitForTimeout(50);
                Expect4(O_Resp[24],O_Resp[25],O_Resp[26],O_Resp[27],O_Resp[28],O_Resp[29],O_Resp[30],O_Resp[31]);
                testWaitForTimeout(50);
                Expect5(O_Resp[32],O_Resp[33],O_Resp[34],O_Resp[35],O_Resp[36],O_Resp[37],O_Resp[38],O_Resp[39]);
                testWaitForTimeout(50);
                EXPECTED_DATA("",E_Resp,40);
                OBSERVED_DATA("",O_Resp,40);
                      for(h=0; h<40; h++)
                          {
                             if(O_Resp[h]==0xFF)
                               {
                                 seeds++;
                               }    
                          }
                      if(seeds>=15)
                      {
                        AddToReport(PASSED);
                      }
                      else
                      {
                        AddToReport(FAILED);
                      }
                Clear_Buffer();
    testWaitForTimeout(2000);
                      
    /*-------------------------------Test Step 34--------------------------------------*/ 
    /*-----------------------------ACTION: Setting ECU to Normal mode -----------------------------------*/
    Back_To_Normal(); 
  }
  
  testcase TC27_PGS_200632()
  {
    /*-------------------------------Test Step 1--------------------------------------*/ 
    /*-----------------------------ACTION: set Battery voltage to 12v -----------------------------------*/
   
    Set_Bat_Vol(12);
    
    /*-------------------------------Test Step 2--------------------------------------*/ 
    /*-----------------------------ACTION: Read MEC -----------------------------------------*/   
    
    Read_MEC();
    
    /*-------------------------------Test Step 3--------------------------------------*/ 
    /*-----------------------------ACTION: Set powermode to OFF -----------------------------------------*/
    @IgnitionSwitch=0;
    Read_PowerMode();
    
    /*-------------------------------Test Step 4--------------------------------------*/ 
    /*-----------------------------ACTION: Checking APSRKPC value-----------------------------------*/
    
    STEP();
    ACTION("Checking APSRKPC value byte[1] is Zero or not"); 
    send_on_CAN(0x03,0x22,0xE0,0xB4,0x00,0x00,0x00,0x00);
    testWaitForTimeout(50);
    Expect(0x06,0x62,0xE0,0xB4,0x01,0x00,0xFF,0xAA);
    EXPECTED_DATA("",E_Resp,8);
    OBSERVED_DATA("",O_Resp,8);
    Check(E_Resp,O_Resp);
    Clear_Buffer();
    
    /*-------------------------------Test Step 5--------------------------------------*/ 
    /*-----------------------------ACTION: Enter Default Session ----------------------------------------*/
    Default_Session_Phy();
    
    /*-------------------------------Test Step 6--------------------------------------*/ 
    /*-----------------------------ACTION: Enter Extended Session ---------------------------------------*/
    Extended_Session_Phy();
    
    /*-------------------------------Test Step 7--------------------------------------*/ 
    /*-----------------------------ACTION: Activating Tester Present for every 2sec----------------------*/
   
    Tester_Present_Per_Start_Fun(2000);
    
    /*-------------------------------Test Step 8--------------------------------------*/ 
    /*-----------------------------ACTION: Security unlock Level 5----------------------------------------*/
    Description_DATA("Checking Security Level 5");
    send_on_CAN(0x02,0x27,0x05,0x55,0x55,0x55,0x55,0x55);
    testWaitForTimeout(100);
    Expect(0x03,0x7F,0x27,0x22,0xAA,0xAA,0xAA,0xAA);
    EXPECTED_DATA("",E_Resp,8);
    OBSERVED_DATA("",O_Resp,8);
    Check(E_Resp,O_Resp);  
    Clear_Buffer();
    testWaitForTimeout(200);
    
    /*-------------------------------Test Step 9--------------------------------------*/ 
    /*-----------------------------ACTION: Security unlock Level 9----------------------------------------*/
    Description_DATA("Checking Security Level 9");
    send_on_CAN(0x02,0x27,0x09,0x55,0x55,0x55,0x55,0x55);
    testWaitForTimeout(100);
    Expect(0x03,0x7F,0x27,0x22,0xAA,0xAA,0xAA,0xAA);
    EXPECTED_DATA("",E_Resp,8);
    OBSERVED_DATA("",O_Resp,8);
    Check(E_Resp,O_Resp);  
    Clear_Buffer();
    testWaitForTimeout(200);
    
    /*-------------------------------Test Step 10--------------------------------------*/ 
    /*-----------------------------ACTION: Security unlock Level 0B----------------------------------------*/
    Description_DATA("Checking Security Level 0B");
    send_on_CAN(0x02,0x27,0x0B,0x55,0x55,0x55,0x55,0x55);
    testWaitForTimeout(100);
    Expect(0x03,0x7F,0x27,0x22,0xAA,0xAA,0xAA,0xAA);
    EXPECTED_DATA("",E_Resp,8);
    OBSERVED_DATA("",O_Resp,8);
    Check(E_Resp,O_Resp);  
    Clear_Buffer();
    testWaitForTimeout(200);
    
    /*-------------------------------Test Step 11--------------------------------------*/ 
    /*-----------------------------ACTION: Security unlock Level 0D----------------------------------------*/
    Description_DATA("Checking Security Level 0D");
    send_on_CAN(0x02,0x27,0x0D,0x55,0x55,0x55,0x55,0x55);
    testWaitForTimeout(100);
    Expect(0x03,0x7F,0x27,0x22,0xAA,0xAA,0xAA,0xAA);
    EXPECTED_DATA("",E_Resp,8);
    OBSERVED_DATA("",O_Resp,8);
    Check(E_Resp,O_Resp);  
    Clear_Buffer();
    testWaitForTimeout(200);
    
    /*-------------------------------Test Step 12--------------------------------------*/ 
    /*-----------------------------ACTION: Security unlock Level 15----------------------------------------*/
    Description_DATA("Checking Security Level 15");
    send_on_CAN(0x02,0x27,0x15,0x55,0x55,0x55,0x55,0x55);
    testWaitForTimeout(100);
    Expect(0x03,0x7F,0x27,0x22,0xAA,0xAA,0xAA,0xAA);
    EXPECTED_DATA("",E_Resp,8);
    OBSERVED_DATA("",O_Resp,8);
    Check(E_Resp,O_Resp);  
    Clear_Buffer();
    testWaitForTimeout(200);
    
    /*-------------------------------Test Step 13--------------------------------------*/ 
    /*-----------------------------ACTION: Setting ECU to Normal mode -----------------------------------*/
    Back_To_Normal(); 
  }
  
  testcase TC28_PGS_154921()
  {
    char logPath[256] = "C:\\Users\\GID_GMSDV_ITV\\Documents\\ECU_Unlock_logs\\Autoamtion\\PGS_154921.asc"; // Change this to your desired path
    setLogFileName("Test Logs",logPath);
    startLogging("Test Logs");
    
    /*-------------------------------Test Step 1--------------------------------------*/ 
    /*-----------------------------ACTION: set Battery voltage to 12v -----------------------------------*/
    
    Set_Bat_Vol(12);
    
    /*-------------------------------Test Step 2--------------------------------------*/ 
    /*-----------------------------ACTION: Read MEC -----------------------------------------*/   
    
    Read_MEC();
    
    /*-------------------------------Test Step 3--------------------------------------*/ 
    /*-----------------------------ACTION: Set powermode to OFF -----------------------------------------*/
    
    @IgnitionSwitch=0;
    testWaitForTimeout(200);
    Read_PowerMode();
    
    /*-------------------------------Test Step 4--------------------------------------*/ 
    /*-----------------------------ACTION: Enter Extended Session ---------------------------------------*/
   
    Extended_Session_Phy();
    
    /*-------------------------------Test Step 5--------------------------------------*/ 
    /*-----------------------------ACTION: Activating Tester Present for every 2sec----------------------*/
   
    Tester_Present_Per_Start_Fun(2000);
    
    /*-------------------------------Test Step 7--------------------------------------*/ 
    /*-----------------------------ACTION: Disable DTC---------------------------------------------------*/
    Dis_DTC_Phy();
    
    /*-------------------------------Test Step 8--------------------------------------*/ 
    /*-----------------------------ACTION: Disable Communication----------------------*/
    
    Dis_Comm_phy();
    
    /*-------------------------------Test Step 9--------------------------------------*/ 
    /*-----------------------------ACTION: Security unlock Level 1----------------------------------------*/
    ACTION("Checking whether a valid Seed [non-zero, non-FF] for Security Level 01 is recieved or not");
    Security_Unlock_With_Key_lvl_1_Phy();
    
    testWaitForTimeout(5000);
    
    /*-------------------------------Test Step 10--------------------------------------*/ 
    /*-----------------------------ACTION: Write RID 21E ----------------------------------------*/
    Write_RID_21E();   //InitialRefalshFlag
    
    /*-------------------------------Test Step 11--------------------------------------*/ 
    /*-----------------------------ACTION: Enter Programming_Session-------------------------------------*/
     Programming_Session_Phy();
    
    /*-------------------------------Test Step 12--------------------------------------*/ 
    /*-----------------------------ACTION: Enter Default Session ----------------------------------------*/
    STEP();
    ACTION("Enter Default Session"); //Default Session in boot P2 and P2* timer will be different 
    send_on_CAN(0x02,0x10,0x01,0x55,0x55,0x55,0x55,0x55);
    testWaitForTimeout(100);
    Expect(0x06,0x50,0x01,0x00,0x64,0x0B,0xB8,0x55);
    EXPECTED_DATA("",E_Resp,8);
    OBSERVED_DATA("",O_Resp,8);
    Check(E_Resp,O_Resp);  
    Clear_Buffer();   
    
    
    testWaitForTimeout(1000);
    
    /*-------------------------------Test Step 13--------------------------------------*/ 
    /*-----------------------------ACTION: Enter Extended Session ---------------------------------------*/
   
    Extended_Session_Phy();
    
    /*-------------------------------Test Step 14--------------------------------------*/ 
    /*-----------------------------ACTION: Set powermode to RUN -----------------------------------------*/
    
    @IgnitionSwitch=2;
    testWaitForTimeout(200);
    Read_PowerMode();
    
    testWaitForTimeout(50);
    
    /*-------------------------------Test Step 15--------------------------------------*/ 
    /*-----------------------------ACTION: Set powermode to OFF -----------------------------------------*/
    
    @IgnitionSwitch=0;
    testWaitForTimeout(200);
    Read_PowerMode();
    
    /*-------------------------------Test Step 16--------------------------------------*/ 
    /*-----------------------------ACTION: Security unlock Level 11----------------------------------------*/
    Description_DATA("RN should not be FF");
    ACTION("Checking whether a valid Seed [non-zero, non-FF] for Security Level 11 is recieved or not");
    if (mec_value==0)
    {
      STEP();
      ACTION("Unlock Security Level 11 with Valid [Key]"); //Unlock Security Level 11
      @SecurityAccess::Security_Level=17;
      testWaitForTimeout(50);
      putValue(APT_UnlockEcu,1);
      testWaitForTimeout(500);
      OBSERVED_DATA("",O_Resp,40);
    
      if(O_Resp[2]==0x67 && O_Resp[3]==0x11)
         {
             for(j=0; j<38 ;j++)
             {
               if(O_Resp[j]==0xFF)
               {
                 Invalidcount ++;
               }
             }
             
             if(Invalidcount >= 15)
             {
               ACTION("RN should not be FF");
               AddToReport(FAILED);
               Invalidcount=0;
             }
             else
             {
                Expect1(0x10,0x21,0x67,0x11,O_Resp[4],O_Resp[5],O_Resp[6],O_Resp[7]);
                testWaitForTimeout(50);
                Expect2(O_Resp[8],O_Resp[9],O_Resp[10],O_Resp[11],O_Resp[12],O_Resp[13],O_Resp[14],O_Resp[15]);
                testWaitForTimeout(50);
                Expect3(O_Resp[16],O_Resp[17],O_Resp[18],O_Resp[19],O_Resp[20],O_Resp[21],O_Resp[22],O_Resp[23]);
                testWaitForTimeout(50);
                Expect4(O_Resp[24],O_Resp[25],O_Resp[26],O_Resp[27],O_Resp[28],O_Resp[29],O_Resp[30],O_Resp[31]);
                testWaitForTimeout(50);
                Expect5(O_Resp[32],O_Resp[33],O_Resp[34],O_Resp[35],O_Resp[36],O_Resp[37],O_Resp[38],O_Resp[39]);
                testWaitForTimeout(50);
               
                Check(E_Resp,O_Resp);
                Clear_Buffer(); 
                Invalidcount=0;
             }
  
         }
         
      else
         {
           Expect(O_Resp[0],O_Resp[1],O_Resp[2],O_Resp[3],O_Resp[4],O_Resp[5],O_Resp[6],O_Resp[7]);
           AddToReport(FAILED);
         }
    }
    testWaitForTimeout(5000);
    
     /*-------------------------------Test Step 17--------------------------------------*/ 
    /*-----------------------------ACTION: Disable DTC---------------------------------------------------*/
    Dis_DTC_Phy();
    
    /*-------------------------------Test Step 18--------------------------------------*/ 
    /*-----------------------------ACTION: Disable Communication----------------------*/
    
    Dis_Comm_phy();
    
    /*-------------------------------Test Step 19--------------------------------------*/ 
    /*-----------------------------ACTION: Security unlock Level 3----------------------------------------*/
    ACTION("Checking whether a valid Seed [non-zero, non-FF] for Security Level 03 is recieved or not");
    Security_Unlock_With_Key_lvl_3_Phy();
    
    testWaitForTimeout(5000);
    
    /*-------------------------------Test Step 20--------------------------------------*/ 
    /*-----------------------------ACTION: Write RID 21E ----------------------------------------*/
    Write_RID_21E();   //InitialRefalshFlag
    
    /*-------------------------------Test Step 21--------------------------------------*/ 
    /*-----------------------------ACTION: Enter Programming_Session-------------------------------------*/
     Programming_Session_Phy();
    
    /*-------------------------------Test Step 22--------------------------------------*/ 
    /*-----------------------------ACTION: Enter Default Session ----------------------------------------*/
    STEP();
    ACTION("Enter Default Session"); //Default Session in boot P2 and P2* timer will be different 
    send_on_CAN(0x02,0x10,0x01,0x55,0x55,0x55,0x55,0x55);
    testWaitForTimeout(100);
    Expect(0x06,0x50,0x01,0x00,0x64,0x0B,0xB8,0x55);
    EXPECTED_DATA("",E_Resp,8);
    OBSERVED_DATA("",O_Resp,8);
    Check(E_Resp,O_Resp);  
    Clear_Buffer();   
    
    
    testWaitForTimeout(1000);
    
    /*-------------------------------Test Step 23--------------------------------------*/ 
    /*-----------------------------ACTION: Enter Extended Session ---------------------------------------*/
   
    Extended_Session_Phy();
    
    /*-------------------------------Test Step 24--------------------------------------*/ 
    /*-----------------------------ACTION: Set powermode to RUN -----------------------------------------*/
    
    @IgnitionSwitch=2;
    testWaitForTimeout(200);
    Read_PowerMode();
    
    testWaitForTimeout(50);
    
    /*-------------------------------Test Step 25--------------------------------------*/ 
    /*-----------------------------ACTION: Set powermode to OFF -----------------------------------------*/
    
    @IgnitionSwitch=0;
    testWaitForTimeout(200);
    Read_PowerMode();
    
    /*-------------------------------Test Step 26--------------------------------------*/ 
    /*-----------------------------ACTION: Security unlock Level 13----------------------------------------*/
    Description_DATA("Last all 15 bytes data should be RN number, which not should be FF");
    ACTION("Checking whether a valid Seed [non-zero, non-FF] for Security Level 13 is recieved or not");
    if (mec_value==0)
    {
      STEP();
      ACTION("Unlock Security Level 13 with Valid [Key]"); //Unlock Security Level 13
      @SecurityAccess::Security_Level=19;
      testWaitForTimeout(50);
      putValue(APT_UnlockEcu,1);
      testWaitForTimeout(500);
      OBSERVED_DATA("",O_Resp,40);
    
      if(O_Resp[2]==0x67 && O_Resp[3]==0x13)
         {
             for(j=0; j<38 ;j++)
             {
               if(O_Resp[j]==0xFF)
               {
                 Invalidcount ++;
               }
             }
             
             if(Invalidcount >= 15)
             {
               ACTION("RN should not be FF");
               AddToReport(FAILED);
               Invalidcount=0;
             }
             else
             {
                Expect1(0x10,0x21,0x67,0x13,O_Resp[4],O_Resp[5],O_Resp[6],O_Resp[7]);
                testWaitForTimeout(50);
                Expect2(O_Resp[8],O_Resp[9],O_Resp[10],O_Resp[11],O_Resp[12],O_Resp[13],O_Resp[14],O_Resp[15]);
                testWaitForTimeout(50);
                Expect3(O_Resp[16],O_Resp[17],O_Resp[18],O_Resp[19],O_Resp[20],O_Resp[21],O_Resp[22],O_Resp[23]);
                testWaitForTimeout(50);
                Expect4(O_Resp[24],O_Resp[25],O_Resp[26],O_Resp[27],O_Resp[28],O_Resp[29],O_Resp[30],O_Resp[31]);
                testWaitForTimeout(50);
                Expect5(O_Resp[32],O_Resp[33],O_Resp[34],O_Resp[35],O_Resp[36],O_Resp[37],O_Resp[38],O_Resp[39]);
                testWaitForTimeout(50);
               
                Check(E_Resp,O_Resp);
                Clear_Buffer(); 
                Invalidcount=0;
             }
  
         }
         
      else
         {
           Expect(O_Resp[0],O_Resp[1],O_Resp[2],O_Resp[3],O_Resp[4],O_Resp[5],O_Resp[6],O_Resp[7]);
           AddToReport(FAILED);
         }
    }
    
    testWaitForTimeout(5000);
    
    /*-------------------------------Test Step 27--------------------------------------*/ 
    /*-----------------------------ACTION: Set powermode to RUN -----------------------------------------*/
    @IgnitionSwitch=2;
    testWaitForTimeout(250);
    Read_PowerMode();  
    testWaitForTimeout(300); 
                      
    /*-------------------------------Test Step 28--------------------------------------*/ 
    /*-----------------------------ACTION: Set OTA PSF Flag to true -----------------------------------------*/                  
    STEP();
    ACTION("Set OTA PSF Flag to True"); // setting OTA PSF flag to true to unlock security level 05              
    setSignal(BSPMP_RmtProgmActvAuth,1);
    testWaitForTimeout(50);
                      
    /*-------------------------------Test Step 29--------------------------------------*/ 
    /*-----------------------------ACTION: Set powermode to OFF -----------------------------------------*/
    @IgnitionSwitch=0;
    testWaitForTimeout(200); 
    Read_PowerMode(); 
    
    /*-------------------------------Test Step 30--------------------------------------*/ 
    /*-----------------------------ACTION: Disable DTC---------------------------------------------------*/
    Dis_DTC_Phy();
    
    /*-------------------------------Test Step 31--------------------------------------*/ 
    /*-----------------------------ACTION: Disable Communication----------------------*/
    
    Dis_Comm_phy();
    
    /*-------------------------------Test Step 32--------------------------------------*/ 
    /*-----------------------------ACTION: Security unlock Level 5----------------------------------------*/
    ACTION("Checking whether a valid Seed [non-zero, non-FF] for Security Level 05 is recieved or not");
    Security_Unlock_With_Key_lvl_5_Phy();
    
    testWaitForTimeout(5000);
    
    /*-------------------------------Test Step 33--------------------------------------*/ 
    /*-----------------------------ACTION: Write RID 21E ----------------------------------------*/
    Write_RID_21E();   //InitialRefalshFlag
    
    /*-------------------------------Test Step 34--------------------------------------*/ 
    /*-----------------------------ACTION: Enter Programming_Session-------------------------------------*/
     Programming_Session_Phy();
    
    /*-------------------------------Test Step 35--------------------------------------*/ 
    /*-----------------------------ACTION: Enter Default Session ----------------------------------------*/
    STEP();
    ACTION("Enter Default Session"); //Default Session in boot P2 and P2* timer will be different 
    send_on_CAN(0x02,0x10,0x01,0x55,0x55,0x55,0x55,0x55);
    testWaitForTimeout(100);
    Expect(0x06,0x50,0x01,0x00,0x64,0x0B,0xB8,0x55);
    EXPECTED_DATA("",E_Resp,8);
    OBSERVED_DATA("",O_Resp,8);
    Check(E_Resp,O_Resp);  
    Clear_Buffer();   
    
    
    testWaitForTimeout(1000);
    
    /*-------------------------------Test Step 36--------------------------------------*/ 
    /*-----------------------------ACTION: Enter Extended Session ---------------------------------------*/
   
    Extended_Session_Phy();
    
    /*-------------------------------Test Step 37--------------------------------------*/ 
    /*-----------------------------ACTION: Set powermode to RUN -----------------------------------------*/
    
    @IgnitionSwitch=2;
    testWaitForTimeout(200);
    Read_PowerMode();
    
    testWaitForTimeout(50);
    
    /*-------------------------------Test Step 38--------------------------------------*/ 
    /*-----------------------------ACTION: Set powermode to OFF -----------------------------------------*/
    
    @IgnitionSwitch=0;
    testWaitForTimeout(200);
    Read_PowerMode();
    
    /*-------------------------------Test Step 39--------------------------------------*/ 
    /*-----------------------------ACTION: Security unlock Level 15----------------------------------------*/
    Description_DATA("Last all 15 bytes data should be RN number, which not should be FF");
    ACTION("Checking whether a valid Seed [non-zero, non-FF] for Security Level 15 is recieved or not");
    if (mec_value==0)
    {
      STEP();
      ACTION("Unlock Security Level 15 with Valid [Key]"); //Unlock Security Level 15
      @SecurityAccess::Security_Level=21;
      testWaitForTimeout(50);
      putValue(APT_UnlockEcu,1);
      testWaitForTimeout(500);
      OBSERVED_DATA("",O_Resp,40);
    
      if(O_Resp[2]==0x67 && O_Resp[3]==0x15)
         {
             for(j=0; j<38 ;j++)
             {
               if(O_Resp[j]==0xFF)
               {
                 Invalidcount ++;
               }
             }
             
             if(Invalidcount >= 15)
             {
               ACTION("RN should not be FF");
               AddToReport(FAILED);
               Invalidcount=0;
             }
             else
             {
                Expect1(0x10,0x21,0x67,0x15,O_Resp[4],O_Resp[5],O_Resp[6],O_Resp[7]);
                testWaitForTimeout(50);
                Expect2(O_Resp[8],O_Resp[9],O_Resp[10],O_Resp[11],O_Resp[12],O_Resp[13],O_Resp[14],O_Resp[15]);
                testWaitForTimeout(50);
                Expect3(O_Resp[16],O_Resp[17],O_Resp[18],O_Resp[19],O_Resp[20],O_Resp[21],O_Resp[22],O_Resp[23]);
                testWaitForTimeout(50);
                Expect4(O_Resp[24],O_Resp[25],O_Resp[26],O_Resp[27],O_Resp[28],O_Resp[29],O_Resp[30],O_Resp[31]);
                testWaitForTimeout(50);
                Expect5(O_Resp[32],O_Resp[33],O_Resp[34],O_Resp[35],O_Resp[36],O_Resp[37],O_Resp[38],O_Resp[39]);
                testWaitForTimeout(50);
               
                Check(E_Resp,O_Resp);
                Clear_Buffer(); 
                Invalidcount=0;
             }
  
         }
         
      else
         {
           Expect(O_Resp[0],O_Resp[1],O_Resp[2],O_Resp[3],O_Resp[4],O_Resp[5],O_Resp[6],O_Resp[7]);
           AddToReport(FAILED);
         }
    }
    
    testWaitForTimeout(5000);
    
    /*-------------------------------Test Step 40--------------------------------------*/ 
    /*-----------------------------ACTION: Setting ECU to Normal mode -----------------------------------*/
    Back_To_Normal();
    stopLogging("Test Logs");
  }
  testcase TC29_PGS_154951()
  {
    char logPath[256] = "C:\\Users\\GID_GMSDV_ITV\\Documents\\ECU_Unlock_logs\\Autoamtion\\PGS_154951.asc"; // Change this to your desired path
    setLogFileName("Test Logs",logPath);
    startLogging("Test Logs");
    
    /*-------------------------------Test Step 1--------------------------------------*/ 
    /*-----------------------------ACTION: set Battery voltage to 12v -----------------------------------*/
   
    Set_Bat_Vol(12);
    
    /*-------------------------------Test Step 2--------------------------------------*/ 
    /*-----------------------------ACTION: Read MEC -----------------------------------------*/   
    
    Read_MEC();
    
    /*-------------------------------Test Step 3--------------------------------------*/ 
    /*-----------------------------ACTION: Set powermode to OFF -----------------------------------------*/
    @IgnitionSwitch=0;
    Read_PowerMode();
    
    /*-------------------------------Test Step 4--------------------------------------*/ 
    /*-----------------------------ACTION: Enter Default Session ----------------------------------------*/
    Default_Session_Phy();
    
    /*-------------------------------Test Step 5--------------------------------------*/ 
    /*-----------------------------ACTION: Activating Tester Present for every 2sec----------------------*/
   
    Tester_Present_Per_Start_Fun(2000);
    
    /*-------------------------------Test Step 6--------------------------------------*/ 
    /*-----------------------------ACTION: Enter Extended Session ---------------------------------------*/
    Extended_Session_Phy();
  
    /*-------------------------------Test Step 7--------------------------------------*/ 
    /*-----------------------------ACTION: Disable DTC---------------------------------------------------*/
    Dis_DTC_Phy();
    
    /*-------------------------------Test Step 8--------------------------------------*/ 
    /*-----------------------------ACTION: Disable Communication----------------------*/
    
    Dis_Comm_phy();
    
    /*-------------------------------Test Step 9--------------------------------------*/ 
    /*-----------------------------ACTION: Security unlock Level 1----------------------------------------*/
    ACTION("Checking whether a valid Seed [non-zero, non-FF] for Security Level 1 is recieved or not");
    Security_Unlock_With_Key_lvl_1_Phy();
    
    testWaitForTimeout(5000);
    
    /*-------------------------------Test Step 10--------------------------------------*/ 
    /*-----------------------------ACTION: Enter Programming_Session-------------------------------------*/
     Programming_Session_Phy();
    
    /*-------------------------------Test Step 11--------------------------------------*/ 
    /*-----------------------------ACTION: Enter Default Session ----------------------------------------*/
    STEP();
    ACTION("Enter Default Session"); //Default Session in boot P2 and P2* timer will be different 
    send_on_CAN(0x02,0x10,0x01,0x55,0x55,0x55,0x55,0x55);
    testWaitForTimeout(100);
    Expect(0x06,0x50,0x01,0x00,0x64,0x0B,0xB8,0x55);
    EXPECTED_DATA("",E_Resp,8);
    OBSERVED_DATA("",O_Resp,8);
    Check(E_Resp,O_Resp);  
    Clear_Buffer();   
    
    
    testWaitForTimeout(1000);
    
    /*-------------------------------Test Step 12--------------------------------------*/ 
    /*-----------------------------ACTION: Enter Extended Session ---------------------------------------*/
    Extended_Session_Phy();
    
    /*-------------------------------Test Step 13--------------------------------------*/ 
    /*-----------------------------ACTION: Security unlock Level 11----------------------------------------*/
    Description_DATA("Last all 15 bytes data should be RN number, which not should be FF");
    ACTION("Checking whether a valid Seed [non-zero, non-FF] for Security Level 11 is recieved or not");
    Security_Unlock_With_Key_lvl_11_Phy();
    
    testWaitForTimeout(5000);
    
    /*-------------------------------Test Step 14--------------------------------------*/ 
    /*-----------------------------ACTION: Disable DTC---------------------------------------------------*/
    Dis_DTC_Phy();
    testWaitForTimeout(250);
    
    /*-------------------------------Test Step 15--------------------------------------*/ 
    /*-----------------------------ACTION: Disable Communication----------------------*/
    
    Dis_Comm_phy();
    testWaitForTimeout(250);
    
    /*-------------------------------Test Step 16--------------------------------------*/ 
    /*-----------------------------ACTION: Security unlock Level 3----------------------------------------*/
    ACTION("Checking whether a valid Seed [non-zero, non-FF] for Security Level 3 is recieved or not");
    Security_Unlock_With_Key_lvl_3_Phy();
    
    testWaitForTimeout(5000);
    
    /*-------------------------------Test Step 17--------------------------------------*/ 
    /*-----------------------------ACTION: Enter Programming_Session-------------------------------------*/
     Programming_Session_Phy();
    
    /*-------------------------------Test Step 18--------------------------------------*/ 
    /*-----------------------------ACTION: Enter Default Session ----------------------------------------*/
    STEP();
    ACTION("Enter Default Session"); //Default Session in boot P2 and P2* timer will be different 
    send_on_CAN(0x02,0x10,0x01,0x55,0x55,0x55,0x55,0x55);
    testWaitForTimeout(100);
    Expect(0x06,0x50,0x01,0x00,0x64,0x0B,0xB8,0x55);
    EXPECTED_DATA("",E_Resp,8);
    OBSERVED_DATA("",O_Resp,8);
    Check(E_Resp,O_Resp);  
    Clear_Buffer();   
    
    
    testWaitForTimeout(1000);
    
    /*-------------------------------Test Step 19--------------------------------------*/ 
    /*-----------------------------ACTION: Enter Extended Session ---------------------------------------*/
    Extended_Session_Phy();
    
    /*-------------------------------Test Step 20--------------------------------------*/ 
    /*-----------------------------ACTION: Security unlock Level 13----------------------------------------*/
    Description_DATA("Last all 15 bytes data should be RN number, which not should be FF");
    ACTION("Checking whether a valid Seed [non-zero, non-FF] for Security Level 13 is recieved or not");
    Security_Unlock_With_Key_lvl_13_Phy();
    
    testWaitForTimeout(5000);
    
    /*-------------------------------Test Step 21--------------------------------------*/ 
    /*-----------------------------ACTION: Set powermode to RUN -----------------------------------------*/
    @IgnitionSwitch=2;
    testWaitForTimeout(250);
    Read_PowerMode();  
    testWaitForTimeout(300); 
                      
    /*-------------------------------Test Step 22--------------------------------------*/ 
    /*-----------------------------ACTION: Set OTA PSF Flag to true -----------------------------------------*/                  
    STEP();
    ACTION("Set OTA PSF Flag to True"); // setting OTA PSF flag to true to unlock security level 05              
    setSignal(BSPMP_RmtProgmActvAuth,1);
    testWaitForTimeout(50);
                      
    /*-------------------------------Test Step 23--------------------------------------*/ 
    /*-----------------------------ACTION: Set powermode to OFF -----------------------------------------*/
    @IgnitionSwitch=0;
    testWaitForTimeout(100); 
    Read_PowerMode();
    /*-------------------------------Test Step 24--------------------------------------*/ 
    /*-----------------------------ACTION: Disable DTC---------------------------------------------------*/
    Dis_DTC_Phy();
    testWaitForTimeout(100);
    
    /*-------------------------------Test Step 25--------------------------------------*/ 
    /*-----------------------------ACTION: Disable Communication----------------------*/
    
    Dis_Comm_phy();
    testWaitForTimeout(100);
    
    /*-------------------------------Test Step 26--------------------------------------*/ 
    /*-----------------------------ACTION: Security unlock Level 5----------------------------------------*/
    ACTION("Checking whether a valid Seed [non-zero, non-FF] for Security Level 5 is recieved or not");
    Security_Unlock_With_Key_lvl_5_Phy();
    
    testWaitForTimeout(5000);
    
    /*-------------------------------Test Step 27--------------------------------------*/ 
    /*-----------------------------ACTION: Enter Programming_Session-------------------------------------*/
     Programming_Session_Phy();
    
    /*-------------------------------Test Step 28--------------------------------------*/ 
    /*-----------------------------ACTION: Enter Default Session ----------------------------------------*/
    STEP();
    ACTION("Enter Default Session"); //Default Session in boot P2 and P2* timer will be different 
    send_on_CAN(0x02,0x10,0x01,0x55,0x55,0x55,0x55,0x55);
    testWaitForTimeout(100);
    Expect(0x06,0x50,0x01,0x00,0x64,0x0B,0xB8,0x55);
    EXPECTED_DATA("",E_Resp,8);
    OBSERVED_DATA("",O_Resp,8);
    Check(E_Resp,O_Resp);  
    Clear_Buffer();   
    
    
    testWaitForTimeout(1000);
    
    /*-------------------------------Test Step 29--------------------------------------*/ 
    /*-----------------------------ACTION: Enter Extended Session ---------------------------------------*/
    Extended_Session_Phy();
    
    /*-------------------------------Test Step 30--------------------------------------*/ 
    /*-----------------------------ACTION: Security unlock Level 15----------------------------------------*/
    Description_DATA("Last all 15 bytes data should be RN number, which not should be FF");
    ACTION("Checking whether a valid Seed [non-zero, non-FF] for Security Level 15 is recieved or not");
    Security_Unlock_With_Key_lvl_15_Phy();
    
    testWaitForTimeout(4000);
    
    /*-------------------------------Test Step 31--------------------------------------*/ 
    /*-----------------------------ACTION: Setting ECU to Normal mode -----------------------------------*/
    Back_To_Normal(); 
    
    stopLogging("Test Logs");
  }
  
  testcase TC30_PGS_154975()
  {
    char logPath[256] = "C:\\Users\\GID_GMSDV_ITV\\Documents\\ECU_Unlock_logs\\Autoamtion\\PGS_154975.asc"; // Change this to your desired path
    setLogFileName("Test Logs",logPath);
    startLogging("Test Logs");
    
    /*-------------------------------Test Step 1--------------------------------------*/ 
    /*-----------------------------ACTION: set Battery voltage to 12v -----------------------------------*/
   
    Set_Bat_Vol(12);
    
    /*-------------------------------Test Step 2--------------------------------------*/ 
    /*-----------------------------ACTION: Read MEC -----------------------------------------*/   
    
    Read_MEC();
    
    /*-------------------------------Test Step 23--------------------------------------*/ 
    /*-----------------------------ACTION: Set powermode to RUN -----------------------------------------*/
    @IgnitionSwitch=2;
    testWaitForTimeout(50);
    testWaitForTesterConfirmation("Check power mode");
    Read_PowerMode();  
    testWaitForTimeout(100); 
                      
    /*-------------------------------Test Step 24--------------------------------------*/ 
    /*-----------------------------ACTION: Set OTA PSF Flag to true -----------------------------------------*/                  
    STEP();
    ACTION("Set OTA PSF Flag to True"); // setting OTA PSF flag to true to unlock security level 05              
    setSignal(BSPMP_RmtProgmActvAuth,1);
    testWaitForTimeout(100);
                      

    /*-------------------------------Test Step 3--------------------------------------*/ 
    /*-----------------------------ACTION: Set powermode to OFF -----------------------------------------*/
    @IgnitionSwitch=0;
    testWaitForTimeout(100);
    Read_PowerMode();
    
    /*-------------------------------Test Step 4--------------------------------------*/ 
    /*-----------------------------ACTION: Enter Default Session ----------------------------------------*/
    Default_Session_Phy();
    
    /*-------------------------------Test Step 5--------------------------------------*/ 
    /*-----------------------------ACTION: Activating Tester Present for every 2sec----------------------*/
   
    Tester_Present_Per_Start_Fun(2000);
    
    /*-------------------------------Test Step 6--------------------------------------*/ 
    /*-----------------------------ACTION: Enter Extended Session ---------------------------------------*/
    Extended_Session_Phy();
    
    /*-------------------------------Test Step 7--------------------------------------*/ 
    /*-----------------------------ACTION: Disable DTC---------------------------------------------------*/
    Dis_DTC_Phy();
    
    /*-------------------------------Test Step 8--------------------------------------*/ 
    /*-----------------------------ACTION: Disable Communication----------------------*/
    
    Dis_Comm_phy();
    
    /*-------------------------------Test Step 9--------------------------------------*/ 
    /*-----------------------------ACTION: Security unlock Level 1----------------------------------------*/
    ACTION("Checking whether a valid Seed [non-zero, non-FF] for Security Level 1 is recieved or not");
    Security_Unlock_With_Key_lvl_1_Phy();
    
    testWaitForTimeout(5000);
    
    /*-------------------------------Test Step 10--------------------------------------*/ 
    /*-----------------------------ACTION: Write RID 21E ----------------------------------------*/
    Write_RID_21E();   //InitialRefalshFlag
    testWaitForTimeout(100);
    
    /*-------------------------------Test Step 11--------------------------------------*/ 
    /*-----------------------------ACTION: Enter Programming_Session-------------------------------------*/
     Programming_Session_Phy();
     testWaitForTimeout(100);
    
    /*-------------------------------Test Step 12--------------------------------------*/ 
    /*-----------------------------ACTION: Enter Default Session ----------------------------------------*/
    STEP();
    ACTION("Enter Default Session"); //Default Session in boot P2 and P2* timer will be different 
    send_on_CAN(0x02,0x10,0x01,0x55,0x55,0x55,0x55,0x55);
    testWaitForTimeout(100);
    Expect(0x06,0x50,0x01,0x00,0x64,0x0B,0xB8,0x55);
    EXPECTED_DATA("",E_Resp,8);
    OBSERVED_DATA("",O_Resp,8);
    Check(E_Resp,O_Resp);  
    Clear_Buffer();   
    
    
    testWaitForTimeout(1000);
    
    /*-------------------------------Test Step 13--------------------------------------*/ 
    /*-----------------------------ACTION: Enter Extended Session ---------------------------------------*/
    Extended_Session_Phy();
    
    /*-------------------------------Test Step 14--------------------------------------*/ 
    /*-----------------------------ACTION: Security unlock Level 13----------------------------------------*/
    Description_DATA("Last all 15 bytes data should be RN number, which not should be FF");
    ACTION("Checking whether a valid Seed [non-zero, non-FF] for Security Level 13 is recieved or not");
    if (mec_value==0)
    {
      STEP();
      ACTION("Unlock Security Level 13 with Valid [Key]"); //Unlock Security Level 13
      @SecurityAccess::Security_Level=19;
      testWaitForTimeout(50);
      putValue(APT_UnlockEcu,1);
      testWaitForTimeout(500);
      OBSERVED_DATA("",O_Resp,40);
    
      if(O_Resp[2]==0x67 && O_Resp[3]==0x13)
         {
             for(j=0; j<38 ;j++)
             {
               if(O_Resp[j]==0xFF)
               {
                 Invalidcount ++;
               }
             }
             
             if(Invalidcount >= 15)
             {
               ACTION("RN should not be FF");
               AddToReport(FAILED);
               Invalidcount=0;
             }
             else
             {
                Expect1(0x10,0x21,0x67,0x13,O_Resp[4],O_Resp[5],O_Resp[6],O_Resp[7]);
                testWaitForTimeout(50);
                Expect2(O_Resp[8],O_Resp[9],O_Resp[10],O_Resp[11],O_Resp[12],O_Resp[13],O_Resp[14],O_Resp[15]);
                testWaitForTimeout(50);
                Expect3(O_Resp[16],O_Resp[17],O_Resp[18],O_Resp[19],O_Resp[20],O_Resp[21],O_Resp[22],O_Resp[23]);
                testWaitForTimeout(50);
                Expect4(O_Resp[24],O_Resp[25],O_Resp[26],O_Resp[27],O_Resp[28],O_Resp[29],O_Resp[30],O_Resp[31]);
                testWaitForTimeout(50);
                Expect5(O_Resp[32],O_Resp[33],O_Resp[34],O_Resp[35],O_Resp[36],O_Resp[37],O_Resp[38],O_Resp[39]);
                testWaitForTimeout(50);
               
                Check(E_Resp,O_Resp);
                Clear_Buffer(); 
                Invalidcount=0;
             }
  
         }
         
      else
         {
           Expect(O_Resp[0],O_Resp[1],O_Resp[2],O_Resp[3],O_Resp[4],O_Resp[5],O_Resp[6],O_Resp[7]);
           AddToReport(FAILED);
         }
    }
    
    testWaitForTimeout(5000);
    
    /*-------------------------------Test Step 15--------------------------------------*/ 
    /*-----------------------------ACTION: Disable DTC---------------------------------------------------*/
    Dis_DTC_Phy();
    
    /*-------------------------------Test Step 16--------------------------------------*/ 
    /*-----------------------------ACTION: Disable Communication----------------------*/
    
    Dis_Comm_phy();
    
    /*-------------------------------Test Step 17--------------------------------------*/ 
    /*-----------------------------ACTION: Security unlock Level 3----------------------------------------*/
    ACTION("Checking whether a valid Seed [non-zero, non-FF] for Security Level 3 is recieved or not");
    Security_Unlock_With_Key_lvl_3_Phy();
    
    testWaitForTimeout(5000);
    
    /*-------------------------------Test Step 18--------------------------------------*/ 
    /*-----------------------------ACTION: Write RID 21E ----------------------------------------*/
    Write_RID_21E();   //InitialRefalshFlag
    
    /*-------------------------------Test Step 19--------------------------------------*/ 
    /*-----------------------------ACTION: Enter Programming_Session-------------------------------------*/
     Programming_Session_Phy();
    
    /*-------------------------------Test Step 20--------------------------------------*/ 
    /*-----------------------------ACTION: Enter Default Session ----------------------------------------*/
    STEP();
    ACTION("Enter Default Session"); //Default Session in boot P2 and P2* timer will be different 
    send_on_CAN(0x02,0x10,0x01,0x55,0x55,0x55,0x55,0x55);
    testWaitForTimeout(100);
    Expect(0x06,0x50,0x01,0x00,0x64,0x0B,0xB8,0x55);
    EXPECTED_DATA("",E_Resp,8);
    OBSERVED_DATA("",O_Resp,8);
    Check(E_Resp,O_Resp);  
    Clear_Buffer();   
    
    
    testWaitForTimeout(1000);
    
    /*-------------------------------Test Step 21--------------------------------------*/ 
    /*-----------------------------ACTION: Enter Extended Session ---------------------------------------*/
    Extended_Session_Phy();
    
    /*-------------------------------Test Step 22--------------------------------------*/ 
    /*-----------------------------ACTION: Security unlock Level 15----------------------------------------*/
    Description_DATA("Last all 15 bytes data should be RN number, which not should be FF");
    ACTION("Checking whether a valid Seed [non-zero, non-FF] for Security Level 15 is recieved or not");
    if (mec_value==0)
    {
      STEP();
      ACTION("Unlock Security Level 15 with Valid [Key]"); //Unlock Security Level 15
      @SecurityAccess::Security_Level=21;
      testWaitForTimeout(50);
      putValue(APT_UnlockEcu,1);
      testWaitForTimeout(500);
      OBSERVED_DATA("",O_Resp,40);
    
      if(O_Resp[2]==0x67 && O_Resp[3]==0x15)
         {
             for(j=0; j<38 ;j++)
             {
               if(O_Resp[j]==0xFF)
               {
                 Invalidcount ++;
               }
             }
             
             if(Invalidcount >= 15)
             {
               ACTION("RN should not be FF");
               AddToReport(FAILED);
               Invalidcount=0;
             }
             else
             {
                Expect1(0x10,0x21,0x67,0x15,O_Resp[4],O_Resp[5],O_Resp[6],O_Resp[7]);
                testWaitForTimeout(50);
                Expect2(O_Resp[8],O_Resp[9],O_Resp[10],O_Resp[11],O_Resp[12],O_Resp[13],O_Resp[14],O_Resp[15]);
                testWaitForTimeout(50);
                Expect3(O_Resp[16],O_Resp[17],O_Resp[18],O_Resp[19],O_Resp[20],O_Resp[21],O_Resp[22],O_Resp[23]);
                testWaitForTimeout(50);
                Expect4(O_Resp[24],O_Resp[25],O_Resp[26],O_Resp[27],O_Resp[28],O_Resp[29],O_Resp[30],O_Resp[31]);
                testWaitForTimeout(50);
                Expect5(O_Resp[32],O_Resp[33],O_Resp[34],O_Resp[35],O_Resp[36],O_Resp[37],O_Resp[38],O_Resp[39]);
                testWaitForTimeout(50);
               
                Check(E_Resp,O_Resp);
                Clear_Buffer(); 
                Invalidcount=0;
             }
  
         }
         
      else
         {
           Expect(O_Resp[0],O_Resp[1],O_Resp[2],O_Resp[3],O_Resp[4],O_Resp[5],O_Resp[6],O_Resp[7]);
           AddToReport(FAILED);
         }
    }
    
    testWaitForTimeout(5000);
    
    /*-------------------------------Test Step 26--------------------------------------*/ 
    /*-----------------------------ACTION: Disable DTC---------------------------------------------------*/
    Dis_DTC_Phy();
    testWaitForTimeout(250);
    
    /*-------------------------------Test Step 27--------------------------------------*/ 
    /*-----------------------------ACTION: Disable Communication----------------------*/
    
    Dis_Comm_phy();
    testWaitForTimeout(250);
    
    /*-------------------------------Test Step 28--------------------------------------*/ 
    /*-----------------------------ACTION: Security unlock Level 5----------------------------------------*/
    ACTION("Checking whether a valid Seed [non-zero, non-FF] for Security Level 5 is recieved or not");
    Security_Unlock_With_Key_lvl_5_Phy();
    
    testWaitForTimeout(5000);
    
    /*-------------------------------Test Step 29--------------------------------------*/ 
    /*-----------------------------ACTION: Write RID 21E ----------------------------------------*/
    Write_RID_21E();   //InitialRefalshFlag
    testWaitForTimeout(100);
    
    /*-------------------------------Test Step 30--------------------------------------*/ 
    /*-----------------------------ACTION: Enter Programming_Session-------------------------------------*/
     Programming_Session_Phy();
     testWaitForTimeout(100);
    
    /*-------------------------------Test Step 31--------------------------------------*/ 
    /*-----------------------------ACTION: Enter Default Session ----------------------------------------*/
    STEP();
    ACTION("Enter Default Session"); //Default Session in boot P2 and P2* timer will be different 
    send_on_CAN(0x02,0x10,0x01,0x55,0x55,0x55,0x55,0x55);
    testWaitForTimeout(100);
    Expect(0x06,0x50,0x01,0x00,0x64,0x0B,0xB8,0x55);
    EXPECTED_DATA("",E_Resp,8);
    OBSERVED_DATA("",O_Resp,8);
    Check(E_Resp,O_Resp);  
    Clear_Buffer();   
    
    
    testWaitForTimeout(1000);
    
    /*-------------------------------Test Step 32--------------------------------------*/ 
    /*-----------------------------ACTION: Enter Extended Session ---------------------------------------*/
    Extended_Session_Phy();
    
    /*-------------------------------Test Step 33--------------------------------------*/ 
    /*-----------------------------ACTION: Security unlock Level 11----------------------------------------*/
    Description_DATA("Last all 15 bytes data should be RN number, which not should be FF");
    ACTION("Checking whether a valid Seed [non-zero, non-FF] for Security Level 11 is recieved or not");
    if (mec_value==0)
    {
      STEP();
      ACTION("Unlock Security Level 11 with Valid [Key]"); //Unlock Security Level 11
      @SecurityAccess::Security_Level=17;
      testWaitForTimeout(50);
      putValue(APT_UnlockEcu,1);
      testWaitForTimeout(500);
      OBSERVED_DATA("",O_Resp,40);
    
      if(O_Resp[2]==0x67 && O_Resp[3]==0x11)
         {
             for(j=0; j<38 ;j++)
             {
               if(O_Resp[j]==0xFF)
               {
                 Invalidcount ++;
               }
             }
             
             if(Invalidcount >= 15)
             {
               ACTION("RN should not be FF");
               AddToReport(FAILED);
               Invalidcount=0;
             }
             else
             {
                Expect1(0x10,0x21,0x67,0x11,O_Resp[4],O_Resp[5],O_Resp[6],O_Resp[7]);
                testWaitForTimeout(50);
                Expect2(O_Resp[8],O_Resp[9],O_Resp[10],O_Resp[11],O_Resp[12],O_Resp[13],O_Resp[14],O_Resp[15]);
                testWaitForTimeout(50);
                Expect3(O_Resp[16],O_Resp[17],O_Resp[18],O_Resp[19],O_Resp[20],O_Resp[21],O_Resp[22],O_Resp[23]);
                testWaitForTimeout(50);
                Expect4(O_Resp[24],O_Resp[25],O_Resp[26],O_Resp[27],O_Resp[28],O_Resp[29],O_Resp[30],O_Resp[31]);
                testWaitForTimeout(50);
                Expect5(O_Resp[32],O_Resp[33],O_Resp[34],O_Resp[35],O_Resp[36],O_Resp[37],O_Resp[38],O_Resp[39]);
                testWaitForTimeout(50);
               
                Check(E_Resp,O_Resp);
                Clear_Buffer(); 
                Invalidcount=0;
             }
  
         }
         
      else
         {
           Expect(O_Resp[0],O_Resp[1],O_Resp[2],O_Resp[3],O_Resp[4],O_Resp[5],O_Resp[6],O_Resp[7]);
           AddToReport(FAILED);
         }
    }
    
    testWaitForTimeout(5000);
    
    /*-------------------------------Test Step 34--------------------------------------*/ 
    /*-----------------------------ACTION: Setting ECU to Normal mode -----------------------------------*/
    Back_To_Normal(); 
    
    stopLogging("Test Logs");
  }
  
  testcase TC31_PGS_155117()
  {
    char logPath[256] = "C:\\Users\\GID_GMSDV_ITV\\Documents\\ECU_Unlock_logs\\PGS_155117.asc"; // Change this to your desired path
    setLogFileName("Test Logs",logPath);
    startLogging("Test Logs");
    
    /*-------------------------------Test Step 1--------------------------------------*/ 
    /*-----------------------------ACTION: set Battery voltage to 12v -----------------------------------*/
   
    Set_Bat_Vol(12);
    
    /*-------------------------------Test Step 2--------------------------------------*/ 
    /*-----------------------------ACTION: Read MEC -----------------------------------------*/   
    
    Read_MEC();
    
    /*-------------------------------Test Step 3--------------------------------------*/ 
    /*-----------------------------ACTION: Set powermode to OFF -----------------------------------------*/
    @IgnitionSwitch=0;
    Read_PowerMode();
    
    /*-------------------------------Test Step 4--------------------------------------*/ 
    /*-----------------------------ACTION: Enter Default Session ----------------------------------------*/
    Default_Session_Phy();
    
    /*-------------------------------Test Step 5--------------------------------------*/ 
    /*-----------------------------ACTION: Activating Tester Present for every 2sec----------------------*/
   
    Tester_Present_Per_Start_Fun(2000);
    
    /*-------------------------------Test Step 6--------------------------------------*/ 
    /*-----------------------------ACTION: Enter Extended Session ---------------------------------------*/
    Extended_Session_Phy();
    
    /*-------------------------------Test Step 7--------------------------------------*/ 
    /*-----------------------------ACTION: Security unlock Level 11----------------------------------------*/   
      Security_Unlock_Seed_lvl_11_Phy();
      testWaitForTimeout(500);
    
      STEP();
      ACTION("Unlock Security Level 11 with Invalid key"); //Unlock Security Level 11 with Invalid key
      send_on_CAN(0x10,0x0E,0x27,0x12,0x00,0x00,0x00,0x00);
      testWaitForTimeout(50);
      send_on_CAN(0x21,0x00,0x00,0x00,0x00,0x00,0x00,0x00);
      testWaitForTimeout(50);
      send_on_CAN(0x22,0x00,0x00,0xAA,0xAA,0xAA,0xAA,0xAA);     
      testWaitForTimeout(200);
      Expect(0x03,0x7F,0x27,0x35,0xAA,0xAA,0xAA,0xAA);
      testWaitForTimeout(50);
      EXPECTED_DATA("",E_Resp,8);
      OBSERVED_DATA("",O_Resp,8);
      Check(E_Resp,O_Resp);  
      Clear_Buffer(); 
    
      testWaitForTimeout(1000);
    
    /*-------------------------------Test Step 8--------------------------------------*/ 
    /*-----------------------------ACTION: Write RID 200 for any 1 Slot----------------------------------------*/
     
      STEP();
      ACTION("Write RID 200 for any 1 Slot"); //Write RID 200 for any 1 Slot
      send_on_CAN(0x10,0x45,0x31,0x01,0x02,0x00,0x02,0x00);
      testWaitForTimeout(50);
      send_on_CAN(0x21,0x00,0x00,0x00,0x00,0x00,0x00,0x00);
      testWaitForTimeout(50);
      send_on_CAN(0x22,0x00,0x00,0x00,0x00,0x00,0x00,0x00);     
      testWaitForTimeout(50);
      send_on_CAN(0x23,0x55,0xDF,0x2E,0x9E,0x35,0xD9,0x5B);
      testWaitForTimeout(50);
      send_on_CAN(0x24,0x84,0x90,0x20,0x70,0xEF,0xF6,0xE5);
      testWaitForTimeout(50);
      send_on_CAN(0x25,0x35,0x4F,0xC9,0x05,0x9A,0x2D,0xDB);     
      testWaitForTimeout(200);
      send_on_CAN(0x26,0x9C,0x0B,0xD6,0x6E,0x46,0x76,0xF1);     
      testWaitForTimeout(50); 
      send_on_CAN(0x27,0xED,0x20,0xA2,0xFB,0x4B,0x2F,0x08);     
      testWaitForTimeout(50);
      send_on_CAN(0x28,0x4B,0x94,0x02,0xA5,0x31,0xC7,0x31);     
      testWaitForTimeout(50);
      send_on_CAN(0x29,0x8B,0x60,0x8B,0xDC,0x2A,0x10,0xD8);     
    
      testWaitForTimeout(200);
    
      Expect(0x03,0x7F,0x31,0x33,0xAA,0xAA,0xAA,0xAA);
      testWaitForTimeout(50);
      EXPECTED_DATA("",E_Resp,8);
      OBSERVED_DATA("",O_Resp,8);
      Check(E_Resp,O_Resp);  
      Clear_Buffer(); 
    
      testWaitForTimeout(1000);
    
    /*-------------------------------Test Step 9--------------------------------------*/ 
    /*-----------------------------ACTION: Enter Extended Session ---------------------------------------*/
    Extended_Session_Phy();
    
    /*-------------------------------Test Step 10--------------------------------------*/ 
    /*-----------------------------ACTION: Security unlock Level 13----------------------------------------*/   
      Security_Unlock_Seed_lvl_13_Phy();
      testWaitForTimeout(500);
    
      STEP();
      ACTION("Unlock Security Level 13 with Invalid key"); //Unlock Security Level 13 with Invalid key
      send_on_CAN(0x10,0x0E,0x27,0x14,0x00,0x00,0x00,0x00);
      testWaitForTimeout(50);
      send_on_CAN(0x21,0x00,0x00,0x00,0x00,0x00,0x00,0x00);
      testWaitForTimeout(50);
      send_on_CAN(0x22,0x00,0x00,0xAA,0xAA,0xAA,0xAA,0xAA);     
      testWaitForTimeout(200);
      Expect(0x03,0x7F,0x27,0x35,0xAA,0xAA,0xAA,0xAA);
      testWaitForTimeout(50);
      EXPECTED_DATA("",E_Resp,8);
      OBSERVED_DATA("",O_Resp,8);
      Check(E_Resp,O_Resp);  
      Clear_Buffer(); 
    
      testWaitForTimeout(1000);
    
    /*-------------------------------Test Step 11--------------------------------------*/ 
    /*-----------------------------ACTION: Write RID 0204 ----------------------------------------*/
    
    STEP();
    ACTION("Write RID 0204"); //Write RID 0204 
    send_on_CAN(0x04,0x31,0x01,0x02,0x04,0x55,0x55,0x55);
    testWaitForTimeout(100);
    Expect(0x03,0x7F,0x31,0x33,0xAA,0xAA,0xAA,0xAA);
    EXPECTED_DATA("",E_Resp,8);
    OBSERVED_DATA("",O_Resp,8);
    Check(E_Resp,O_Resp);  
    Clear_Buffer();   
    
    
    testWaitForTimeout(1000);
    
    /*-------------------------------Test Step 12--------------------------------------*/ 
    /*-----------------------------ACTION: Enter Extended Session ---------------------------------------*/
    Extended_Session_Phy();
    
    /*-------------------------------Test Step 13--------------------------------------*/ 
    /*-----------------------------ACTION: Security unlock Level 15----------------------------------------*/   
      Security_Unlock_Seed_lvl_15_Phy();
      testWaitForTimeout(500);
    
      STEP();
      ACTION("Unlock Security Level 15 with Invalid key"); //Unlock Security Level 15 with Invalid key
      send_on_CAN(0x10,0x0E,0x27,0x16,0x00,0x00,0x00,0x00);
      testWaitForTimeout(50);
      send_on_CAN(0x21,0x00,0x00,0x00,0x00,0x00,0x00,0x00);
      testWaitForTimeout(50);
      send_on_CAN(0x22,0x00,0x00,0xAA,0xAA,0xAA,0xAA,0xAA);     
      testWaitForTimeout(200);
      Expect(0x03,0x7F,0x27,0x35,0xAA,0xAA,0xAA,0xAA);
      testWaitForTimeout(50);
      EXPECTED_DATA("",E_Resp,8);
      OBSERVED_DATA("",O_Resp,8);
      Check(E_Resp,O_Resp);  
      Clear_Buffer(); 
    
      testWaitForTimeout(1000);
    
    /*-------------------------------Test Step 14--------------------------------------*/ 
    /*-----------------------------ACTION: Writing DID F190 --------------------*/
    STEP();
    ACTION("Write DID F190 ");                                                    //Writing DID F190
    send_on_CAN(0x10,0x14,0x2E,0xF1,0x90,0x01,0x02,0x03);                         
    testWaitForTimeout(50);
    send_on_CAN(0x21,0x04,0x05,0x06,0x07,0x08,0x09,0x10);                         
    testWaitForTimeout(50);
    send_on_CAN(0x22,0x11,0x12,0x13,0x14,0x15,0x16,0x17);                         
    testWaitForTimeout(200);
    Expect(0x03,0x7F,0x2E,0x33,0xAA,0xAA,0xAA,0xAA);
    EXPECTED_DATA("",E_Resp,0X8);
    OBSERVED_DATA("",O_Resp,0X8);
    Check(E_Resp,O_Resp);  
    Clear_Buffer();   

    testWaitForTimeout(1000);
    
    /*-------------------------------Test Step 15--------------------------------------*/ 
    /*-----------------------------ACTION: Setting ECU to Normal mode -----------------------------------*/
    Back_To_Normal(); 
    stopLogging("Test Logs");
  }
  
  testcase TC32_PGS_155069()
  {
    char logPath[256] = "C:\\Users\\GID_GMSDV_ITV\\Documents\\ECU_Unlock_logs\\Autoamtion\\PGS_155069.asc"; // Change this to your desired path
    setLogFileName("Test Logs",logPath);
    startLogging("Test Logs");
    
     /*-------------------------------Test Step 16--------------------------------------*/ 
    /*-----------------------------ACTION: set Battery voltage to 12v -----------------------------------*/
   
    Set_Bat_Vol(12);
    
    /*-------------------------------Test Step 17--------------------------------------*/ 
    /*-----------------------------ACTION: Read MEC -----------------------------------------*/   
    
    Read_MEC();
    
    /*-------------------------------Test Step 18--------------------------------------*/ 
    /*-----------------------------ACTION: Set powermode to OFF -----------------------------------------*/
    @IgnitionSwitch=0;
    Read_PowerMode();
    
    /*-------------------------------Test Step 19--------------------------------------*/ 
    /*-----------------------------ACTION: Enter Default Session ----------------------------------------*/
    Default_Session_Phy();
    
    /*-------------------------------Test Step 20--------------------------------------*/ 
    /*-----------------------------ACTION: Activating Tester Present for every 2sec----------------------*/
   
    Tester_Present_Per_Start_Fun(2000);
    
    /*-------------------------------Test Step 21--------------------------------------*/ 
    /*-----------------------------ACTION: Enter Extended Session ---------------------------------------*/
    Extended_Session_Phy();
    
    /*-------------------------------Test Step 22--------------------------------------*/ 
    /*-----------------------------ACTION: Disable DTC---------------------------------------------------*/
    Dis_DTC_Phy();
    
    /*-------------------------------Test Step 23--------------------------------------*/ 
    /*-----------------------------ACTION: Disable Communication----------------------*/
    
    Dis_Comm_phy();
    
    /*-------------------------------Test Step 24--------------------------------------*/ 
    /*-----------------------------ACTION: Security unlock Level 1----------------------------------------*/
    ACTION("Checking whether a valid Seed [non-zero, non-FF] for Security Level 1 is recieved or not");
    Security_Unlock_With_Key_lvl_1_Phy();
    
    testWaitForTimeout(5000);
    
    /*-------------------------------Test Step 25--------------------------------------*/ 
    /*-----------------------------ACTION: Write RID 21E ----------------------------------------*/
    Write_RID_21E();   //InitialRefalshFlag
    
    /*-------------------------------Test Step 26--------------------------------------*/ 
    /*-----------------------------ACTION: Enter Programming_Session-------------------------------------*/
     Programming_Session_Phy();
    
    /*-------------------------------Test Step 27--------------------------------------*/ 
    /*-----------------------------ACTION: Enter Default Session ----------------------------------------*/
    STEP();
    ACTION("Enter Default Session"); //Default Session in boot P2 and P2* timer will be different 
    send_on_CAN(0x02,0x10,0x01,0x55,0x55,0x55,0x55,0x55);
    testWaitForTimeout(100);
    Expect(0x06,0x50,0x01,0x00,0x64,0x0B,0xB8,0x55);
    EXPECTED_DATA("",E_Resp,8);
    OBSERVED_DATA("",O_Resp,8);
    Check(E_Resp,O_Resp);  
    Clear_Buffer();   
    
    
    testWaitForTimeout(1000);
    
    /*-------------------------------Test Step 28--------------------------------------*/ 
    /*-----------------------------ACTION: Enter Extended Session ---------------------------------------*/
    Extended_Session_Phy();
    
    /*-------------------------------Test Step 29--------------------------------------*/ 
    /*-----------------------------ACTION: Security unlock Level 11----------------------------------------*/
 
    STEP();
    Description_DATA("Last all 15 bytes data should be RN number, which not should be FF");
    ACTION("Security unlock seed 11 checking RN received as FF "); //Security unlock seed 11
    send_on_CAN(0x02,0x27,0x11,0x55,0x55,0x55,0x55,0x55);
    testWaitForTimeout(300);
                Expect1(0x10,0x21,0x67,0x11,O_Resp[4],O_Resp[5],O_Resp[6],O_Resp[7]);
                testWaitForTimeout(50);
                Expect2(O_Resp[8],O_Resp[9],O_Resp[10],O_Resp[11],O_Resp[12],O_Resp[13],O_Resp[14],O_Resp[15]);
                testWaitForTimeout(50);
                Expect3(O_Resp[16],O_Resp[17],O_Resp[18],O_Resp[19],O_Resp[20],O_Resp[21],O_Resp[22],O_Resp[23]);
                testWaitForTimeout(50);
                Expect4(O_Resp[24],O_Resp[25],O_Resp[26],O_Resp[27],O_Resp[28],O_Resp[29],O_Resp[30],O_Resp[31]);
                testWaitForTimeout(50);
                Expect5(O_Resp[32],O_Resp[33],O_Resp[34],O_Resp[35],O_Resp[36],O_Resp[37],O_Resp[38],O_Resp[39]);
                testWaitForTimeout(50);
                EXPECTED_DATA("",E_Resp,40);
                OBSERVED_DATA("",O_Resp,40);
                      for(h=0; h<40; h++)
                          {
                             if(O_Resp[h]==0xFF)
                               {
                                 seeds++;
                               }    
                          }
                      if(seeds>=15)
                      {
                        AddToReport(PASSED);
                      }
                      else
                      {
                        AddToReport(FAILED);
                      }
                Clear_Buffer();
     testWaitForTimeout(2000);
       
    /*-------------------------------Test Step 30--------------------------------------*/ 
    /*-----------------------------ACTION: Security unlock Level 11 with invalid key ---------------------------------------*/
      STEP();
      ACTION("Unlock Security Level 11 with Invalid key"); //Unlock Security Level 11 with Invalid key
      send_on_CAN(0x10,0x0E,0x27,0x12,0x00,0x00,0x00,0x00);
      testWaitForTimeout(50);
      send_on_CAN(0x21,0x00,0x00,0x00,0x00,0x00,0x00,0x00);
      testWaitForTimeout(50);
      send_on_CAN(0x22,0x00,0x00,0xAA,0xAA,0xAA,0xAA,0xAA);     
      testWaitForTimeout(200);
      Expect(0x03,0x7F,0x27,0x35,0xAA,0xAA,0xAA,0xAA);
      testWaitForTimeout(50);
      EXPECTED_DATA("",E_Resp,8);
      OBSERVED_DATA("",O_Resp,8);
      Check(E_Resp,O_Resp);  
      Clear_Buffer(); 
    
      testWaitForTimeout(1000); 
      
    /*-------------------------------Test Step 31--------------------------------------*/ 
    /*-----------------------------ACTION: Write RID 0205 ----------------------------------------*/
    
    STEP();
    ACTION("Write RID 0205"); //Write RID 0205
    send_on_CAN(0x04,0x31,0x01,0x02,0x05,0x55,0x55,0x55);
    testWaitForTimeout(100);
    Expect(0x03,0x7F,0x31,0x33,0xAA,0xAA,0xAA,0xAA);
    EXPECTED_DATA("",E_Resp,8);
    OBSERVED_DATA("",O_Resp,8);
    Check(E_Resp,O_Resp);  
    Clear_Buffer();   
    
    
    testWaitForTimeout(1000);
                      
    /*-------------------------------Test Step 32--------------------------------------*/ 
    /*-----------------------------ACTION: Enter Extended Session ---------------------------------------*/
    Extended_Session_Phy();
    
    /*-------------------------------Test Step 33--------------------------------------*/ 
    /*-----------------------------ACTION: Disable DTC---------------------------------------------------*/
    Dis_DTC_Phy();
    testWaitForTimeout(100);
                      
    /*-------------------------------Test Step 34--------------------------------------*/ 
    /*-----------------------------ACTION: Disable Communication----------------------*/
    
    Dis_Comm_phy();
    
    /*-------------------------------Test Step 35--------------------------------------*/ 
    /*-----------------------------ACTION: Security unlock Level 3----------------------------------------*/
    ACTION("Checking whether a valid Seed [non-zero, non-FF] for Security Level 3 is recieved or not");
    Security_Unlock_With_Key_lvl_3_Phy();
    
    testWaitForTimeout(5000);
    
    /*-------------------------------Test Step 36--------------------------------------*/ 
    /*-----------------------------ACTION: Write RID 21E ----------------------------------------*/
    Write_RID_21E();   //InitialRefalshFlag
    
    /*-------------------------------Test Step 37--------------------------------------*/ 
    /*-----------------------------ACTION: Enter Programming_Session-------------------------------------*/
     Programming_Session_Phy();
    
    /*-------------------------------Test Step 38--------------------------------------*/ 
    /*-----------------------------ACTION: Enter Default Session ----------------------------------------*/
    STEP();
    ACTION("Enter Default Session"); //Default Session in boot P2 and P2* timer will be different 
    send_on_CAN(0x02,0x10,0x01,0x55,0x55,0x55,0x55,0x55);
    testWaitForTimeout(100);
    Expect(0x06,0x50,0x01,0x00,0x64,0x0B,0xB8,0x55);
    EXPECTED_DATA("",E_Resp,8);
    OBSERVED_DATA("",O_Resp,8);
    Check(E_Resp,O_Resp);  
    Clear_Buffer();   
    
    
    testWaitForTimeout(1000);
    
    /*-------------------------------Test Step 39--------------------------------------*/ 
    /*-----------------------------ACTION: Enter Extended Session ---------------------------------------*/
    Extended_Session_Phy();
    
    /*-------------------------------Test Step 40--------------------------------------*/ 
    /*-----------------------------ACTION: Security unlock Level 13----------------------------------------*/
 
    STEP();
    Description_DATA("Last all 15 bytes data should be RN number, which not should be FF");
    ACTION("Security unlock seed 13 checking RN received as FF "); //Security unlock seed 13
    send_on_CAN(0x02,0x27,0x13,0x55,0x55,0x55,0x55,0x55);
    testWaitForTimeout(300);
                Expect1(0x10,0x21,0x67,0x13,O_Resp[4],O_Resp[5],O_Resp[6],O_Resp[7]);
                testWaitForTimeout(50);
                Expect2(O_Resp[8],O_Resp[9],O_Resp[10],O_Resp[11],O_Resp[12],O_Resp[13],O_Resp[14],O_Resp[15]);
                testWaitForTimeout(50);
                Expect3(O_Resp[16],O_Resp[17],O_Resp[18],O_Resp[19],O_Resp[20],O_Resp[21],O_Resp[22],O_Resp[23]);
                testWaitForTimeout(50);
                Expect4(O_Resp[24],O_Resp[25],O_Resp[26],O_Resp[27],O_Resp[28],O_Resp[29],O_Resp[30],O_Resp[31]);
                testWaitForTimeout(50);
                Expect5(O_Resp[32],O_Resp[33],O_Resp[34],O_Resp[35],O_Resp[36],O_Resp[37],O_Resp[38],O_Resp[39]);
                testWaitForTimeout(50);
                EXPECTED_DATA("",E_Resp,40);
                OBSERVED_DATA("",O_Resp,40);
                      for(h=0; h<40; h++)
                          {
                             if(O_Resp[h]==0xFF)
                               {
                                 seeds++;
                               }    
                          }
                      if(seeds>=15)
                      {
                        AddToReport(PASSED);
                      }
                      else
                      {
                        AddToReport(FAILED);
                      }
                Clear_Buffer();
     testWaitForTimeout(2000);
       
    /*-------------------------------Test Step 41--------------------------------------*/ 
    /*-----------------------------ACTION: Security unlock Level 13 with invalid key ---------------------------------------*/
      STEP();
      ACTION("Unlock Security Level 13 with Invalid key"); //Unlock Security Level 13 with Invalid key
      send_on_CAN(0x10,0x0E,0x27,0x14,0x00,0x00,0x00,0x00);
      testWaitForTimeout(50);
      send_on_CAN(0x21,0x00,0x00,0x00,0x00,0x00,0x00,0x00);
      testWaitForTimeout(50);
      send_on_CAN(0x22,0x00,0x00,0xAA,0xAA,0xAA,0xAA,0xAA);     
      testWaitForTimeout(200);
      Expect(0x03,0x7F,0x27,0x35,0xAA,0xAA,0xAA,0xAA);
      testWaitForTimeout(50);
      EXPECTED_DATA("",E_Resp,8);
      OBSERVED_DATA("",O_Resp,8);
      Check(E_Resp,O_Resp);  
      Clear_Buffer(); 
    
      testWaitForTimeout(1000); 
                      
    /*-------------------------------Test Step 42--------------------------------------*/ 
    /*-----------------------------ACTION: Write RID 200 for any 1 Slot----------------------------------------*/
     
      STEP();
      ACTION("Write RID 200 for any 1 Slot"); //Write RID 200 for any 1 Slot
      send_on_CAN(0x10,0x45,0x31,0x01,0x02,0x00,0x02,0x00);
      testWaitForTimeout(50);
      send_on_CAN(0x21,0x00,0x00,0x00,0x00,0x00,0x00,0x00);
      testWaitForTimeout(50);
      send_on_CAN(0x22,0x00,0x00,0x00,0x00,0x00,0x00,0x00);     
      testWaitForTimeout(50);
      send_on_CAN(0x23,0x55,0xDF,0x2E,0x9E,0x35,0xD9,0x5B);
      testWaitForTimeout(50);
      send_on_CAN(0x24,0x84,0x90,0x20,0x70,0xEF,0xF6,0xE5);
      testWaitForTimeout(50);
      send_on_CAN(0x25,0x35,0x4F,0xC9,0x05,0x9A,0x2D,0xDB);     
      testWaitForTimeout(200);
      send_on_CAN(0x26,0x9C,0x0B,0xD6,0x6E,0x46,0x76,0xF1);     
      testWaitForTimeout(50); 
      send_on_CAN(0x27,0xED,0x20,0xA2,0xFB,0x4B,0x2F,0x08);     
      testWaitForTimeout(50);
      send_on_CAN(0x28,0x4B,0x94,0x02,0xA5,0x31,0xC7,0x31);     
      testWaitForTimeout(50);
      send_on_CAN(0x29,0x8B,0x60,0x8B,0xDC,0x2A,0x10,0xD8);     
    
      testWaitForTimeout(200);
    
      Expect(0x03,0x7F,0x31,0x33,0xAA,0xAA,0xAA,0xAA);
      testWaitForTimeout(50);
      EXPECTED_DATA("",E_Resp,8);
      OBSERVED_DATA("",O_Resp,8);
      Check(E_Resp,O_Resp);  
      Clear_Buffer(); 
    
      testWaitForTimeout(1000); 
                      
    /*-------------------------------Test Step 43-------------------------------------*/ 
    /*-----------------------------ACTION: Enter Extended Session ---------------------------------------*/
    Extended_Session_Phy();
                      
    /*-------------------------------Test Step 44--------------------------------------*/ 
    /*-----------------------------ACTION: Set powermode to RUN -----------------------------------------*/
    @IgnitionSwitch=2;
    testWaitForTimeout(250);
    Read_PowerMode();  
    testWaitForTimeout(300); 
                      
    /*-------------------------------Test Step 45--------------------------------------*/ 
    /*-----------------------------ACTION: Set OTA PSF Flag to true -----------------------------------------*/                  
    STEP();
    ACTION("Set OTA PSF Flag to True"); // setting OTA PSF flag to true to unlock security level 05              
    setSignal(BSPMP_RmtProgmActvAuth,1);
    testWaitForTimeout(50);
                      
    /*-------------------------------Test Step 46--------------------------------------*/ 
    /*-----------------------------ACTION: Set powermode to OFF -----------------------------------------*/
    @IgnitionSwitch=0;
    testWaitForTimeout(200); 
    Read_PowerMode();   
                      
    /*-------------------------------Test Step 46--------------------------------------*/ 
    /*-----------------------------ACTION: Disable DTC---------------------------------------------------*/
    Dis_DTC_Phy();
    testWaitForTimeout(250);
                      
    /*-------------------------------Test Step 47--------------------------------------*/ 
    /*-----------------------------ACTION: Disable Communication------------------------------------------*/
    
    Dis_Comm_phy(); 
    
    /*-------------------------------Test Step 48--------------------------------------*/ 
    /*-----------------------------ACTION: Security unlock Level 5----------------------------------------*/
    ACTION("Checking whether a valid Seed [non-zero, non-FF] for Security Level 5 is recieved or not");
    Security_Unlock_With_Key_lvl_5_Phy();
    
    testWaitForTimeout(5000);                  
    
    /*-------------------------------Test Step 49--------------------------------------*/ 
    /*-----------------------------ACTION: Write RID 21E ----------------------------------------*/
    Write_RID_21E();   //InitialRefalshFlag
    
    /*-------------------------------Test Step 50--------------------------------------*/ 
    /*-----------------------------ACTION: Enter Programming_Session-------------------------------------*/
     Programming_Session_Phy();
    
    /*-------------------------------Test Step 51--------------------------------------*/ 
    /*-----------------------------ACTION: Enter Default Session ----------------------------------------*/
    STEP();
    ACTION("Enter Default Session"); //Default Session in boot P2 and P2* timer will be different 
    send_on_CAN(0x02,0x10,0x01,0x55,0x55,0x55,0x55,0x55);
    testWaitForTimeout(100);
    Expect(0x06,0x50,0x01,0x00,0x64,0x0B,0xB8,0x55);
    EXPECTED_DATA("",E_Resp,8);
    OBSERVED_DATA("",O_Resp,8);
    Check(E_Resp,O_Resp);  
    Clear_Buffer();   
    
    
    testWaitForTimeout(1000);
    
    /*-------------------------------Test Step 52--------------------------------------*/ 
    /*-----------------------------ACTION: Enter Extended Session ---------------------------------------*/
    Extended_Session_Phy();
    
    /*-------------------------------Test Step 53--------------------------------------*/ 
    /*-----------------------------ACTION: Security unlock Level 15----------------------------------------*/
    
    STEP();
    Description_DATA("Last all 15 bytes data should be RN number, which not should be FF");
    ACTION("Security unlock seed 15 checking RN received as FF "); //Security unlock seed 15
    send_on_CAN(0x02,0x27,0x15,0x55,0x55,0x55,0x55,0x55);
    testWaitForTimeout(300);
                Expect1(0x10,0x21,0x67,0x13,O_Resp[4],O_Resp[5],O_Resp[6],O_Resp[7]);
                testWaitForTimeout(50);
                Expect2(O_Resp[8],O_Resp[9],O_Resp[10],O_Resp[11],O_Resp[12],O_Resp[13],O_Resp[14],O_Resp[15]);
                testWaitForTimeout(50);
                Expect3(O_Resp[16],O_Resp[17],O_Resp[18],O_Resp[19],O_Resp[20],O_Resp[21],O_Resp[22],O_Resp[23]);
                testWaitForTimeout(50);
                Expect4(O_Resp[24],O_Resp[25],O_Resp[26],O_Resp[27],O_Resp[28],O_Resp[29],O_Resp[30],O_Resp[31]);
                testWaitForTimeout(50);
                Expect5(O_Resp[32],O_Resp[33],O_Resp[34],O_Resp[35],O_Resp[36],O_Resp[37],O_Resp[38],O_Resp[39]);
                testWaitForTimeout(50);
                EXPECTED_DATA("",E_Resp,40);
                OBSERVED_DATA("",O_Resp,40);
                      for(h=0; h<40; h++)
                          {
                             if(O_Resp[h]==0xFF)
                               {
                                 seeds++;
                               }    
                          }
                      if(seeds>=15)
                      {
                        AddToReport(PASSED);
                      }
                      else
                      {
                        AddToReport(FAILED);
                      }
                Clear_Buffer();
                      
    testWaitForTimeout(2000);
                      
    /*-------------------------------Test Step 54--------------------------------------*/ 
    /*-----------------------------ACTION: Security unlock Level 15 with invalid key ---------------------------------------*/
      STEP();
      ACTION("Unlock Security Level 15 with Invalid key"); //Unlock Security Level 15 with Invalid key
      send_on_CAN(0x10,0x0E,0x27,0x16,0x00,0x00,0x00,0x00);
      testWaitForTimeout(50);
      send_on_CAN(0x21,0x00,0x00,0x00,0x00,0x00,0x00,0x00);
      testWaitForTimeout(50);
      send_on_CAN(0x22,0x00,0x00,0xAA,0xAA,0xAA,0xAA,0xAA);     
      testWaitForTimeout(200);
      Expect(0x03,0x7F,0x27,0x35,0xAA,0xAA,0xAA,0xAA);
      testWaitForTimeout(50);
      EXPECTED_DATA("",E_Resp,8);
      OBSERVED_DATA("",O_Resp,8);
      Check(E_Resp,O_Resp);  
      Clear_Buffer(); 
    
      testWaitForTimeout(1000);
                      
    /*-------------------------------Test Step 55--------------------------------------*/ 
    /*-----------------------------ACTION: Writing DID F198 --------------------*/
    STEP();
    ACTION("Write DID F198 ");                                                    //Writing DID F198
    send_on_CAN(0x10,0x0D,0x2E,0xF1,0x98,0x02,0x03,0x04);                         
    testWaitForTimeout(50);
    send_on_CAN(0x21,0x05,0x06,0x07,0x08,0x09,0x08,0x70);                                                
    testWaitForTimeout(200);
    Expect(0x03,0x7F,0x2E,0x33,0xAA,0xAA,0xAA,0xAA);
    EXPECTED_DATA("",E_Resp,0X8);
    OBSERVED_DATA("",O_Resp,0X8);
    Check(E_Resp,O_Resp);  
    Clear_Buffer();   

    testWaitForTimeout(1000);
                      
    /*-------------------------------Test Step 56--------------------------------------*/ 
    /*-----------------------------ACTION: Setting ECU to Normal mode -----------------------------------*/
    Back_To_Normal();
  
    stopLogging("Test Logs");
                      
  }