/*@!Encoding:1252*/
includes
{
 // #include "Var_gen.cin"
//  #include "TR_Description_BZA.can"
 // #include "GPIB_Control.can"
//  #include "GPIB_Control.can"
 // #include "Dummy_var_file.cin"
}

variables
{
//  message 0x7D0 DIAG_Req;
//  message 0x7D8 DIAG_resp;
//  message 0x7DF FUN_Req;
  message can2.0x2f0 DIAG_Req_XCP;
  message can2.0x2f1 DIAG_Res_XCP;
  message CAN1.0X14DA59F1x DIAG_Req;
  message CAN1.0x14DAF159x DIAG_resp;
  message CAN1.0x10DBFEF1x FUN_Req;
  
  long GWM_KEY_VAL;
//  message 0x762 DIAG_Req_CCP;
//  message CAN2.0x7E0 XCP_Host_req = {DLC = 8};
//  message CAN2.0x7E4 XCP_Host_resp = {DLC = 8};
//  message CAN2.0x762 XCP_VFP_req = {DLC = 8};
//  message CAN2.0x763 XCP_VFP_resp = {DLC = 8};
//  message CAN2.0x623 XCP_0x623_req = {DLC = 8};
//  message CAN2.0x625 XCP_0x625_req = {DLC = 8};  

  byte DontRecordTestePresent=0,Res_buf_index;
  byte req[5000],req1[5000],xcpreq[200];
  int tbufind,rbufind,buf_index1,rbufind1,tbuf_index1,tbufind1;
  char buffer[1000];
  char load_string[200];
  //Variables used for writing
  mstimer Data_Sending,Data_Sending1,FUN_Data_Sending1;
  byte W_array[1000],write_array_buff[1000],l_temp,data_pack_cnt,length_cnt;
  int write_data[200];
  int l_temp1;
  

  //Variables used for security access
  long seed,Key_Mul,Key_Mul_Byte1,Key_temp,Key_temp_xor,Key_Byte1,Key_Byte2 ;
  
  
     //For SecurityAccess 6 bytes 
    long key_val,key_val1;
  
 //byte Capture_buffers[100] = {5	,6	,7	,9	,10	,11	,12	,13	,14	,15	,17	,18	,19	,20	,21	,22	,23	,25	,26	,27	,28	,29	,30	,31	,33	,34	,35	,36	,37	,38	,39	,41	,42	,43	,44	,45	,46	,47	,49	,50	,51	,52	,53	,54	,55	,57	,58	,59	,60	,61	,62	,63	}; 
   byte xcppanel = 0;
  byte xcpbuf[4];
  byte Host_Res[8],Host_Req_Flag_Cnt,Host_Res_Flag_Cnt;
  byte VFP_Res[8],VFP_Req_Flag_Cnt,VFP_Res_Flag_Cnt;
  
  
  long XCP_Address=0;
	byte XCP_Bitmap=0;
	byte XCP_Sign=0;
	byte XCP_Size=1;
	double XCP_Precision=255;//0.000000476837158203125;
//  long j;
  
  long XCP_VFP_Address = 0;
  byte XCP_VFP_Bitmap=0;
  byte XCP_VFP_Sign=0;
  byte XCP_VFP_Size=0;
  double XCP_VFP_Precision=255;
  
  
  byte IEEE_SINGLE_PRECISION = 255;
  byte IEEE_DOUBLE_PRECISION = 254;
  byte SaccSeed;

  
   byte O_Resp[1000]; 
  byte E_Resp[1000];
  
    byte Tx_buffer[1000];
      byte Rx_buffer[1000];
  int i,count,DTCStepCount;
  
  int buf_index,tbuf_index;
}

on message CAN1.0x14DA59F1x
{

    //Clear O_resp Buffer on receiving new diagnostic response
    if( this.byte(0) <= 0x10 )
    {
    buf_index = 0;
    for (rbufind=0;rbufind<200;rbufind++  )      
    {
      O_Resp[ rbufind ] = 0 ;      
    }
    buf_index = 0;
    }
  
    
    //Clear TX Buffer on sending new diagnostic request
    if( (this.byte(0) <= 0x10) )
     {
          for (tbufind=0;tbufind<200;tbufind++  )      
          {
            Tx_buffer[ tbufind ] = 0 ;      
          }
          tbuf_index = 0;
     }
    
     

       for (tbufind=0;tbufind<8;tbufind++  )      
         {
            Tx_buffer[ tbuf_index ] = this.byte(tbufind);  
            write("","%X-%X",tbuf_index,Tx_buffer[ tbuf_index ]);
            tbuf_index++;
            
         }
      
    
        
}

on message CAN1.0x14DAF159x
{
        //Send Flow Control If response more than a frame
        if((this.byte(0)&0xF0) == 0x10 )
         {  
           Send_FC();     
         }


        
 //store all data
        if( (this.byte(3)== 0x78) && (this.byte(1) != 0x7F) && (this.byte(2) > 0x30))
        {
          for (rbufind=0;rbufind<64;rbufind++  )      
          {
            O_Resp[ buf_index ] = this.byte(rbufind);      
            buf_index++;
          }
        }
        
        if( (this.byte(3)== 0x78) && (this.byte(1) != 0x7F)&& (this.byte(2) < 0x30))
        {
          for (rbufind=0;rbufind<48;rbufind++  )      
          {
            O_Resp[ buf_index ] = this.byte(rbufind);      
            buf_index++;
          }
        }
        
        if( ((this.byte(1) != 0x7F)&& (this.byte(2) < 0x30)))
        {
          for (rbufind=0;rbufind<48;rbufind++  )      
          {
            O_Resp[ buf_index ] = this.byte(rbufind);      
            buf_index++;
          }
        }

        
        if( (this.byte(3)!= 0x78) && (this.byte(2) > 0x30))
        {
           for (rbufind=0;rbufind<64;rbufind++  )      
            {
              Rx_buffer[ buf_index ] = this.byte(rbufind);      
              buf_index++;
            }
        }
        
         if( (this.byte(1)!= 0x7F) && (this.byte(2) > 0x30))
        {
           for (rbufind=0;rbufind<120;rbufind++  )      
            {
              Rx_buffer[ buf_index ] = this.byte(rbufind);      
              buf_index++;
            }
        }
         
         //
 if((this.byte(0)<=0x10)&&(this.byte(1)!=0x7F))

  {

    Res_buf_index = 0;

    for (rbufind=0;rbufind<8;rbufind++)

    {

      O_Resp[ Res_buf_index ] = this.byte(rbufind);

      Res_buf_index++;

    }

  }

  else if((this.byte(0)>0x10)||(this.byte(1)==0x7F))  // changed line no 206 rbufind=1 to avoid consecutive frame

  {

    for (rbufind=0;rbufind<8;rbufind++)

    {

      O_Resp[ Res_buf_index ] = this.byte(rbufind);

      Res_buf_index++;

    }

  }
 
  if(this.byte(1)==0x7F)

  {

    Res_buf_index = 0;

    for (rbufind=0;rbufind<8;rbufind++)

    {

      O_Resp[ Res_buf_index ] = this.byte(rbufind);

      Res_buf_index++;

    }

    Res_buf_index = 0;

  }        
 
        
        if( (this.byte(3)!= 0x78) && (this.byte(2) < 0x30))
        {
           for (rbufind=0;rbufind<48;rbufind++  )      
            {
              O_Resp[ buf_index ] = this.byte(rbufind);      
              buf_index++;
            }
        } 
           
          
        
        
        //If Flow control as response clear O_resp buffer and set index to 0
        if( this.byte(0) == 0x30 )
        {
        buf_index = 0;
        for (rbufind=0;rbufind<200;rbufind++  )      
        {
          O_Resp[ buf_index ] = 0 ;      
          buf_index++;
        }
        buf_index = 0;
        }
    
        // Send Key on response to  seed 3 bytes 
         if(( this.byte(0) == 0x06) && ( this.byte(1) == 0x067) && ( this.byte(2) == 0x01) )
         {
          //seed = ( this.byte(3)) * 0x1000000 + ( this.byte(4)) * 0x10000 + ( this.byte(5)) * 0x100 + ( this.byte(4)) ;
           SaccSeed = (( this.byte(3)<<24) +( this.byte(4)<<16) +( this.byte(5)<<8) +  this.byte(6)) & 0xFFFFFFFF ;
           write("SaccSeed2 value %x",SaccSeed);
         }
         
}

on message CAN1.0x10dbfef1x
{

    //Clear O_resp Buffer on receiving new diagnostic response
    if( this.byte(0) <= 0x10 )
    {
    buf_index = 0;
    for (rbufind=0;rbufind<200;rbufind++  )      
    {
      O_Resp[ rbufind ] = 0 ;      
    }
    buf_index = 0;
    }
  
    
    //Clear TX Buffer on sending new diagnostic request
    if( (this.byte(0) <= 0x10) )
     {
          for (tbufind=0;tbufind<200;tbufind++  )      
          {
            Tx_buffer[ tbufind ] = 0 ;      
          }
          tbuf_index = 0;
     }
    
     
    //Store TX Buffer 
    for (tbufind=0;tbufind<8;tbufind++  )      
     {
        Tx_buffer[ tbuf_index ] = this.byte(tbufind);  
        //teststep("","%X-%X",tbuf_index,Tx_buffer[ tbuf_index ]);
        tbuf_index++;
        
     }
        
}

on message can2.0x2F0
{
    //Clear O_resp Buffer on receiving new diagnostic response
    buf_index = 0;
    for (rbufind=0;rbufind<200;rbufind++ )      
    {
      O_Resp[ rbufind ] = 0 ;      
    }
    buf_index = 0;

    
    //Clear TX Buffer on sending new diagnostic request
    for (tbufind=0;tbufind<200;tbufind++)      
    {
       Tx_buffer[ tbufind ] = 0 ;      
    }
    tbuf_index = 0;

    //Store TX Buffer 
    for (tbufind=0;tbufind<8;tbufind++  )      
    {
      Tx_buffer[ tbuf_index ] = this.byte(tbufind);  
      //teststep("","%X-%X",tbuf_index,Tx_buffer[ tbuf_index ]);
      tbuf_index++;
    }
  
}

on message can2.0x2F1
{     
  buf_index = 0;
      //store all data
      for (rbufind=0;rbufind<8;rbufind++  )      
      {
         O_Resp[ buf_index ] = this.byte(rbufind);      
         buf_index++;
      }
//       buf_index = 0;
}

Send_on_CAN_XCP(int d0,int d1,int d2,int d3,int d4,int d5,int d6,int d7)
{


          if((d0 < 0x10)||(d0==0x30))
          {
          	DIAG_Req_XCP.DLC = 15; 
          	req[0] = DIAG_Req_XCP.BYTE(0) = d0;
          	req[1] = DIAG_Req_XCP.BYTE(1) = d1;
            req[2] = DIAG_Req_XCP.BYTE(2) = d2; 
          	req[3] = DIAG_Req_XCP.BYTE(3) = d3;
          	req[4] = DIAG_Req_XCP.BYTE(4) = d4;
          	req[5] = DIAG_Req_XCP.BYTE(5) = d5;
          	req[6] = DIAG_Req_XCP.BYTE(6) = d6;
          	req[7] = DIAG_Req_XCP.BYTE(7) = d7;
            DIAGNOSTIC_REQUEST("",req,8);
            Output(DIAG_Req_XCP);  
          }
          else if (d0 >= 0x10) 
          {
             	DIAG_Req_XCP.DLC = 15; 
            	req[0] = DIAG_Req_XCP.BYTE(0) = d0;
            	req[1] = DIAG_Req_XCP.BYTE(1) = d1;
				      req[2] = DIAG_Req_XCP.BYTE(2) = d2; 
            	req[3] = DIAG_Req_XCP.BYTE(3) = d3;
            	req[4] = DIAG_Req_XCP.BYTE(4) = d4;
            	req[5] = DIAG_Req_XCP.BYTE(5) = d5;
            	req[6] = DIAG_Req_XCP.BYTE(6) = d6;
            	req[7] = DIAG_Req_XCP.BYTE(7) = d7;
              DIAGNOSTIC_REQUEST("",req,8);
              Output(DIAG_Req_XCP);
              testwaitfortimeout(16);        
          }
}


Set_batt_voltage(float val)
{
  //@Env_battery_high=0x00;
  //@Env_battery_low=0x00;
  snprintf(buffer,elcount(buffer),"VOLT %f",val);
  write("%s",buffer);
 // Test_Gpib_Write(buffer);
//  Test_Gpib_Write("OUTP ON");
  testWaitForTimeout(500);
 
}
//
Set_batt_voltage_high(float val)
{
   //@Env_battery_high=0x01;
  //@Env_battery_low=0x00;
  snprintf(buffer,elcount(buffer),"VOLT %f",val);
  write("%s",buffer);
 // Test_Gpib_Write(buffer);
 // Test_Gpib_Write("OUTP ON");
 
}
//
Set_batt_voltage_low(float val)
{ 
  //@Env_battery_low=0x01;
  // @Env_battery_high=0x00;
  snprintf(buffer,elcount(buffer),"VOLT %f",val);
  write("%s",buffer);
 // Test_Gpib_Write(buffer);
//  Test_Gpib_Write("OUTP ON");
 
}

on timer Data_Sending
{
            int j;
            testwaitfortimeout(50);
            if(data_pack_cnt < (l_temp-1) && length_cnt < 0x2F )
            {
            DIAG_Req.dlc = 8;
            DIAG_Req.byte(0)= length_cnt;
            for(j=1;j<=7;j++)
             { 
                DIAG_Req.byte(j)= write_array_buff[data_pack_cnt] ;
                data_pack_cnt++;
             }
            output(DIAG_Req);
            length_cnt++;
            //testStep("","Writeen %d bytes of data %d ",data_pack_cnt,(l_temp-1));
            setTimer(Data_Sending,5);
            }

}

/*on timer Data_Sending1
{
            int j;
            testwaitfortimeout(50);
            data_pack_cnt++;
            if(data_pack_cnt <= (l_temp1-1) && length_cnt < 0x2F )
            {
            DIAG_Req.dlc = 8;
            DIAG_Req.byte(0)= length_cnt;
            for(j=1;j<=7;j++)
             { 
                DIAG_Req.byte(j)= write_array_buff[data_pack_cnt] ;
                data_pack_cnt++;
             }
            output(DIAG_Req);
            length_cnt++;
            //testStep("","Writeen %d bytes of data %d ",data_pack_cnt,(l_temp-1));
            setTimer(Data_Sending1,50);
            }

}*/

//////////////////////////////////////////////////////////////


on timer Data_Sending1
{
int j;
int datalength;//JP
testwaitfortimeout(50);
datalength= l_temp1-5;//Jp FOR 64 BYTES DATA WRITE  UPDATE TO  10 TO SEND 9 cf
  write("data length = %d",datalength);
data_pack_cnt++;
  write("data_pack_cnt = %d",data_pack_cnt);
  if((length_cnt == 0x29 && datalength<=69) || (length_cnt == 0x26 && datalength<=48) || (length_cnt == 0x27 && datalength<=55))
  {
    l_temp1 = l_temp1+5;
    write("in IF Loop");
  }
if(data_pack_cnt <= (l_temp1-1) && length_cnt < 0x2F )
{
  write("In MAIN IF");
////////JP Added//////////////////////////
if(datalength<=13 && length_cnt==0x21)
{
DIAG_Req.dlc = datalength-5;
  write("In 21 IF");
}
else if(datalength<=20 && length_cnt==0x22)
{
DIAG_Req.dlc = datalength-12;
  write("In 22 IF");
}
else if(datalength<=27 && length_cnt==0x23)
{
DIAG_Req.dlc = datalength-19;
  write("In 23 IF");
}
else if(datalength<=34 && length_cnt==0x24)
{
DIAG_Req.dlc = datalength-26;
}
else if(datalength<=41 && length_cnt==0x25)
{
DIAG_Req.dlc = datalength-33;
}
else if(datalength<=48 && length_cnt==0x26)
{
DIAG_Req.dlc = datalength-40;
}
else if(datalength<=55 && length_cnt==0x27)
{
DIAG_Req.dlc = datalength-47;
}
else if(datalength<=62 && length_cnt==0x28)
{
DIAG_Req.dlc = datalength-54;
  write("In 28 IF");
}
else if(datalength<=69 && length_cnt==0x29)
{
DIAG_Req.dlc = datalength-61;
  write("In 29 IF");
}
/////////////////////////////////////////////
DIAG_Req.byte(0)= length_cnt;
for(j=1;j<=7;j++)
{
DIAG_Req.byte(j)= write_array_buff[data_pack_cnt] ;
data_pack_cnt++;
}
output(DIAG_Req);
length_cnt++;
//testStep("","Writeen %d bytes of data %d ",data_pack_cnt,(l_temp-1));
setTimer(Data_Sending1,50);
}}


/////////////////////////////////////////

/*on timer FUN_Data_Sending1
{
            int j;
            testwaitfortimeout(50);
            data_pack_cnt++;
            if(data_pack_cnt < (l_temp1-1) && length_cnt < 0x2F )
            {
            FUN_Req.dlc = 8;
            FUN_Req.byte(0)= length_cnt;
            for(j=1;j<=7;j++)
             { 
                FUN_Req.byte(j)= write_array_buff[data_pack_cnt] ;
                data_pack_cnt++;
             }
            output(FUN_Req);
            length_cnt++;
            //testStep("","Writeen %d bytes of data %d ",data_pack_cnt,(l_temp-1));
            setTimer(FUN_Data_Sending1,50);
            }

}*/
////////////////////////////////////////////////////////////////////////////////////
on timer FUN_Data_Sending1
{
int j;
int datalength;//JP
testwaitfortimeout(50);
datalength= l_temp1-5;//JP
data_pack_cnt++;
  if(length_cnt == 0x29)
  {
    l_temp1 = l_temp1+5;
  }
if(data_pack_cnt <= (l_temp1-1) && length_cnt < 0x2F )
{
////////JP Added//////////////////////////
if(datalength<=13 && length_cnt==0x21)
{
FUN_Req.dlc = datalength-5;
}
else if(datalength<=20 && length_cnt==0x22)
{
FUN_Req.dlc = datalength-12;
}
else if(datalength<=27 && length_cnt==0x23)
{
FUN_Req.dlc = datalength-19;
}
else if(datalength<=34 && length_cnt==0x24)
{
FUN_Req.dlc = datalength-26;
}
else if(datalength<=41 && length_cnt==0x25)
{
FUN_Req.dlc = datalength-33;
}
else if(datalength<=48 && length_cnt==0x26)
{
FUN_Req.dlc = datalength-40;
}
else if(datalength<=55 && length_cnt==0x27)
{
FUN_Req.dlc = datalength-47;
}
else if(datalength<=62 && length_cnt==0x28)
{
FUN_Req.dlc = datalength-54;
}
else if(datalength<=69 && length_cnt==0x29)
{
FUN_Req.dlc = datalength-61;
}
/////////////////////////////////////////////
FUN_Req.byte(0)= length_cnt;
for(j=1;j<=7;j++)
{
FUN_Req.byte(j)= write_array_buff[data_pack_cnt] ;
data_pack_cnt++;
}
output(FUN_Req);
length_cnt++;
//testStep("","Writeen %d bytes of data %d ",data_pack_cnt,(l_temp-1));
setTimer(Data_Sending1,50);
}
}

/////////////////////////////////////////////////////////

send_on_CAN (int d0,int d1,int d2,int d3,int d4,int d5,int d6,int d7)
{


          if((d0 < 0x10)||(d0==0x30))
          {
          	DIAG_Req.DLC = 8; //8
          	req[0] = DIAG_Req.BYTE(0) = d0;
          	req[1] = DIAG_Req.BYTE(1) = d1;
            req[2] = DIAG_Req.BYTE(2) = d2; 
          	req[3] = DIAG_Req.BYTE(3) = d3;
          	req[4] = DIAG_Req.BYTE(4) = d4;
          	req[5] = DIAG_Req.BYTE(5) = d5;
          	req[6] = DIAG_Req.BYTE(6) = d6;
          	req[7] = DIAG_Req.BYTE(7) = d7;
  		      DIAGNOSTIC_REQUEST(" 0x14DA59F1x   ",req,8);
            
            Output(DIAG_Req);  
          }
          else if (d0 >= 0x10) 
          {
           // Count =  (DIAG_Req.BYTE(1))/8;
       //    Count =  d1/8;
           // for(i = 1; i <= Count; i++)
          //  {
            	DIAG_Req.DLC = 8; 
            	req[0] = DIAG_Req.BYTE(0) = d0;
            	req[1] = DIAG_Req.BYTE(1) = d1;
              req[2] = DIAG_Req.BYTE(2) = d2; 
            	req[3] = DIAG_Req.BYTE(3) = d3;
            	req[4] = DIAG_Req.BYTE(4) = d4;
            	req[5] = DIAG_Req.BYTE(5) = d5;
            	req[6] = DIAG_Req.BYTE(6) = d6;
            	req[7] = DIAG_Req.BYTE(7) = d7;
    		      DIAGNOSTIC_REQUEST(" 0x14DA59F1x   ",req,8);
              
              Output(DIAG_Req);
         //   }
          }
          
}

//////////////////////////////////////////////////////////////////////////////////////////
send_on_CAN_bl (int d0,int d1,int d2,int d3,int d4,int d5,int d6,int d7)
{


          if((d0 < 0x10)||(d0==0x30))
          {
          	DIAG_Req.DLC = 8; 
          	req[0] = DIAG_Req.BYTE(0) = d0;
          	req[1] = DIAG_Req.BYTE(1) = d1;
            req[2] = DIAG_Req.BYTE(2) = d2; 
          	req[3] = DIAG_Req.BYTE(3) = d3;
          	req[4] = DIAG_Req.BYTE(4) = d4;
          	req[5] = DIAG_Req.BYTE(5) = d5;
          	req[6] = DIAG_Req.BYTE(6) = d6;
          	req[7] = DIAG_Req.BYTE(7) = d7;
  		      DIAGNOSTIC_REQUEST("",req,8);
            
            Output(DIAG_Req);  
          }
          else if (d0 >= 0x10) 
          {
           // Count =  (DIAG_Req.BYTE(1))/8;
       //    Count =  d1/8;
           // for(i = 1; i <= Count; i++)
          //  {
            	DIAG_Req.DLC = 8; 
            	req[0] = DIAG_Req.BYTE(0) = d0;
            	req[1] = DIAG_Req.BYTE(1) = d1;
              req[2] = DIAG_Req.BYTE(2) = d2; 
            	req[3] = DIAG_Req.BYTE(3) = d3;
            	req[4] = DIAG_Req.BYTE(4) = d4;
            	req[5] = DIAG_Req.BYTE(5) = d5;
            	req[6] = DIAG_Req.BYTE(6) = d6;
            	req[7] = DIAG_Req.BYTE(7) = d7;
    		      DIAGNOSTIC_REQUEST("",req,8);
              
              Output(DIAG_Req);
         //   }
          }
          
}
/////////////////////////////////////////////////////////////////////



Read_DTC_06(long DTC) 
{ 
 // ACTION("Read DTC-19 06 "); 
  DIAG_Req.dlc = 8; 
  DIAG_Req.byte(0)=  0x06; 
  DIAG_Req.byte(1)=  0x19; 
  DIAG_Req.byte(2)=  0x06; 
  DIAG_Req.byte(3)=  (DTC & 0xFF0000) >> 16; 
  DIAG_Req.byte(4)=  (DTC & 0x00FF00) >> 8; 
  DIAG_Req.byte(5)=  DTC & 0x0000FF ; 
  DIAG_Req.byte(6)=  0xFF; 
  output(DIAG_Req); 
  testwaitfortimeout(200); 
  DIAGNOSTIC_REQUEST("",Tx_buffer,8); 
  OBSERVED_DATA("",O_Resp,16); 
  }


send_on_CAN_FUN (int d0,int d1,int d2,int d3,int d4,int d5,int d6,int d7)
{
          if((d0 < 0x10)||(d0==0x30))
          {
            FUN_Req.DLC = d0+1; //8
            req[0] = FUN_Req.BYTE(0) = d0;
            req[1] = FUN_Req.BYTE(1) = d1;
            req[2] = FUN_Req.BYTE(2) = d2; 
            req[3] = FUN_Req.BYTE(3) = d3;
            req[4] = FUN_Req.BYTE(4) = d4;
            req[5] = FUN_Req.BYTE(5) = d5;
            req[6] = FUN_Req.BYTE(6) = d6;
            req[7] = FUN_Req.BYTE(7) = d7;
                 // FUNC_REQUEST("",req,8);
            DIAGNOSTIC_REQUEST(" 0x10DBFEF1x   ",req,8);
            Output(FUN_Req);  
          }
          else if (d0 >= 0x10) 
          {
           // Count =  (DIAG_Req.BYTE(1))/8;
       //    Count =  d1/8;
           // for(i = 1; i <= Count; i++)
          //  {
                  FUN_Req.DLC = d0+1; 
                  req[0] = FUN_Req.BYTE(0) = d0;
                  req[1] = FUN_Req.BYTE(1) = d1;
              req[2] = FUN_Req.BYTE(2) = d2; 
                  req[3] = FUN_Req.BYTE(3) = d3;
                  req[4] = FUN_Req.BYTE(4) = d4;
                  req[5] = FUN_Req.BYTE(5) = d5;
                  req[6] = FUN_Req.BYTE(6) = d6;
                  req[7] = FUN_Req.BYTE(7) = d7;
                 // FUNCTIONAL_REQUEST("",req,8);
              DIAGNOSTIC_REQUEST(" 0x10DBFEF1x   ",req,8);
              Output(FUN_Req);
         //   }
          }
          
}


//send_on_xcp (int d0,int d1,int d2,int d3,int d4,int d5,int d6,int d7)
//{
//  int f;
//     for(f=0;f<10;f++)    
//    {
//      req1[f]=0x00;
//    }
//            XCP_VFP_req.DLC = 8; 
//            req1[0] = XCP_VFP_req.BYTE(0) = d0;
//            req1[1] = XCP_VFP_req.BYTE(1) = d1;
//            req1[2] = XCP_VFP_req.BYTE(2) = d2; 
//            req1[3] = XCP_VFP_req.BYTE(3) = d3;
//            req1[4] = XCP_VFP_req.BYTE(4) = d4;
//            req1[5] = XCP_VFP_req.BYTE(5) = d5;
//            req1[6] = XCP_VFP_req.BYTE(6) = d6;
//            req1[7] = XCP_VFP_req.BYTE(7) = d7;
//                 // FUNC_REQUEST("",req,8);
//            DIAGNOSTIC_REQUEST("",req1,8);
//            Output(XCP_VFP_req);  
//          
//         //   }
//          
//          
//}

Session(byte yy)
{
  
  DIAG_Req.dlc = 8;
  DIAG_Req.byte(0) = 0x2 ; 
  DIAG_Req.byte(1) = 0x10 ; 
  DIAG_Req.byte(2) = yy ;
  output(DIAG_Req); 
  testwaitfortimeout(100);
  Step();

  if(yy==0x01)
    Action("Enter into Default Session");
  else if(yy==0x02)
    Action("Enter into Programming Session");
  else
    Action("Enter into Extended Session");
  
  DIAGNOSTIC_REQUEST("",Tx_buffer,8);
  OBSERVED_DATA("",O_Resp,8);
  Expect(0x06,0x50,yy,0x00,0x32,0x01,0xF4,0x00);
  EXPECTED_DATA("",E_Resp,8);
  Check(O_Resp,E_Resp,8);
  
}

Session_Func(byte yy)
{
  
  FUN_Req.dlc = 8;
  FUN_Req.byte(0) = 0x2 ; 
  FUN_Req.byte(1) = 0x10 ; 
  FUN_Req.byte(2) = yy ;
  output(FUN_Req); 
  testwaitfortimeout(100);
  Step();

  if(yy==0x01)
    Action("Enter into Default Session");
  else if(yy==0x02)
    Action("Enter into Programming Session");
  else
    Action("Enter into Extended Session");
  
  DIAGNOSTIC_REQUEST("",Tx_buffer,8);
  OBSERVED_DATA("",O_Resp,8);
  Expect(0x06,0x50,yy,0x00,0x32,0x01,0xF4,0x00);
  EXPECTED_DATA("",E_Resp,8);
  Check(O_Resp,E_Resp,8);
  
}

Session_prog(byte yy)
{
  
  DIAG_Req.dlc = 8;
  DIAG_Req.byte(0) = 0x2 ; 
  DIAG_Req.byte(1) = 0x10 ; 
  DIAG_Req.byte(2) = yy ;
  output(DIAG_Req); 
  testwaitfortimeout(600);
  Step();

  if(yy==0x01)
    Action("Enter into Default Session");
  else if(yy==0x02)
    Action("Enter into Programming Session");
  else
    Action("Enter into Extended Session");
  
  DIAGNOSTIC_REQUEST("",Tx_buffer,8);
  OBSERVED_DATA("",O_Resp,8);
  Expect(0x06,0x50,yy,0x00,0x32,0x01,0xF4,0x00);
  EXPECTED_DATA("",E_Resp,8);
  Check(O_Resp,E_Resp,8);
  
}

Security_Access()
{
  Session(3);  
  
  Step();
  Action("Unlock the ECU");
  Add_To_Report();
  
	Request_Seed();
  testwaitfortimeout(250);
  
//  ACTION("2nd Level Security Acess");
//  testWaitForTimeout(300); 
  DIAGNOSTIC_REQUEST("",Tx_buffer,8);
  OBSERVED_DATA("",O_Resp,8);
  Expect(0x02,0x67,0x02,0x00,0x00,0x00,0x00,0x00);
  EXPECTED_DATA ("",E_Resp,8);   
  Check(E_Resp,O_Resp,3);
  testWaitForTimeout(200);
}

Security_Access_A_Sample()
{
  Session(3);  
  Action("Request SEED");
  send_on_CAN (0x02,0x27,0x01,0x00,0x00,0x00,0x00,0x00);
  testWaitForTimeout(200);
  OBSERVED_DATA("",O_Resp,8);
  Expect(0x06,0x67,0x01,O_Resp[3],O_Resp[4],O_Resp[5],O_Resp[6],0x00);
  EXPECTED_DATA("",E_Resp,8);
  check(E_Resp,O_Resp,8);
  
  ACTION("Send KEY"); 
  send_on_CAN (0x06,0x27,0x02,0x00,0x00,0x00,0x01,0x00); 
  testWaitForTimeout(200);
  Expect(0x02,0x67,0x02,0x00,0x00,0x00,0x00,0x00);
  OBSERVED_DATA("",O_Resp,8);
  EXPECTED_DATA("",E_Resp,8);
  check(E_Resp,O_Resp,8);
}

Security_Access1()
{
  Step();
  Action("Security Access");
  Add_To_Report();
  
  Session(3);  
	Request_Seed1();
  testwaitfortimeout(250);
  
  ACTION("2nd Level Security Acess");
  //testWaitForTimeout(300); 
  DIAGNOSTIC_REQUEST("",Tx_buffer,8);
  OBSERVED_DATA("",O_Resp,8);
  Expect(0x02,0x67,0x02,0x00,0x00,0x00,0x00,0x00);
  EXPECTED_DATA ("",E_Resp,8);   
  Check(E_Resp,O_Resp,3);
//  testWaitForTimeout(10);
}

Security_Access_prog()
{
  Step();
  Action("Security Access");
  Add_To_Report();
  
 // Session(3);  
	Request_Seed();
  testwaitfortimeout(650);
  
  ACTION("2nd Level Security Acess");
  //testWaitForTimeout(300); 
  DIAGNOSTIC_REQUEST("",Tx_buffer,8);
  OBSERVED_DATA("",O_Resp,8);
  Expect(0x02,0x67,0x02,0x00,0x00,0x00,0x00,0x00);
  EXPECTED_DATA ("",E_Resp,8);   
  Check(E_Resp,O_Resp,3);
//  testWaitForTimeout(10);
}

//Security_Access_prog()
//{
//  Step();
//  Action("Security Access");
//  Add_To_Report();
//  
//  Session(3);  
//	Req_seed();
//  testwaitfortimeout(250);
//  
// // ACTION("2nd Level Security Acess");
//  //testWaitForTimeout(300); 
//  DIAGNOSTIC_REQUEST("",Tx_buffer,8);
//  OBSERVED_DATA("",O_Resp,8);
//  Expect(0x02,0x67,0x02,0x00,0x00,0x00,0x00,0x00);
//  EXPECTED_DATA ("",E_Resp,8);   
//  Check(E_Resp,O_Resp,3);
////  testWaitForTimeout(10);
//}



Request_Seed()
{
  Step();
  Action("Request SEED");
  send_on_CAN (0x02,0x27,0x01,0x00,0x00,0x00,0x00,0x00);
  testWaitForTimeout(200);
  OBSERVED_DATA("",O_Resp,8);
  Expect(0x04,0x67,0x01,O_Resp[3],O_Resp[4],0x00,0x00,0x00);
  EXPECTED_DATA("",E_Resp,8);
  check(E_Resp,O_Resp,8);
  key_val1=Calculate_KEY(O_Resp[3],O_Resp[4]);
  testWaitForTimeout(100);
  Send_Key(key_val1);
  
}

Request_Seed1()
{
  Step();
  Action("Request SEED");
  send_on_CAN (0x02,0x27,0x01,0x00,0x00,0x00,0x00,0x00);
  testWaitForTimeout(200);
  OBSERVED_DATA("",O_Resp,8);
  Expect(0x04,0x67,0x01,O_Resp[3],O_Resp[4],0x00,0x00,0x00);
  EXPECTED_DATA("",E_Resp,8);
  check(E_Resp,O_Resp,8);
  key_val1=Calculate_KEY(O_Resp[3],O_Resp[4]);
  testWaitForTimeout(100);
  Send_Key1(key_val1);
  
}
 
Send_Key(long Cal_Key)
{  
   
  byte key1,key2;
  key1= ((Cal_Key>>8) & 0x000000FF);
  key2= (Cal_Key&0x000000FF);
  Step();
  ACTION("Send KEY"); 
  send_on_CAN (0x04,0x27,0x02,key1,key2,0x00,0x00,0x00); 
  testWaitForTimeout(200);
  Expect(0x02,0x67,0x02,0x00,0x00,0x00,0x00,0x00);
  OBSERVED_DATA("",O_Resp,8);
  EXPECTED_DATA("",E_Resp,8);
  check(E_Resp,O_Resp,8);
}

Send_Key1(long Cal_Key)
{  
  
  byte key1,key2;
  key1= ((Cal_Key>>7) & 0x000000FF);
  key2= (Cal_Key&0x000000FF);
  Step();
  ACTION("Send KEY"); 
  send_on_CAN (0x04,0x27,0x02,key1,key2,0x00,0x00,0x00); 
  testWaitForTimeout(200);
  Expect(0x02,0x67,0x02,0x00,0x00,0x00,0x00,0x00);
  OBSERVED_DATA("",O_Resp,8);
  EXPECTED_DATA("",E_Resp,8);
  check(E_Resp,O_Resp,8);
}

long Calculate_KEY(byte seed1,byte seed2)
{
  long seed_val,key_val;
  
  seed_val = ((seed1<<8) + seed2) & 0x0000FFFF ;
  key_val = (((seed_val * 20077) + 12345) ^ 0xA5A5);
  
  return key_val; 
}




//Req_seed()
//{
//
//	 Step();
//  Action("Request SEED");
//  send_on_CAN (0x02,0x27,0x01,0x00,0x00,0x00,0x00,0x00);
//  testWaitForTimeout(200);
//  OBSERVED_DATA("",O_Resp,8);
//  Expect(0x04,0x67,0x01,O_Resp[3],O_Resp[4],0x00,0x00,0x00);
//  EXPECTED_DATA("",E_Resp,8);
//  check(E_Resp,O_Resp,8);
//  key_val1=Calculate_KEY_prog(O_Resp[3],O_Resp[4]);
//  testWaitForTimeout(100);
//  Send_Key(key_val1);
//}

Send_seed(int seed)
{

  DIAG_Req.dlc = 8;
  DIAG_Req.byte(0)= 0x04;
  DIAG_Req.byte(1)= 0x27;
  DIAG_Req.byte(2)= 0x02;
  
  Key_Mul=seed*20077;
  Key_Mul_Byte1=((((long)(Key_Mul))&0x0000ffff));
  Key_temp=(Key_Mul_Byte1+0x3039);
  Key_temp_xor=(Key_temp^0xA5A5);
  Key_Byte1=(((Key_temp_xor)& 0xff00)>>8);
  Key_Byte2=((Key_temp_xor)& 0x00ff);
  
  DIAG_Req.byte(3)= Key_Byte1 ;
  DIAG_Req.byte(4)= Key_Byte2 ;
  output(DIAG_Req);
}
   
   
       
Expect(int d0,int d1,int d2,int d3,int d4,int d5,int d6,int d7)
{
    E_Resp[0] = d0;
    E_Resp[1] = d1;
    E_Resp[2] = d2; 
    E_Resp[3] = d3;
    E_Resp[4] = d4;
    E_Resp[5] = d5;
    E_Resp[6] = d6;
    E_Resp[7] = d7;
}

Expect1(int d0,int d1,int d2,int d3,int d4,int d5,int d6,int d7)
{
    E_Resp[0] = d0;
    E_Resp[1] = d1;
    E_Resp[2] = d2; 
    E_Resp[3] = d3;
    E_Resp[4] = d4;
    E_Resp[5] = d5;
    E_Resp[6] = d6;
    E_Resp[7] = d7;
}

Expect2(int d0,int d1,int d2,int d3,int d4,int d5,int d6,int d7)
{
    E_Resp[8] = d0;
    E_Resp[9] = d1;
    E_Resp[10] = d2; 
    E_Resp[11] = d3;
    E_Resp[12] = d4;
    E_Resp[13] = d5;
    E_Resp[14] = d6;
    E_Resp[15] = d7;
}

Expect3(int d0,int d1,int d2,int d3,int d4,int d5,int d6,int d7)
{
    E_Resp[16] = d0;
    E_Resp[17] = d1;
    E_Resp[18] = d2; 
    E_Resp[19] = d3;
    E_Resp[20] = d4;
    E_Resp[21] = d5;
    E_Resp[22] = d6;
    E_Resp[23] = d7;
}

Expect4(int d0,int d1,int d2,int d3,int d4,int d5,int d6,int d7)
{
    E_Resp[24] = d0;
    E_Resp[25] = d1;
    E_Resp[26] = d2; 
    E_Resp[27] = d3;
    E_Resp[28] = d4;
    E_Resp[29] = d5;
    E_Resp[30] = d6;
    E_Resp[31] = d7;
}

Expect5(int d0,int d1,int d2,int d3,int d4,int d5,int d6,int d7)
{
    E_Resp[32] = d0;
    E_Resp[33] = d1;
    E_Resp[34] = d2; 
    E_Resp[35] = d3;
    E_Resp[36] = d4;
    E_Resp[37] = d5;
    E_Resp[38] = d6;
    E_Resp[39] = d7;
}

Expect6(int d0,int d1,int d2,int d3,int d4,int d5,int d6,int d7)
{
    E_Resp[40] = d0;
    E_Resp[41] = d1;
    E_Resp[42] = d2; 
    E_Resp[43] = d3;
    E_Resp[44] = d4;
    E_Resp[45] = d5;
    E_Resp[46] = d6;
    E_Resp[47] = d7;
}

Expect7(int d0,int d1,int d2,int d3,int d4,int d5,int d6,int d7)
{
    E_Resp[48] = d0;
    E_Resp[49] = d1;
    E_Resp[50] = d2; 
    E_Resp[51] = d3;
    E_Resp[52] = d4;
    E_Resp[53] = d5;
    E_Resp[54] = d6;
    E_Resp[55] = d7;
}
Expect8(int d0,int d1,int d2,int d3,int d4,int d5,int d6,int d7)
{
    E_Resp[56] = d0;
    E_Resp[57] = d1;
    E_Resp[58] = d2; 
    E_Resp[59] = d3;
    E_Resp[60] = d4;
    E_Resp[61] = d5;
    E_Resp[62] = d6;
    E_Resp[63] = d7;
}

Expect9(int d0,int d1,int d2,int d3,int d4,int d5,int d6,int d7)
{
    E_Resp[64] = d0;
    E_Resp[65] = d1;
    E_Resp[66] = d2; 
    E_Resp[67] = d3;
    E_Resp[68] = d4;
    E_Resp[69] = d5;
    E_Resp[70] = d6;
    E_Resp[71] = d7;
}
Expect10(int d0,int d1,int d2,int d3,int d4,int d5,int d6,int d7)
{
    E_Resp[72] = d0;
    E_Resp[73] = d1;
    E_Resp[74] = d2; 
    E_Resp[75] = d3;
    E_Resp[76] = d4;
    E_Resp[77] = d5;
    E_Resp[78] = d6;
    E_Resp[79] = d7;
}
Write(int d0,int d1,int d2,int d3,int d4,int d5,int d6,int d7)
{
    W_array[0] = d0;
    W_array[1] = d1;
    W_array[2] = d2; 
    W_array[3] = d3;
    W_array[4] = d4;
    W_array[5] = d5;
    W_array[6] = d6;
    W_array[7] = d7;
}

Write1(int d0,int d1,int d2,int d3,int d4,int d5,int d6,int d7)
{
    W_array[0] = d0;
    W_array[1] = d1;
    W_array[2] = d2; 
    W_array[3] = d3;
    W_array[4] = d4;
    W_array[5] = d5;
    W_array[6] = d6;
    W_array[7] = d7;
}

Write2(int d0,int d1,int d2,int d3,int d4,int d5,int d6,int d7)
{
    W_array[8] = d0;
    W_array[9] = d1;
    W_array[10] = d2; 
    W_array[11] = d3;
    W_array[12] = d4;
    W_array[13] = d5;
    W_array[14] = d6;
    W_array[15] = d7;
}

Write3(int d0,int d1,int d2,int d3,int d4,int d5,int d6,int d7)
{
    W_array[16] = d0;
    W_array[17] = d1;
    W_array[18] = d2; 
    W_array[19] = d3;
    W_array[20] = d4;
    W_array[21] = d5;
    W_array[22] = d6;
    W_array[23] = d7;
}

Write4(int d0,int d1,int d2,int d3,int d4,int d5,int d6,int d7)
{
    W_array[24] = d0;
    W_array[25] = d1;
    W_array[26] = d2; 
    W_array[27] = d3;
    W_array[28] = d4;
    W_array[29] = d5;
    W_array[30] = d6;
    W_array[31] = d7;
}

Write5(int d0,int d1,int d2,int d3,int d4,int d5,int d6,int d7)
{
    W_array[32] = d0;
    W_array[33] = d1;
    W_array[34] = d2; 
    W_array[35] = d3;
    W_array[36] = d4;
    W_array[37] = d5;
    W_array[38] = d6;
    W_array[39] = d7;
}

Write6(int d0,int d1,int d2,int d3,int d4,int d5,int d6,int d7)
{
    W_array[40] = d0;
    W_array[41] = d1;
    W_array[42] = d2; 
    W_array[43] = d3;
    W_array[44] = d4;
    W_array[45] = d5;
    W_array[46] = d6;
    W_array[47] = d7;
}

Write7(int d0,int d1,int d2,int d3,int d4,int d5,int d6,int d7)
{
    W_array[48] = d0;
    W_array[49] = d1;
    W_array[50] = d2; 
    W_array[51] = d3;
    W_array[52] = d4;
    W_array[53] = d5;
    W_array[54] = d6;
    W_array[55] = d7;
}

Write8(int d0,int d1,int d2,int d3,int d4,int d5,int d6,int d7)
{
    W_array[56] = d0;
    W_array[57] = d1;
    W_array[58] = d2; 
    W_array[59] = d3;
    W_array[60] = d4;
    W_array[61] = d5;
    W_array[62] = d6;
    W_array[63] = d7;
}

Write9(int d0,int d1,int d2,int d3,int d4,int d5,int d6,int d7)
{
    W_array[64] = d0;
    W_array[65] = d1;
    W_array[66] = d2; 
    W_array[67] = d3;
    W_array[68] = d4;
    W_array[69] = d5;
    W_array[70] = d6;
    W_array[71] = d7;
}

Write10(int d0,int d1,int d2,int d3,int d4,int d5,int d6,int d7)
{
    W_array[72] = d0;
    W_array[73] = d1;
    W_array[74] = d2; 
    W_array[75] = d3;
    W_array[76] = d4;
    W_array[77] = d5;
    W_array[78] = d6;
    W_array[79] = d7;
}
Check(byte E_Resp[],byte O_Resp[])
{
  for(i=0;i<8;i++)
  {
    if(E_Resp[i] == O_Resp[i])
    {
      count = count+1;
    }
  }
  
  if(count == 8)
  {
    Add_to_report(PASSED); 
    count=0;
  }
  else
  {
    Add_to_report(FAILED);  
    count=0;
  }
}

Check(byte E_Resp[],byte O_Resp[],int len)
{ 
  int count=0;
  int i=0;
  for(i=0;i<len;i++)
  {
    if(E_Resp[i] == O_Resp[i])
    {
      count = count+1;
    }
  }
  
  if(count == len)
  {
    Add_to_report(PASSED); 
    count=0;
  }
  else
  {
    Add_to_report(FAILED);  
    count=0;
  }
}

/*
Check_DTC_SNAPSHOT(byte E_Resp[],byte O_Resp[],int len)
{ 
  for(i=0;i<len;i++)
  {
    if (i != 22)
    {
    if(E_Resp[i] == O_Resp[i])
    {
      count = count+1;
    }
    }
  }
  
  if(count == len-1)
  {
    Add_to_report(PASSED); 
    count=0;
  }
  else
  {
    Add_to_report(FAILED);  
    count=0;
  }
}
*/

Check(byte E_Resp,byte O_Resp)
{
    if(E_Resp == O_Resp)
    {
      count = count+1;
    }
  
  if(count == 1)
  {
    Add_to_report(PASSED); 
    count=0;
  }
  else
  {
    Add_to_report(FAILED);  
    count=0;
  }
}


//Compare_Byte_DID(byte byte_position,byte Data)
//{
//  //Add_To_Report();
//  snprintf(load_string,200,"Checking if Byte %d has data 0x%x",byte_position,Data);  
//  ACTION(load_string);
//  EXPECTED_DATA (Data);
//  OBSERVED_DATA (O_Resp[Capture_buffers[byte_position]]);
//  
//    if(O_Resp[ Capture_buffers[byte_position] ] == Data)
//    {
//      count = count+1;
//    }
//  
//  if(count == 1)
//  {
//    Add_to_report(PASSED); 
//    count=0;
//  }
//  else
//  {
//    Add_to_report(FAILED);  
////    count=0;
//  }
//  
//  write("exp %x observed %x",O_Resp[byte_position],Data);
//}
//
//Compare_Byte_DID_data_unknown(byte byte_position)
//{
//  //Add_To_Report();
//  snprintf(load_string,200,"Checking Byte %d ",byte_position);  
//  ACTION(load_string);
//  EXPECTED_DATA (O_Resp[Capture_buffers[byte_position]]);
//  OBSERVED_DATA (O_Resp[Capture_buffers[byte_position]]);
//  
//    
//  count = count+1;
//  if(count == 1)
//  {
//    Add_to_report(PASSED); 
//    count=0;
//  }
//  
//  
//  //write("exp %x observed %x",O_Resp[byte_position],Data);
//}

Check(byte E_Resp_Start,byte E_Resp_End,byte O_Resp)
{ Step();
    if((O_Resp >= E_Resp_Start) && (O_Resp <= E_Resp_End))
    {
      count = 1;
    }
  
  if(count == 1)
  {
    Add_to_report(PASSED); 
    count=0;
  }
  else
  {
    Add_to_report(FAILED);  
    count=0;
  }
}

Clear_Buffer()
{ 
  write("clear");
  for(i=0;i<999;i++) 
  { 
  O_Resp[i] = 0; 
//    S_Req[i]=0;
    E_Resp[i]=0;
    W_array[i]=0;
  } 
//  for(i=0;i<20;i++) 
//  { 
//    S_Req[i]=0;
//  } 
} 

//TestOutcome_bits(char d[],int e,int f,int m,int bit)
//{
//  int t_i;
// 
//    ACTION("Get Variable ",d);
//    t_i = GetHostVariable(d);
//    COMMENT_DATA_DTC("Byte ",t_i);
//    t_i = m & t_i ;
//    t_i = t_i >> bit ;  
//    testWaitForTimeout(100); 
//    OBSERVED_DATA("",t_i,1);
//    DIAGNOSTIC_REQUEST("",Tx_buffer,8);   
//    EXPECTED_DATA ("",e,1);    
//    Check(e,t_i);
//    testWaitForTimeout(200);
//
//}
Send_FC()
{

  DIAG_Req.dlc = 8;
  DIAG_Req.byte(0)= 0x30;
  DIAG_Req.byte(1)= 0x00;
  DIAG_Req.byte(2)= 0x00;
  DIAG_Req.byte(3)= 0x00;
  DIAG_Req.byte(4)= 0x00;
  DIAG_Req.byte(5)= 0x00;
  DIAG_Req.byte(6)= 0x00;
  DIAG_Req.byte(7)= 0x00;
  output(DIAG_Req);
  testwaitfortimeout(50); 
}

Routine_Start(long routine_no)
{ Step();
      DIAG_Req.dlc = 8;
      DIAG_Req.byte(0)= 0x04;
      DIAG_Req.byte(1)= 0x31;
      DIAG_Req.byte(2)= 0x01;
      DIAG_Req.byte(3)= routine_no >> 8 ;  
      DIAG_Req.byte(4)= routine_no & 0x00FF ; 
      output(DIAG_Req);
      testwaitfortimeout(50);
      
      
    ACTION("Start Routine ",routine_no);
    testWaitForTimeout(100); 
    OBSERVED_DATA("",O_Resp,8);
    DIAGNOSTIC_REQUEST("",Tx_buffer,8); 
    Expect(0x04,0x71,0x01,(routine_no >> 8),(routine_no & 0x00FF),0x00,0x00,0x00);
    EXPECTED_DATA ("",E_Resp,8);    
    Check(E_Resp,O_Resp);
    testWaitForTimeout(1000);
    
}

Routine_Result(long routine_no)
{
   Step();
send_on_can(0x02,0x11,0x01,0x00,0x00,0x00,0x00,0x00); 
testWaitForTimeout(1000);
Security_Access();
 
      DIAG_Req.dlc = 8;
      DIAG_Req.byte(0)= 0x04;
      DIAG_Req.byte(1)= 0x31;
      DIAG_Req.byte(2)= 0x03;
      DIAG_Req.byte(3)= routine_no >> 8 ;  
      DIAG_Req.byte(4)= routine_no & 0x00FF ;
      output(DIAG_Req);
      testwaitfortimeout(50);
      
      ACTION(" Routine Result ",routine_no);
      testWaitForTimeout(100); 
      OBSERVED_DATA("",O_Resp,8);
      DIAGNOSTIC_REQUEST("",Tx_buffer,8); 
      Expect(0x05,0x71,0x03,(routine_no >> 8),(routine_no & 0x00FF),O_Resp[5],0x00,0x00);
      EXPECTED_DATA ("",E_Resp,8);    
      Check(E_Resp,O_Resp);
      testWaitForTimeout(1000);      
}

Routine_Stop(long routine_no)
{

      //Security_Access();
      DIAG_Req.dlc = 8;
      DIAG_Req.byte(0)= 0x04;
      DIAG_Req.byte(1)= 0x31;
      DIAG_Req.byte(2)= 0x02;
      DIAG_Req.byte(3)= routine_no >> 8 ;  
      DIAG_Req.byte(4)= routine_no & 0x00FF ; 
      output(DIAG_Req);
      testwaitfortimeout(50);
      
      ACTION("Stop Routine ",routine_no);
      testWaitForTimeout(100); 
      OBSERVED_DATA("",O_Resp,8);
      DIAGNOSTIC_REQUEST("",Tx_buffer,8); 
      Expect(0x04,0x71,0x02,(routine_no >> 8),(routine_no & 0x00FF),0x00,0x00,0x00);
      EXPECTED_DATA ("",E_Resp,8);    
      Check(E_Resp,O_Resp);
      testWaitForTimeout(1000);
}


Read_DID(long did)
{ 
  Step();

  DIAG_Req.dlc = 8;
  DIAG_Req.byte(0)= 0x03;
  DIAG_Req.byte(1)= 0x22;
  DIAG_Req.byte(2)= ( did & 0xFF00)>>8 ;
  DIAG_Req.byte(3)=  did & 0x00FF ;
  output(DIAG_Req);
   testwaitfortimeout(400); 
  
  DIAGNOSTIC_REQUEST("",Tx_buffer,8);
  
    if(O_Resp[0]==0x10)
     OBSERVED_DATA("",O_Resp,( O_Resp[1] + ((O_Resp[1] - 6)/7) + 3 ));
    else
     OBSERVED_DATA("",O_Resp,8);
     
}

//Write_did(long did , int len)
// {

//    int p1;
    
    
//      Step();
//    l_temp = len;
    
//    for(p1=0;p1<1000;p1++)
//    {
//    write_array_buff[p1] = W_array[p1] ;      
//    }
    
//     if(len < 5 )
//     {
//      DIAG_Req.dlc = 8;
//      DIAG_Req.byte(0)= 3 + len;
//      DIAG_Req.byte(1)= 0x2E;
//      DIAG_Req.byte(2)= ( did & 0xFF00)>>8 ;
//      DIAG_Req.byte(3)= did & 0x00FF ;
//      for(i=0; i< len ;i++)
//      {
//      DIAG_Req.byte(4+i)= write_array_buff[i] ;
//      }
//      output(DIAG_Req);
//     }
//     else
//     {
//      DIAG_Req.dlc = 8;
//      DIAG_Req.byte(0)= 0x10;
//      DIAG_Req.byte(1)= 0x03 + len;
//      DIAG_Req.byte(2)= 0x2E ;
//      DIAG_Req.byte(3)=( did & 0xFF00)>>8 ;
//      DIAG_Req.byte(4)=  did & 0x00FF ;
//      for(data_pack_cnt=0;data_pack_cnt<3;data_pack_cnt++)
//       { 
//          DIAG_Req.byte(data_pack_cnt+5)= write_array_buff[data_pack_cnt] ;
//       }
//      output(DIAG_Req);
//      length_cnt = 0x21;
//      data_pack_cnt = 3;// have written 3 bytes of data.
//      setTimer(Data_Sending,10);
//      testwaitfortimeout(500);
//     }
     
// }

Write_did(byte DIDHigh,byte DIDLow,long len)
 {

    int p1;
    
    
    Step();
    l_temp1 = len+5;
    //l_temp1 = len;
      write("%d",l_temp1);

    for(p1=0;p1<1000;p1++)
    {
    write_array_buff[p1] = W_array[p1] ;      
    }
    
     if(len < 8 )
     {
      DIAG_Req.dlc = len+1;
//      DIAG_Req.byte(0)= len;
//      DIAG_Req.byte(1)= 0x2E;
//      DIAG_Req.byte(2)=  DIDHigh;
//      DIAG_Req.byte(3)=  DIDLow;
      for(i=0;i<8;i++)
      {
      DIAG_Req.byte(i)= write_array_buff[i] ;
      }
      output(DIAG_Req);
     }
     else
     {
      DIAG_Req.dlc = 8;
//      DIAG_Req.byte(0)= 0x10;
//      DIAG_Req.byte(1)= len;
//      DIAG_Req.byte(2)= 0x2E ;
//      DIAG_Req.byte(3)=  DIDHigh;
//      DIAG_Req.byte(4)=  DIDLow;
      for(data_pack_cnt=0;data_pack_cnt<8;data_pack_cnt++)
       { 
          DIAG_Req.byte(data_pack_cnt)= write_array_buff[data_pack_cnt] ;
       }
      output(DIAG_Req);
      length_cnt = 0x21;
      data_pack_cnt = 8;// have written 8 bytes of data.
      setTimer(Data_Sending1,50);
      testwaitfortimeout(500);
     }
     
 }

Write_did_FUN(byte DIDHigh,byte DIDLow,long len)
 {

    int p1;
    
    
      Step();
    l_temp1 = len+5; 
  write("%d",l_temp1);
    for(p1=0;p1<1000;p1++)
    {
    write_array_buff[p1] = W_array[p1] ;      
    }
    
     if(len < 8 )
     {
      FUN_Req.dlc = len+1;
//      FUN_Req.byte(0)= len;
//      FUN_Req.byte(1)= 0x2E;
//      FUN_Req.byte(2)=  DIDHigh;
//      FUN_Req.byte(3)=  DIDLow;
      for(i=0;i<8;i++)
      {
      FUN_Req.byte(i)= write_array_buff[i] ;
      }
      output(FUN_Req);
     }
     else
     {
      FUN_Req.dlc = 8;
//      FUN_Req.byte(0)= 0x10;
//      FUN_Req.byte(1)= len;
//      FUN_Req.byte(2)= 0x2E ;
//      FUN_Req.byte(3)=  DIDHigh;
//      FUN_Req.byte(4)=  DIDLow;
      for(data_pack_cnt=0;data_pack_cnt<8;data_pack_cnt++)
       { 
          FUN_Req.byte(data_pack_cnt)= write_array_buff[data_pack_cnt] ;
       }
      output(FUN_Req);
      length_cnt = 0x21;
      data_pack_cnt = 8;// have written 3 bytes of data.
      setTimer(FUN_Data_Sending1,50);
      testwaitfortimeout(500);
     }
     
 }

//long GetHostVariable(char var_sea_buf[] )
//{
//
//  long return_var_buf;
//  int var_cnt,Valid_i;
//  Valid_i = 0;
//   Step();
//  
//  for(var_cnt=0 ; var_cnt < 31333 ; var_cnt++ )
//  {
////  Accesing String from Environment Variable
////  getValue(variable_search, var_sea_buf);
////  testStep("Variable Name"," %s%s ",variable[var_cnt].name,var_sea_buf);
//  if(!strncmp(var_sea_buf,variable[var_cnt].name,strlen(var_sea_buf)))
//  {
//  if(strlen(var_sea_buf) == strlen(variable[var_cnt].name))
//  {
//  Valid_i =1;
////  testStep("Variable Name"," %s ",variable[var_cnt].name);
//  DIAG_Req.dlc = 8;
//  DIAG_Req.byte(0)= 0x07;
//  DIAG_Req.byte(1)= 0x23;
//  DIAG_Req.byte(2)= 0x14;
//  DIAG_Req.byte(3)= ((variable[var_cnt].address & 0xFF000000)>> 24);
//  DIAG_Req.byte(4)= ((variable[var_cnt].address & 0xFF0000)>> 16);
//  DIAG_Req.byte(5)= ((variable[var_cnt].address & 0xFF00)>> 8);
//  DIAG_Req.byte(6)= (variable[var_cnt].address & 0x00FF);
//  DIAG_Req.byte(7)= variable[var_cnt].size;
//  output(DIAG_Req);
//  testWaitForTimeout(100);
//  if(O_Resp[0]== 0x02)
//  {
////  testStep("","%s value is %X " ,variable[var_cnt].name,O_Resp[2] );
//    return_var_buf = O_Resp[2];
//  }
//  if(O_Resp[0]== 0x03)
//  {
////  testStep("","%s value is %X " ,variable[var_cnt].name,O_Resp[2] );
//    return_var_buf = O_Resp[2]+( O_Resp[3] << 8 );
//    COMMENT_DATA_DTC("Value ",return_var_buf);
//  }
//  if(O_Resp[0]== 0x04)
//  {
////  testStep("","%s value is %X " ,variable[var_cnt].name,O_Resp[2] );
//    return_var_buf = O_Resp[2]+( O_Resp[3] << 8 )+( O_Resp[4] << 16 );
//  }
//  if(O_Resp[0]== 0x05)
//  {
////  testStep("","%s value is %X " ,variable[var_cnt].name,O_Resp[2] );
//    return_var_buf = O_Resp[2]+( O_Resp[3] << 8 )+( O_Resp[4] << 16 )+( O_Resp[5] << 24 );
//  }
//  }
//  }
//  }
//
//  if(Valid_i == 0)
//  {
//    write("Variable Not Found in variable data.h");
//    ACTION("Variable Not Found in variable data.h");
//  }
//  return return_var_buf;
//}

//TestOutcome(char d[],long e)
//{ 
//    long t_i;
//   
//    ACTION("Get Variable ",d);
//    t_i = GetHostVariable(d);
//    testWaitForTimeout(100); 
//    OBSERVED_DATA("",t_i,1);
//    DIAGNOSTIC_REQUEST("",Tx_buffer,8);   
//    EXPECTED_DATA ("",e,1);    
//    Check(e,t_i);
//    testWaitForTimeout(100);
//
//}
//
//TestOutcome_counter(char d[],long e)
//{ 
//    long t_i;
//   
//    ACTION("Get Variable ",d);
//    t_i = GetHostVariable(d);
//    testWaitForTimeout(100); 
//    OBSERVED_DATA("",t_i,1);
//    DIAGNOSTIC_REQUEST("",Tx_buffer,8);   
//    EXPECTED_DATA ("",e,1);    
//    //Check(e,t_i);
//    testWaitForTimeout(100);
//
//}
//
//TestOutcome_bit(char d[],int e,int bit)
//{
//  int t_i,ind;
//  int sh_i;
//  sh_i = 0x01;
//
//    sh_i = sh_i << bit ;
//    ACTION("Get Variable ",d);
//    t_i = GetHostVariable(d);
//    COMMENT_DATA_DTC("Byte ",t_i);
//    t_i = (sh_i) & t_i ;
//    t_i = t_i >> bit ;  
//    testWaitForTimeout(100); 
//    OBSERVED_DATA("",t_i,1);
//    DIAGNOSTIC_REQUEST("",Tx_buffer,8);   
//    EXPECTED_DATA ("",e,1);    
//    Check(e,t_i);
//    testWaitForTimeout(200);
//
//}
//
//TestOutcome_lamps(char d[],int e,int mask,int bit)
//{
//  int t_i,ind;
//  int sh_i;
//  sh_i = 0x01;
//
//   
//  
//   // sh_i = sh_i << bit ;
//    ACTION("Get Variable ",d);
//    t_i = GetHostVariable(d);
//    COMMENT_DATA_DTC("Byte ",t_i);
//    t_i = (mask) & t_i ;
//    t_i = t_i >> bit ;  
//    testWaitForTimeout(100); 
//    OBSERVED_DATA("",t_i,1);
//    DIAGNOSTIC_REQUEST("",Tx_buffer,8);   
//    EXPECTED_DATA ("",e,1);    
//    Check(e,t_i);
//    testWaitForTimeout(200);
//
//}
//
//TestOutcome(char d[],int e,int f)
//{
//  int t_i;
// 
//    ACTION("Get ",d);
//    t_i = GetHostVariable(d);
//    testWaitForTimeout(100); 
//    OBSERVED_DATA("",t_i,1);
//    DIAGNOSTIC_REQUEST("",Tx_buffer,8);
//    EXPECTED_RANGE_DATA ("Range",e,f); 
//    Check(e,f,t_i);
//    testWaitForTimeout(100);
//
//}


//
//TestSignal(char d[],int e)
//{
//  int t_i;
//
//    ACTION("Get Signal for variable ",d);
//    t_i = GetHostVariable(d);
//    testWaitForTimeout(100); 
//    OBSERVED_DATA("",e,1);
//    DIAGNOSTIC_REQUEST("",Tx_buffer,8);   
//    EXPECTED_DATA ("",t_i,1);    
//    Check(e,t_i);
//    write("%d  %d",t_i,e);
//    testWaitForTimeout(2000);
//
//}



TestSignal(int d,int e)
{
  int t_i;

    ACTION("Get Signal");
    testWaitForTimeout(100); 
    OBSERVED_DATA("",e,1);
    DIAGNOSTIC_REQUEST("",Tx_buffer,8);   
    EXPECTED_DATA ("",d,1);    
    Check(e,d);
    testWaitForTimeout(2000);

}

//qword GetHostVariable_byte(char var_sea_buf[] )
//{
//  qword return_var_buf;
//  int var_cnt=0,Valid_i;
//  Valid_i = 0;
//
//  for(var_cnt=0 ; var_cnt < 31333 ; var_cnt++ )
//  {
////  Accesing String from Environment Variable
////  getValue(variable_search, var_sea_buf);
////  testStep("Variable Name"," %s%s ",variable[var_cnt].name,var_sea_buf);
//  if(!strncmp(var_sea_buf,variable[var_cnt].name,strlen(var_sea_buf)))
//  {
//  if(strlen(var_sea_buf) == strlen(variable[var_cnt].name))
//  {
//  Valid_i =1;
////  testStep("Variable Name"," %s ",variable[var_cnt].name);
//  DIAG_Req.dlc = 8;
//  DIAG_Req.byte(0)= 0x10;
//  DIAG_Req.byte(1)= 0x08;
//  DIAG_Req.byte(2)= 0x23;
//  DIAG_Req.byte(3)= 0x24;
//  DIAG_Req.byte(4)= ((variable[var_cnt].address & 0xFF000000)>> 24);
//  DIAG_Req.byte(5)= ((variable[var_cnt].address & 0xFF0000)>> 16);
//  DIAG_Req.byte(6)= ((variable[var_cnt].address & 0xFF00)>> 8);
//  DIAG_Req.byte(7)= (variable[var_cnt].address & 0x00FF);
//  output(DIAG_Req);
//  testWaitForTimeout(20);
//  DIAG_Req.byte(0)= 0x21;
//  DIAG_Req.byte(1)= 0;
//  DIAG_Req.byte(2)= variable[var_cnt].size;
//  DIAG_Req.byte(3)= 0;
//  DIAG_Req.byte(4)= 0;
//  DIAG_Req.byte(5)= 0;
//  DIAG_Req.byte(6)= 0;
//  DIAG_Req.byte(7)= 0;
//  output(DIAG_Req);
//  testWaitForTimeout(100);
//  
//  if(O_Resp[0]== 0x02)
//  {
////  testStep("","%s value is %X " ,variable[var_cnt].name,O_Resp[2] );
//    return_var_buf = O_Resp[2];
//  }
//  if(O_Resp[0]== 0x03)
//  {
////  testStep("","%s value is %X " ,variable[var_cnt].name,O_Resp[2] );
//    return_var_buf = O_Resp[2]+( O_Resp[3] << 8 );
//  }
//  if(O_Resp[0]== 0x04)
//  {
////  testStep("","%s value is %X " ,variable[var_cnt].name,O_Resp[2] );
//    write("i am in loop");
//    return_var_buf = O_Resp[2]+( O_Resp[3] << 8 )+( O_Resp[4] << 16 );}
//  if(O_Resp[0]== 0x05)
//  {
////  testStep("","%s value is %X " ,variable[var_cnt].name,O_Resp[2] );
//    return_var_buf = O_Resp[2]+( O_Resp[3] << 8 )+( O_Resp[4] << 16 )+( O_Resp[5] << 24 );
//  }
//  }
//  }
//  }
//
//  if(Valid_i == 0)
//  {
//    write("Variable Not Found in variable data.h");
//  }
//  return return_var_buf;
//}


//TestOutcome_byte(char d[],long e) 
//{ 
//  long t_i; 
////Session(3); 
////Session_tester(0x60); 
////Security_Access(); 
// // tester_present(); 
//    ACTION("Get Variable_byte ",d); 
//    t_i = GetHostVariable_byte(d); 
//    testWaitForTimeout(100); 
//    OBSERVED_DATA("",t_i,1); 
//    DIAGNOSTIC_REQUEST("",Tx_buffer,16);   
//    EXPECTED_DATA ("",e,1); 
//      Check(e,t_i); 
//    testWaitForTimeout(100); 
//  
////    if( e- t_i<=0x0050) 
////  { 
////    count = count+1; 
////  } 
//// 
////  
////  if(count == 1) 
////  { 
////    Add_to_report(PASSED); 
////    count=0; 
////  } 
////  else 
////  { 
////    Add_to_report(FAILED);  
////    count=0; 
////  } 
////  testwaitfortimeout(1200); 
////      Clear_Buffer(); 
//// testWaitForTimeout(1000); 
//}

void DID_Write(byte DIDHigh,byte DIDLow,byte No_of_Bytes)
{
  if(No_of_Bytes <= 0x07)
   {
      DIAG_Req.dlc = 8;
      DIAG_Req.byte(0)=  No_of_Bytes;
      DIAG_Req.byte(1)=  0x2E;
      DIAG_Req.byte(2)=  DIDHigh ;
      DIAG_Req.byte(3)=  DIDLow;
      DIAG_Req.byte(4)=  W_array[0];
      DIAG_Req.byte(5)=  W_array[1];
      DIAG_Req.byte(6)=  W_array[2];
      DIAG_Req.byte(7)=  W_array[3];
      output(DIAG_Req);
      testwaitfortimeout(200);  
  }
  
  if(No_of_Bytes > 0x07)
   {
      DIAG_Req.dlc = 8;
      DIAG_Req.byte(0)=  0x10;
      DIAG_Req.byte(1)=  No_of_Bytes;
      DIAG_Req.byte(2)=  0x2E ;
      DIAG_Req.byte(3)=  DIDHigh;
      DIAG_Req.byte(4)=  DIDLow;
      DIAG_Req.byte(5)=  W_array[0];
      DIAG_Req.byte(6)=  W_array[1];
      DIAG_Req.byte(7)=  W_array[2];
      output(DIAG_Req);
      testwaitfortimeout(50); //100
   
    
      DIAG_Req.dlc = 8;
      DIAG_Req.byte(0)=  0x21;
      DIAG_Req.byte(1)=  W_array[3];
      DIAG_Req.byte(2)=  W_array[4];
      DIAG_Req.byte(3)=  W_array[5];
      DIAG_Req.byte(4)=  W_array[6];
      DIAG_Req.byte(5)=  W_array[7];
      DIAG_Req.byte(6)=  W_array[8];
      DIAG_Req.byte(7)=  W_array[9];
      output(DIAG_Req);
      testwaitfortimeout(50); 
     
  }
    
   if(No_of_Bytes > 0x0D)
  {
      DIAG_Req.dlc = 8;
      DIAG_Req.byte(0)=  0x22;
      DIAG_Req.byte(1)=  W_array[10];
      DIAG_Req.byte(2)=  W_array[11];
      DIAG_Req.byte(3)=  W_array[12];
      DIAG_Req.byte(4)=  W_array[13];
      DIAG_Req.byte(5)=  W_array[14];
      DIAG_Req.byte(6)=  W_array[15];
      DIAG_Req.byte(7)=  W_array[16];
      output(DIAG_Req);
      testwaitfortimeout(50); 
  }
  if (No_of_Bytes > 0x14)
  {
      DIAG_Req.dlc = 8;
      DIAG_Req.byte(0)=  0x23;
      DIAG_Req.byte(1)=  W_array[17];
      DIAG_Req.byte(2)=  W_array[18];
      DIAG_Req.byte(3)=  W_array[19];
      DIAG_Req.byte(4)=  W_array[20];
      DIAG_Req.byte(5)=  W_array[21];
      DIAG_Req.byte(6)=  W_array[22];
      DIAG_Req.byte(7)=  W_array[23];
      output(DIAG_Req);
      testwaitfortimeout(50);
  }
   if (No_of_Bytes > 0x1B)
  {
      DIAG_Req.dlc = 8;
      DIAG_Req.byte(0)=  0x24;
      DIAG_Req.byte(1)=  W_array[24];
      DIAG_Req.byte(2)=  W_array[25];
      DIAG_Req.byte(3)=  W_array[26];
      DIAG_Req.byte(4)=  W_array[27];
      DIAG_Req.byte(5)=  W_array[28];
      DIAG_Req.byte(6)=  W_array[29];
      DIAG_Req.byte(7)=  W_array[30];
      output(DIAG_Req);
      testwaitfortimeout(50);
  }
  if (No_of_Bytes > 0x22)
  {
      DIAG_Req.dlc = 8;
      DIAG_Req.byte(0)=  0x25;
      DIAG_Req.byte(1)=  W_array[31];
      DIAG_Req.byte(2)=  W_array[32];
      DIAG_Req.byte(3)=  W_array[33];
      DIAG_Req.byte(4)=  W_array[34];
      DIAG_Req.byte(5)=  W_array[35];
      DIAG_Req.byte(6)=  W_array[36];
      DIAG_Req.byte(7)=  W_array[37];
      output(DIAG_Req);
      testwaitfortimeout(50);
  }
      
      if(No_of_Bytes <= 0x07)
      DIAGNOSTIC_REQUEST("",W_array,8);
      
      if((No_of_Bytes>0x07)&& (No_of_Bytes<0x0D))
      DIAGNOSTIC_REQUEST("",W_array,16);
      
      if((No_of_Bytes>0x0D)&& (No_of_Bytes<0x14))
      DIAGNOSTIC_REQUEST("",W_array,24);
      
      if((No_of_Bytes>0x14)&& (No_of_Bytes<0x1B))
      DIAGNOSTIC_REQUEST("",W_array,32);
      
      if((No_of_Bytes>0x1B)&& (No_of_Bytes<0x22))
      DIAGNOSTIC_REQUEST("",W_array,40);
      
      if(O_Resp[0]==0x10)
     OBSERVED_DATA("",O_Resp,( O_Resp[1] + ((O_Resp[1] - 6)/7) + 3 ));
    else
     OBSERVED_DATA("",O_Resp,8);
      
      Expect1(0x03,0x6E,DIDHigh,DIDLow,0x00,0x00,0x00,0x00);
      EXPECTED_DATA ("",E_Resp,8);  
//      OBSERVED_DATA("",O_Resp,8);
      Check(E_Resp,O_Resp);
      testWaitForTimeout(2000); 
    
  }

void DID_Write_Func(byte DIDHigh,byte DIDLow,byte No_of_Bytes)
{
  if(No_of_Bytes <= 0x07)
   {
      FUN_Req.dlc = 8;
      FUN_Req.byte(0)=  No_of_Bytes;
      FUN_Req.byte(1)=  0x2E;
      FUN_Req.byte(2)=  DIDHigh ;
      FUN_Req.byte(3)=  DIDLow;
      FUN_Req.byte(4)=  W_array[0];
      FUN_Req.byte(5)=  W_array[1];
      FUN_Req.byte(6)=  W_array[2];
      FUN_Req.byte(7)=  W_array[3];
      output(FUN_Req);
      testwaitfortimeout(200);  
  }
  
  if(No_of_Bytes > 0x07)
   {
      FUN_Req.dlc = 8;
      FUN_Req.byte(0)=  0x10;
      FUN_Req.byte(1)=  No_of_Bytes;
      FUN_Req.byte(2)=  0x2E ;
      FUN_Req.byte(3)=  DIDHigh;
      FUN_Req.byte(4)=  DIDLow;
      FUN_Req.byte(5)=  W_array[0];
      FUN_Req.byte(6)=  W_array[1];
      FUN_Req.byte(7)=  W_array[2];
      output(FUN_Req);
      testwaitfortimeout(50); //100
   
    
      FUN_Req.dlc = 8;
      FUN_Req.byte(0)=  0x21;
      FUN_Req.byte(1)=  W_array[3];
      FUN_Req.byte(2)=  W_array[4];
      FUN_Req.byte(3)=  W_array[5];
      FUN_Req.byte(4)=  W_array[6];
      FUN_Req.byte(5)=  W_array[7];
      FUN_Req.byte(6)=  W_array[8];
      FUN_Req.byte(7)=  W_array[9];
      output(FUN_Req);
      testwaitfortimeout(50); 
     
  }
    
   if(No_of_Bytes > 0x0D)
  {
      FUN_Req.dlc = 8;
      FUN_Req.byte(0)=  0x22;
      FUN_Req.byte(1)=  W_array[10];
      FUN_Req.byte(2)=  W_array[11];
      FUN_Req.byte(3)=  W_array[12];
      FUN_Req.byte(4)=  W_array[13];
      FUN_Req.byte(5)=  W_array[14];
      FUN_Req.byte(6)=  W_array[15];
      FUN_Req.byte(7)=  W_array[16];
      output(FUN_Req);
      testwaitfortimeout(50); 
  }
  if (No_of_Bytes > 0x14)
  {
      FUN_Req.dlc = 8;
      FUN_Req.byte(0)=  0x23;
      FUN_Req.byte(1)=  W_array[17];
      FUN_Req.byte(2)=  W_array[18];
      FUN_Req.byte(3)=  W_array[19];
      FUN_Req.byte(4)=  W_array[20];
      FUN_Req.byte(5)=  W_array[21];
      FUN_Req.byte(6)=  W_array[22];
      FUN_Req.byte(7)=  W_array[23];
      output(FUN_Req);
      testwaitfortimeout(50);
  }
   if (No_of_Bytes > 0x1B)
  {
      FUN_Req.dlc = 8;
      FUN_Req.byte(0)=  0x24;
      FUN_Req.byte(1)=  W_array[24];
      FUN_Req.byte(2)=  W_array[25];
      FUN_Req.byte(3)=  W_array[26];
      FUN_Req.byte(4)=  W_array[27];
      FUN_Req.byte(5)=  W_array[28];
      FUN_Req.byte(6)=  W_array[29];
      FUN_Req.byte(7)=  W_array[30];
      output(FUN_Req);
      testwaitfortimeout(50);
  }
  if (No_of_Bytes > 0x22)
  {
      FUN_Req.dlc = 8;
      FUN_Req.byte(0)=  0x25;
      FUN_Req.byte(1)=  W_array[31];
      FUN_Req.byte(2)=  W_array[32];
      FUN_Req.byte(3)=  W_array[33];
      FUN_Req.byte(4)=  W_array[34];
      FUN_Req.byte(5)=  W_array[35];
      FUN_Req.byte(6)=  W_array[36];
      FUN_Req.byte(7)=  W_array[37];
      output(FUN_Req);
      testwaitfortimeout(50);
  }
      
      if(No_of_Bytes <= 0x07)
      DIAGNOSTIC_REQUEST("",W_array,8);
      
      if((No_of_Bytes>0x07)&& (No_of_Bytes<0x0D))
      DIAGNOSTIC_REQUEST("",W_array,16);
      
      if((No_of_Bytes>0x0D)&& (No_of_Bytes<0x14))
      DIAGNOSTIC_REQUEST("",W_array,24);
      
      if((No_of_Bytes>0x14)&& (No_of_Bytes<0x1B))
      DIAGNOSTIC_REQUEST("",W_array,32);
      
      if((No_of_Bytes>0x1B)&& (No_of_Bytes<0x22))
      DIAGNOSTIC_REQUEST("",W_array,40);
      
      if(O_Resp[0]==0x10)
     OBSERVED_DATA("",O_Resp,( O_Resp[1] + ((O_Resp[1] - 6)/7) + 3 ));
    else
     OBSERVED_DATA("",O_Resp,8);
      
      Expect1(0x00,0x00,0x00,0x00,0x00,0x00,0x00,0x00);
      EXPECTED_DATA ("",E_Resp,8);  
//      OBSERVED_DATA("",O_Resp,8);
      Check(E_Resp,O_Resp);
      testWaitForTimeout(2000); 
    
  }


//SetHostVariable(char var_sea_buf[] , long sethost_value )
//{
//
//  int var_cnt,Valid_i;
//  Valid_i = 0;
//  Step();
//  
//  for(var_cnt=0 ; var_cnt< 31333 ; var_cnt++ )
//  {
//  if(!strncmp(var_sea_buf,variable[var_cnt].name,strlen(var_sea_buf)))
//  {
//  if(strlen(var_sea_buf) == strlen(variable[var_cnt].name))
//  {
//  Valid_i = 1;
//  DIAG_Req.dlc = 8;
//  DIAG_Req.byte(0)= 0x10;
//  DIAG_Req.byte(1)= 0x07+variable[var_cnt].size;
//  DIAG_Req.byte(2)= 0x3D;
//  DIAG_Req.byte(3)= 0x14;
//  DIAG_Req.byte(4)= ((variable[var_cnt].address & 0xFF000000)>> 24);
//  DIAG_Req.byte(5)= ((variable[var_cnt].address & 0xFF0000)>> 16);
//  DIAG_Req.byte(6)= ((variable[var_cnt].address & 0xFF00)>> 8);
//  DIAG_Req.byte(7)= (variable[var_cnt].address & 0x00FF);
//  output(DIAG_Req);
//  testWaitForTimeout(50);
//  DIAG_Req.dlc = 8;
//  DIAG_Req.byte(0)= 0x21;
//  DIAG_Req.byte(1)= variable[var_cnt].size;
//  DIAG_Req.byte(2)= sethost_value & 0x00FF  /*( sethost_value && 0x00FF )*/ ;
//  DIAG_Req.byte(3)= sethost_value>>8 /*( sethost_value>>8 )*/;
//  DIAG_Req.byte(4)= 0x00;
//  DIAG_Req.byte(5)= 0x00;
//  DIAG_Req.byte(6)= 0x00;
//  DIAG_Req.byte(7)= 0x00;
//
//  output(DIAG_Req);
//  testWaitForTimeout(50);
//  }
//  }
//  }
//  if(Valid_i == 0)
//  {
//    write("Variable Not Found in variable data.h");
//    ACTION("Variable Not Found in variable data.h");
//  }
//  
//    ACTION("Set ",var_sea_buf);
//    testWaitForTimeout(200); 
//    OBSERVED_DATA("",O_Resp,8);
//    DIAGNOSTIC_REQUEST("",Tx_buffer,16);
//    
//    EXPECTED_DATA ("Positive Response",0x7D,1);    
//    Check(0x7D,O_Resp[1]);
//    testWaitForTimeout(200);
//
//}

Clear_DTC()
{
	DIAG_Req.dlc = 8;
  DIAG_Req.byte(0)= 0x04;
  DIAG_Req.byte(1)= 0x14;
  DIAG_Req.byte(2)= 0xFF;
  DIAG_Req.byte(3)= 0xFF;
  DIAG_Req.byte(4)= 0xFF;
  DIAG_Req.byte(5)= 0;
  DIAG_Req.byte(6)= 0;
  DIAG_Req.byte(7)= 0;
  output(DIAG_Req);
 
  ACTION("Clear DTCs");
  testWaitForTimeout(1000); 
  OBSERVED_DATA("",O_Resp,8);
  DIAGNOSTIC_REQUEST("",Tx_buffer,8);
  Expect(0x01,0x54,0x00,0x00,0x00,0x00,0x00,0x00);
  EXPECTED_DATA ("",E_Resp,8);  
  Check(E_Resp,O_Resp);
  testWaitForTimeout(2000);  
}

Clear_DTC_particular(long dtc_name_i)
{

	DIAG_Req.dlc = 8;
  DIAG_Req.byte(0)= 0x04;
  DIAG_Req.byte(1)= 0x14;
  DIAG_Req.byte(2)= ( dtc_name_i >> 16 ) & 0xFF ;
  DIAG_Req.byte(3)= ( dtc_name_i >> 08 ) & 0xFF ;
  DIAG_Req.byte(4)= dtc_name_i & 0xFF ;
  DIAG_Req.byte(5)= 0x00;
  DIAG_Req.byte(6)= 0x00;
  DIAG_Req.byte(7)= 0;
  
  
  
  output(DIAG_Req);
 
  ACTION("Clear Diagnostics ");
  testWaitForTimeout(1000); 
  OBSERVED_DATA("",O_Resp,8);
  DIAGNOSTIC_REQUEST("",Tx_buffer,8);
  Expect(0x01,0x54,0x00,0x00,0x00,0x00,0x00,0x00);
  EXPECTED_DATA ("",E_Resp,8);  
  Check(E_Resp,O_Resp);
  testWaitForTimeout(2000);  
}

RecycleIgnition(int y)
{
 Step();
	DIAG_Req.dlc = 8;
  DIAG_Req.byte(0)= 0x2;
  DIAG_Req.byte(1)= 0x11;
  DIAG_Req.byte(2)= y;
  DIAG_Req.byte(3)= 0x00;
  DIAG_Req.byte(4)= 0x00;
  DIAG_Req.byte(5)= 0x00;
  DIAG_Req.byte(6)= 0x00;
  DIAG_Req.byte(7)= 0x00;
  output(DIAG_Req);
  testwaitfortimeout(500);
  
  ACTION("Recycle Ignition "); 
  OBSERVED_DATA("",O_Resp,8);
  DIAGNOSTIC_REQUEST("",Tx_buffer,8);
  Expect(0x02,0x51,y,0xCC,0xCC,0xCC,0xCC,0xCC);
  EXPECTED_DATA ("",E_Resp,8);  
  Check(E_Resp,O_Resp);
  testWaitForTimeout(21000);  
}

Battery_Ignition()
{
  SetBattVoltage(0);
  testwaitfortimeout(2000);
  SetBattVoltage (12.5);
  testwaitfortimeout(3000);
}
//Recycle_Ignition()
//{
//  SetBattVoltage_IGN(0);
//  testwaitfortimeout(5000);
//  SetBattVoltage_IGN (12.5);
//  testwaitfortimeout(5000);
//}
Tester_Present(int y)
{

	DIAG_Req.dlc = 8;
  DIAG_Req.byte(0)= 0x02;
  DIAG_Req.byte(1)= 0x3E;
  output(DIAG_Req);
  testwaitfortimeout(500);
}

//Void checkSignalvalue(float EXP, float OBS)
//{
//  if((OBS <= EXP+0.5)&& (OBS >= EXP-0.5))
//    {
//    Add_To_Report(PASSED);
//    }
//    else
//    {
//    Add_To_Report(FAILED);
//    }
//}

//CCP_Connect()
//{
//  ACTION("CCP_Connect");
//  DIAG_Req_CCP.dlc = 8;
//  DIAG_Req_CCP.byte(0)= 0xFF;
//  DIAG_Req_CCP.byte(1)= 0x00;
//  DIAG_Req_CCP.byte(2)= 0x00;
//  DIAG_Req_CCP.byte(3)= 0x00;
//  DIAG_Req_CCP.byte(4)= 0x00;
//  DIAG_Req_CCP.byte(5)= 0x00;
//  DIAG_Req_CCP.byte(6)= 0x00;
//  DIAG_Req_CCP.byte(7)= 0x00;
//  
//  Output(DIAG_Req_CCP);
//  testwaitfortimeout(200); 
//}

//Disconnect_ccp()
//{
//  DIAG_Req_CCP.dlc = 8;
//  DIAG_Req_CCP.byte(0)= 0xFE;
//  DIAG_Req_CCP.byte(1)= 0x00;
//  DIAG_Req_CCP.byte(2)= 0x00;
//  DIAG_Req_CCP.byte(3)= 0x00;
//  DIAG_Req_CCP.byte(4)= 0x00;
//  DIAG_Req_CCP.byte(5)= 0x00;
//  DIAG_Req_CCP.byte(6)= 0x00;
//  DIAG_Req_CCP.byte(7)= 0x00;
//  
//  Output(DIAG_Req_CCP);
//  testwaitfortimeout(200); 
//}

//User_CMD(long x, long y)
//{
//  DIAG_Req_CCP.dlc = 8;
//  DIAG_Req_CCP.byte(0)= 0xF1;
//  DIAG_Req_CCP.byte(1)= 0x08;
//  DIAG_Req_CCP.byte(2)= x;
//  DIAG_Req_CCP.byte(3)= y;
//  DIAG_Req_CCP.byte(4)= 0x00;   
//  DIAG_Req_CCP.byte(5)= 0x00;
//  DIAG_Req_CCP.byte(6)= 0x00;
//  DIAG_Req_CCP.byte(7)= 0x00;
//  Output(DIAG_Req_CCP);
//  testwaitfortimeout(200); 
//}

Read_DTC(int mask)
{
  Step();
  DIAG_Req.dlc = 8;
  DIAG_Req.byte(0)= 0x03;
  DIAG_Req.byte(1)= 0x19;
  DIAG_Req.byte(2)= 0x01;
  DIAG_Req.byte(3)= mask;
  DIAG_Req.byte(4)= 0x00;
  DIAG_Req.byte(5)= 0x00;
  DIAG_Req.byte(6)= 0x00;
  DIAG_Req.byte(7)= 0x00;
  output(DIAG_Req);
  
  DIAGNOSTIC_REQUEST("",Tx_buffer,8);
  testWaitForTimeout(100);
  
  if(O_Resp[0] < 0x10)
  {
  OBSERVED_DATA("",O_Resp,(O_Resp[0] +1 ));
  }
  if(O_Resp[0] == 0x10)
  {
  OBSERVED_DATA("",O_Resp ,( O_Resp[1] + ((O_Resp[1] - 6)/7) + ( (O_Resp[1]-6) % 7 ) + 2 ) );
  }
  
}
 

Read_DTC_Extended(long dtc_name_i)
{
  Step();
  ACTION("ReadDTCInformation Request Message");
  DIAG_Req.dlc = 8;
  DIAG_Req.byte(0)= 0x06;
  DIAG_Req.byte(1)= 0x19;
  DIAG_Req.byte(2)= 0x06;
  DIAG_Req.byte(3)= ( dtc_name_i >> 16 ) & 0xFF ;
  DIAG_Req.byte(4)= ( dtc_name_i >> 08 ) & 0xFF ;
  DIAG_Req.byte(5)= dtc_name_i & 0xFF ;
  DIAG_Req.byte(6)= 0xFF;
  DIAG_Req.byte(7)= 0x00;
  output(DIAG_Req);
  testWaitForTimeout(100);
  
  DIAGNOSTIC_REQUEST("",Tx_buffer,8);
  
  if(O_Resp[0] < 0x10)
  {
  OBSERVED_DATA("",O_Resp,(O_Resp[0] +1 ));
  }
  if(O_Resp[0] == 0x10)
  {
  OBSERVED_DATA("",O_Resp ,( O_Resp[1] + ((O_Resp[1] - 6)/7) + ( (O_Resp[1]-6) % 7 ) + 2 ) );
  }
  
  
}
  
Read_DTC_Extended_with_status(long dtc_name_i,byte expected)
{
  Step();
  ACTION("ReadDTCInformation Request Message");
  DIAG_Req.dlc = 8;
  DIAG_Req.byte(0)= 0x06;
  DIAG_Req.byte(1)= 0x19;
  DIAG_Req.byte(2)= 0x06;
  DIAG_Req.byte(3)= ( dtc_name_i >> 16 ) & 0xFF ;
  DIAG_Req.byte(4)= ( dtc_name_i >> 08 ) & 0xFF ;
  DIAG_Req.byte(5)= dtc_name_i & 0xFF ;
  DIAG_Req.byte(6)= 0xFF;
  DIAG_Req.byte(7)= 0x00;
  output(DIAG_Req);
  testWaitForTimeout(100);
  
  DIAGNOSTIC_REQUEST("",Tx_buffer,8);
  
  if(O_Resp[0] < 0x10)
  {
  OBSERVED_DATA("",O_Resp,(O_Resp[0] +1 ));
  }
  if(O_Resp[0] == 0x10)
  {
  OBSERVED_DATA("",O_Resp ,( O_Resp[1] + ((O_Resp[1] - 6)/7) + ( (O_Resp[1]-6) % 7 ) + 2 ) );
  }
  
  if(O_Resp[7] == expected)
    {
      {
      if((expected==0x89)||(expected==0x09)) 
        COMMENT_DATA("DTC is active");
      else if(expected==0x08)
        COMMENT_DATA("DTC is not active,it is in history");
       else
      COMMENT_DATA("No DTC is logged for DTC Number ");
    }
     Add_to_report(PASSED);
    }
    else
      Add_to_report(FAILED);
    
  
}


//Read_DTC_Name(int mask)
//{
// 
//  int dtc_cnt;
//  char dtc_name_buffer[100];
//  int rd;
//  Step();
//  
//  DIAG_Req.dlc = 8;
//  DIAG_Req.byte(0)= 0x03;
//  DIAG_Req.byte(1)= 0x19;
//  DIAG_Req.byte(2)= 0x02;
//  DIAG_Req.byte(3)= mask;
//  DIAG_Req.byte(4)= 0x00;
//  DIAG_Req.byte(5)= 0x00;
//  DIAG_Req.byte(6)= 0x00;
//  DIAG_Req.byte(7)= 0x00;
//  output(DIAG_Req);
//  testWaitForTimeout(100);
//  DIAGNOSTIC_REQUEST("",Tx_buffer,8);
//  
//  if(O_Resp[0] < 0x10)
//  {
//  OBSERVED_DATA("",O_Resp,(O_Resp[0] +1 ));
//  }
//  if(O_Resp[0] == 0x10)
//  {
//  OBSERVED_DATA("",O_Resp ,( O_Resp[1] + ((O_Resp[1] - 6)/7) + ( (O_Resp[1]-6) % 7 ) + 2 ) );
//  }
//
////  ACTION(" No of DTC - ",((O_Resp[1]-3)/4));
//  COMMENT_DATA("DTC - Status");
//  if(O_Resp[0]==0x10)
//  {
//  for(rd = 0 ; rd < O_Resp[1] ; )
//  {
//    if((O_Resp[read_index[rd]]!=0) | (O_Resp[read_index[rd+1]]!=0) |(O_Resp[read_index[rd+2]]!=0))
//    {
//    for(dtc_cnt=0 ; dtc_cnt<elcount(dtc_n) ; dtc_cnt++ )
//        {
//        if( ((O_Resp[read_index[rd]]<<16)+(O_Resp[read_index[rd+1]]<<8)+(O_Resp[read_index[rd+2]])) == dtc_n[dtc_cnt].dtc_number)
//        {
//          snprintf(dtc_name_buffer,elcount(dtc_name_buffer)," %s", dtc_n[dtc_cnt].dtc_name);
//          COMMENT_DATA_DTC(dtc_name_buffer,O_Resp[read_index[rd+3]]);
//        }
//        }
//    }
//    rd +=4;
//  }
//  }
//  if(O_Resp[0] < 0x10)
//  {
//  for(rd = 0 ; rd < O_Resp[0]-3 ; )
//  {
//    if((O_Resp[read_index_single_frame[rd]]!=0) | (O_Resp[read_index_single_frame[rd+1]]!=0) |(O_Resp[read_index_single_frame[rd+2]]!=0))
//    {
//    for(dtc_cnt=0 ; dtc_cnt<elcount(dtc_n) ; dtc_cnt++ )
//        {
//        if( ((O_Resp[read_index_single_frame[rd]]<<16)+(O_Resp[read_index_single_frame[rd+1]]<<8)+(O_Resp[read_index_single_frame[rd+2]])) == dtc_n[dtc_cnt].dtc_number)
//        {
//          snprintf(dtc_name_buffer,elcount(dtc_name_buffer)," %s", dtc_n[dtc_cnt].dtc_name);
//          COMMENT_DATA_DTC(dtc_name_buffer,O_Resp[read_index_single_frame[rd+3]]);
//        }
//        }     
//    }
//    rd +=4;
//  }
//  }  
//  
//  
//  
//}

//Read_DTC_NAME_MASK(long DTC_no,int mask)
//{
//
//  int dtc_cnt;
//  char dtc_name_buffer[100];
//  int rd;
//  int validdtc; 
//
//  validdtc = 0;
//  Step();
//  
//  
//  DIAG_Req.dlc = 8;
//  DIAG_Req.byte(0)= 0x03;
//  DIAG_Req.byte(1)= 0x19;
//  DIAG_Req.byte(2)= 0x02;
//  DIAG_Req.byte(3)= mask;
//  DIAG_Req.byte(4)= 0x00;
//  DIAG_Req.byte(5)= 0x00;
//  DIAG_Req.byte(6)= 0x00;
//  DIAG_Req.byte(7)= 0x00;
//  output(DIAG_Req);
//  testWaitForTimeout(100);
//  
//  if(O_Resp[0] < 0x10)
//  {
//  OBSERVED_DATA("",O_Resp,(O_Resp[0] +1 ));
//  }
//  if(O_Resp[0] == 0x10)
//  {
//  OBSERVED_DATA("",O_Resp ,( O_Resp[1] + ((O_Resp[1] - 6)/7) + ( (O_Resp[1]-6) % 7 ) + 2 ) );
//  }
//
//  ACTION(" No of DTC - ",((O_Resp[1]-3)/4));
//  COMMENT_DATA("DTC - Status");
//  if(O_Resp[0]==0x10)
//  {
//  for(rd = 0 ; rd < O_Resp[1] ; )
//  {
//    if((O_Resp[read_index[rd]]!=0) | (O_Resp[read_index[rd+1]]!=0) |(O_Resp[read_index[rd+2]]!=0))
//    {
//    if((O_Resp[read_index[rd]]== (DTC_no >> 16)) & (O_Resp[read_index[rd+1]] == ((DTC_no & 0x00FF00) >> 8 )) & (O_Resp[read_index[rd+2]]== (DTC_no & 0x0000FF)))
//    {
//    for(dtc_cnt=0 ; dtc_cnt<elcount(dtc_n) ; dtc_cnt++ )
//        {
//        if( ((O_Resp[read_index[rd]]<<16)+(O_Resp[read_index[rd+1]]<<8)+(O_Resp[read_index[rd+2]])) == dtc_n[dtc_cnt].dtc_number)
//        {
//          snprintf(dtc_name_buffer,elcount(dtc_name_buffer)," %s", dtc_n[dtc_cnt].dtc_name);
//          COMMENT_DATA_DTC(dtc_name_buffer,O_Resp[read_index[rd+3]]);
//        }
//        }
//    validdtc=1;    
//    }
//    }
//    rd +=4;
//  }
//  }
//  
//  if(O_Resp[0] < 0x10)
//  {
//  for(rd = 0 ; rd < O_Resp[0]-3 ; )
//  {
//    if((O_Resp[read_index_single_frame[rd]]!=0) | (O_Resp[read_index_single_frame[rd+1]]!=0) |(O_Resp[read_index_single_frame[rd+2]]!=0))
//    {
//    if((O_Resp[read_index_single_frame[rd]]== (DTC_no >> 16)) & (O_Resp[read_index_single_frame[rd+1]] == ((DTC_no & 0x00FF00) >> 8 )) & (O_Resp[read_index_single_frame[rd+2]]== (DTC_no & 0x0000FF)))
//    {
//    for(dtc_cnt=0 ; dtc_cnt<elcount(dtc_n) ; dtc_cnt++ )
//        {
//        if( ((O_Resp[read_index_single_frame[rd]]<<16)+(O_Resp[read_index_single_frame[rd+1]]<<8)+(O_Resp[read_index_single_frame[rd+2]])) == dtc_n[dtc_cnt].dtc_number)
//        {
//          snprintf(dtc_name_buffer,elcount(dtc_name_buffer)," %s", dtc_n[dtc_cnt].dtc_name);
//          COMMENT_DATA_DTC(dtc_name_buffer,O_Resp[read_index_single_frame[rd+3]]);
//        }
//        }
//    validdtc=1;  
//    }
//    }
//    rd +=4;
//  }
//  }  
//  
//  
//  if (validdtc == 0)
//  {
//    COMMENT_DATA("No DTC is logged for DTC Number ");
//  }  
//  
//}

//Read_DTC_Name_3(long DTC_no,int expected,int mask)
//{
//
//  int dtc_cnt;
//  char dtc_name_buffer[100];
//  int rd;
//  int validdtc; 
//
//  validdtc = 0;
//  
//  
//   Step();
//  DIAG_Req.dlc = 8;
//  DIAG_Req.byte(0)= 0x03;
//  DIAG_Req.byte(1)= 0x19;
//  DIAG_Req.byte(2)= 0x02;
//  DIAG_Req.byte(3)= mask;
//  DIAG_Req.byte(4)= 0x00;
//  DIAG_Req.byte(5)= 0x00;
//  DIAG_Req.byte(6)= 0x00;
//  DIAG_Req.byte(7)= 0x00;
//  output(DIAG_Req);
//  testWaitForTimeout(500);
//  
//  if(O_Resp[0] < 0x10)
//  {
//  OBSERVED_DATA("",O_Resp,(O_Resp[0] +1 ));
//  }
//  if(O_Resp[0] == 0x10)
//  {
//  OBSERVED_DATA("",O_Resp ,( O_Resp[1] + ((O_Resp[1] - 6)/7) + ( (O_Resp[1]-6) % 7 ) + 2 ) );
//  }
//
// // ACTION(" No of DTC - ",((O_Resp[1]-3)/4));
//  COMMENT_DATA("DTC - Status");
//  if(O_Resp[0]==0x10)
//  {
//  for(rd = 0 ; rd < O_Resp[1] ; )
//  {
//    if((O_Resp[read_index[rd]]!=0) | (O_Resp[read_index[rd+1]]!=0) |(O_Resp[read_index[rd+2]]!=0))
//    {
//    if((O_Resp[read_index[rd]]== (DTC_no >> 16)) & (O_Resp[read_index[rd+1]] == ((DTC_no & 0x00FF00) >> 8 )) & (O_Resp[read_index[rd+2]]== (DTC_no & 0x0000FF)))
//    {
//    for(dtc_cnt=0 ; dtc_cnt<elcount(dtc_n) ; dtc_cnt++ )
//        {
//        if( ((O_Resp[read_index[rd]]<<16)+(O_Resp[read_index[rd+1]]<<8)+(O_Resp[read_index[rd+2]])) == dtc_n[dtc_cnt].dtc_number)
//        {
//          snprintf(dtc_name_buffer,elcount(dtc_name_buffer)," %s", dtc_n[dtc_cnt].dtc_name);
//          COMMENT_DATA_DTC(dtc_name_buffer,O_Resp[read_index[rd+3]]);
//          if(O_Resp[read_index[rd+3]] == expected)
//          Add_to_report(PASSED);
//          else
//          Add_to_report(FAILED);
//        }
//        }
//    validdtc=1;    
//    }
//    }
//    rd +=4;
//  }
//  }
//  
//  if(O_Resp[0] < 0x10)
//  {
//  for(rd = 0 ; rd < O_Resp[0]-3 ; )
//  {
//    if((O_Resp[read_index_single_frame[rd]]!=0) | (O_Resp[read_index_single_frame[rd+1]]!=0) |(O_Resp[read_index_single_frame[rd+2]]!=0))
//    {
//    if((O_Resp[read_index_single_frame[rd]]== (DTC_no >> 16)) & (O_Resp[read_index_single_frame[rd+1]] == ((DTC_no & 0x00FF00) >> 8 )) & (O_Resp[read_index_single_frame[rd+2]]== (DTC_no & 0x0000FF)))
//    {
//    for(dtc_cnt=0 ; dtc_cnt<elcount(dtc_n) ; dtc_cnt++ )
//        {
//        if( ((O_Resp[read_index_single_frame[rd]]<<16)+(O_Resp[read_index_single_frame[rd+1]]<<8)+(O_Resp[read_index_single_frame[rd+2]])) == dtc_n[dtc_cnt].dtc_number)
//        {
//          snprintf(dtc_name_buffer,elcount(dtc_name_buffer)," %s", dtc_n[dtc_cnt].dtc_name);
//          COMMENT_DATA_DTC(dtc_name_buffer,O_Resp[read_index_single_frame[rd+3]]);
//        }
//        }
//       
//    validdtc=1;    
//    }
//    
//    }
//    rd +=4;
//  }
//  
//  }  
//  
//  
//  if (validdtc == 0)
//  {
//    COMMENT_DATA("No DTC is logged for DTC Number ");
//    if(expected != 00)
//    Add_to_report(FAILED);
//    else
//    Add_to_report(PASSED);
//  }  
//  
//}

//Read_DTC_Name(long DTC_no,int expected)
//{
//
//  int dtc_cnt;
//  char dtc_name_buffer[100];
//  int rd;
//  int validdtc; 
//
//  validdtc = 0;
//  
//  
//   Step();
//  DIAG_Req.dlc = 8;
//  DIAG_Req.byte(0)= 0x03;
//  DIAG_Req.byte(1)= 0x19;
//  DIAG_Req.byte(2)= 0x02;
//  DIAG_Req.byte(3)= expected;
//  DIAG_Req.byte(4)= 0x00;
//  DIAG_Req.byte(5)= 0x00;
//  DIAG_Req.byte(6)= 0x00;
//  DIAG_Req.byte(7)= 0x00;
//  output(DIAG_Req);
//  testWaitForTimeout(100);
//      
// DIAGNOSTIC_REQUEST("",Tx_buffer,8);
//      
//  if(O_Resp[0] < 0x10)
//  {
//  OBSERVED_DATA("",O_Resp,(O_Resp[0] +1 ));
//  }
//  if(O_Resp[0] == 0x10)
//  {
//  OBSERVED_DATA("",O_Resp ,( O_Resp[1] + ((O_Resp[1] - 6)/7) + ( (O_Resp[1]-6) % 7 ) + 2 ) );
//  }
//
// // ACTION(" No of DTC - ",((O_Resp[1]-3)/4));
//  COMMENT_DATA("DTC - Status");
//  if(O_Resp[0]==0x10)
//  {
//  for(rd = 0 ; rd < O_Resp[1] ; )
//  {
//    if((O_Resp[read_index[rd]]!=0) | (O_Resp[read_index[rd+1]]!=0) |(O_Resp[read_index[rd+2]]!=0))
//    {
//    if((O_Resp[read_index[rd]]== (DTC_no >> 16)) & (O_Resp[read_index[rd+1]] == ((DTC_no & 0x00FF00) >> 8 )) & (O_Resp[read_index[rd+2]]== (DTC_no & 0x0000FF)))
//    {
//    for(dtc_cnt=0 ; dtc_cnt<elcount(dtc_n) ; dtc_cnt++ )
//        {
//        if( ((O_Resp[read_index[rd]]<<16)+(O_Resp[read_index[rd+1]]<<8)+(O_Resp[read_index[rd+2]])) == dtc_n[dtc_cnt].dtc_number)
//        {
//          snprintf(dtc_name_buffer,elcount(dtc_name_buffer)," %s", dtc_n[dtc_cnt].dtc_name);
//          COMMENT_DATA_DTC(dtc_name_buffer,O_Resp[read_index[rd+3]]);
//          if(O_Resp[read_index[rd+3]] == expected)
//          Add_to_report(PASSED);
//          else
//          Add_to_report(FAILED);
//        }
//        }
//        if(O_Resp[7] == expected)
//          Add_to_report(PASSED);
//          else
//          Add_to_report(FAILED);
//    validdtc=1;    
//    }
//    }
//    rd +=4;
//  }
//  }
//  
//  if(O_Resp[0] < 0x10)
//  {
//  for(rd = 0 ; rd < O_Resp[0]-3 ; )
//  {
//    if((O_Resp[read_index_single_frame[rd]]!=0) | (O_Resp[read_index_single_frame[rd+1]]!=0) |(O_Resp[read_index_single_frame[rd+2]]!=0))
//    {
//    if((O_Resp[read_index_single_frame[rd]]== (DTC_no >> 16)) & (O_Resp[read_index_single_frame[rd+1]] == ((DTC_no & 0x00FF00) >> 8 )) & (O_Resp[read_index_single_frame[rd+2]]== (DTC_no & 0x0000FF)))
//    {
//    for(dtc_cnt=0 ; dtc_cnt<elcount(dtc_n) ; dtc_cnt++ )
//        {
//        if( ((O_Resp[read_index_single_frame[rd]]<<16)+(O_Resp[read_index_single_frame[rd+1]]<<8)+(O_Resp[read_index_single_frame[rd+2]])) == dtc_n[dtc_cnt].dtc_number)
//        {
//          snprintf(dtc_name_buffer,elcount(dtc_name_buffer)," %s", dtc_n[dtc_cnt].dtc_name);
//          COMMENT_DATA_DTC(dtc_name_buffer,O_Resp[read_index_single_frame[rd+3]]);
//        }
//        }
//       
//    validdtc=1;    
//    }
//    
//    }
//    rd +=4;
//  }
//  
//  }  
//  
//  
//  if (validdtc == 0)
//  {
//    COMMENT_DATA("No DTC is logged for DTC Number ");
//    if(expected != 00)
//    Add_to_report(FAILED);
//    else
//    Add_to_report(PASSED);
//  }  
//   
// if (validdtc != 0)
//  {
//    if(O_Resp[7] == expected)
//    {
//      {
//      if((expected==0x89)) 
//        COMMENT_DATA("DTC is active");
//      else if(expected==0x09)
//         COMMENT_DATA("DTC is active");
//      else if(expected==0x08)
//        COMMENT_DATA("DTC is not active,it is in history");
//       else
//      COMMENT_DATA("No DTC is logged for DTC Number ");
//    }
//     Add_to_report(PASSED);
//    }
//    else
//      Add_to_report(FAILED);
//  
//    
//  }  
//  
//}


//qword Read_did_bits(long did_ref,int byte_no,int start_bit,int end_bit )
//{ 
//int q1,q2,q3,q4,q5,q6,q7;
//long res_read_did_bytes;
//qword res_read_did_bits,res_read_did_bits_temp;  
//byte res_read_did_bits_array[50];
//res_read_did_bits = 0x00;
//res_read_did_bits_temp = 0x00;
//Step();
//
//
//testwaitfortimeout(500);
//Read_did(did_ref);	
//testwaitfortimeout(200);
//
//if(O_Resp[0] == 0x10)
//{
//q5 = ((read_index[byte_no]) * 8) + start_bit ;
//q6 = ((read_index[byte_no]) * 8) + end_bit  ;
//
//      for ( q1=0 ; q1<40 ; q1++ )
//        {
//          q3 = 0x01;
//          for (q2=0 ; q2<8 ; q2++ )
//            {
//              q4 = (q1 * 8) + q2 ; 
//              if(q4>=q5 && q4 <=q6)
//              {
//                res_read_did_bits_array[q4-q5] = ((O_Resp[q1]&q3) ? 1 : 0 ) ;
//              }
//              q3 = q3 << 1 ;
//            }
//        }
//}
//if(O_Resp[0] < 0x10)
//{
//q5 = ((read_index_single_frame[byte_no]) * 8) + start_bit ;
//q6 = ((read_index_single_frame[byte_no]) * 8) + end_bit ;
//
//      for ( q1=0 ; q1<40 ; q1++ )
//        {
//          q3 = 0x01;
//          for (q2=0 ; q2<8 ; q2++ )
//            {
//              q4 = (q1 * 8) + q2 ; 
//              if(q4>=q5 && q4 <=q6)
//              {
//                res_read_did_bits_array[q4-q5] = ((O_Resp[q1]&q3) ? 1 : 0 ) ;
//                
//              }
//              q3 = q3 << 1 ;
//            }
//        }
//}
//
//for(q7=0 ; q7<=(q6-q5) ; q7++)
//{
//  res_read_did_bits_temp = res_read_did_bits_temp + (res_read_did_bits_array[q7] << (q7) );
//  
//}
//
//   return res_read_did_bits_temp;
//}


//Set_batt_voltage(float val)
//{
//  snprintf(buffer,elcount(buffer),"VOLT %f",val);
//  write("%s",buffer);
//  Test_Gpib_Write(buffer);
//  Test_Gpib_Write("OUTP ON");
//  
//}
//XCP_VFP_Connect()
//{
//  Step();
//  Action("XCP CONNECT");
//  send_on_xcp (0xFF,0x00,0x00,0x00,0x00,0x00,0x00,0x00);
//  testWaitForTimeout(1000); 
//  OBSERVED_DATA("",O_Resp,8);
// // DIAGNOSTIC_REQUEST("",Tx_buffer1,8);
//  Expect(0xFF,0x0C,0x80,0x08,0x08,0x00,0x01,0x01);
//  EXPECTED_DATA ("",E_Resp,8);  
//  Check(E_Resp,O_Resp,8);
//  testWaitForTimeout(100); 
//
//  
//}


//XCP_VFP_User_command(byte a,byte b)
//{
// Step();
//  Action("XCP User_command");
//  Step();
//  send_on_xcp (0xF1,0x08,a,b,0x00,0x00,0x00,0x00);
//  testWaitForTimeout(1000); 
//  OBSERVED_DATA("",O_Resp,8);
// // DIAGNOSTIC_REQUEST("",Tx_buffer1,8);
//  Expect(0x00,0x00,0x00,0x00,0x00,0x00,0x00,0x00);
//  EXPECTED_DATA ("",E_Resp,8);  
//  Check(E_Resp1,O_Resp,8);
//  testWaitForTimeout(100); 
//  
//  
//}


IFV300_REQ_SEED()
{
  send_on_CAN (0x02,0x27,0x01,0x00,0x00,0x00,0x00,0x00);
  testWaitForTimeout(50);
  OBSERVED_DATA("",O_Resp,8);
  Expect(0x06,0x67,0x01,O_Resp[3],O_Resp[4],O_Resp[5],O_Resp[6],0x00);
  EXPECTED_DATA("",E_Resp,8);
  check(E_Resp,O_Resp,8);
  GWM_KEY_VAL = IFV300_Calculate_KEY(O_Resp[3],O_Resp[4],O_Resp[5],O_Resp[6]);
  testWaitForTimeout(100);
  
}

long IFV300_Calculate_KEY( byte seed1,byte seed2,byte seed3,byte seed4)
{
  long key_val = 0;
  long seed_val;
  int i;
  seed_val = ((seed1<<24) +(seed2<<16) +(seed3<<8) + seed4) & 0xFFFFFFFF ;
  
                if (seed_val !=0)
                                {
                                                for (i=0;i<35;i++)
                                                {
                                                if (seed_val & 0x80000000)
                                                                {
                                                                seed_val = seed_val << 1;
                                                                seed_val = seed_val ^ 0x46534641;
                                                                }
                                                                else
                                                                {
                                                                seed_val = seed_val << 1;
                                                                }
                                                }
                                                key_val = seed_val;
                                }
  
  return key_val; 
}


IFV300_SEND_KEY()
{  
  
  byte key1,key2,key3,key4;
  key1= ((GWM_KEY_VAL>>24) & 0x000000FF);
  key2= ((GWM_KEY_VAL>>16) & 0x000000FF);
  key3= ((GWM_KEY_VAL>>8) & 0x000000FF);
  key4= (GWM_KEY_VAL&0x000000FF);
  Step();
  //ACTION("Send KEY"); 
  send_on_CAN (0x06,0x27,0x02,key1,key2,key3,key4,0x00); 
  testWaitForTimeout(200);
  Expect(0x02,0x67,0x02,0x00,0x00,0x00,0x00,0x00);
  OBSERVED_DATA("",O_Resp,8);
  EXPECTED_DATA("",E_Resp,8);
  check(E_Resp,O_Resp,8);
}


void DTC_Qualifiction_time_Check(Long DTC_NUM )
{
   float T1=0xff,backup,T2= 0xFF,QulaTime=0; 
  int r;
  T1=(timeNowFloat()/100);
  
   for(r=0;r<400;r++)
  {
    
  DIAG_Req.dlc = 8; 
  DIAG_Req.byte(0)=  0x06; 
  DIAG_Req.byte(1)=  0x19; 
  DIAG_Req.byte(2)=  0x06; 
  DIAG_Req.byte(3)=  (DTC_NUM & 0xFF0000) >> 16; 
  DIAG_Req.byte(4)=  (DTC_NUM & 0x00FF00) >> 8; 
  DIAG_Req.byte(5)=  DTC_NUM & 0x0000FF ; 
  DIAG_Req.byte(6)=  0xFF; 
  output(DIAG_Req); 
  testWaitForTimeout(30);
 // OBSERVED_DATA("",O_Resp,16);    
 //   AddToReport();
    backup=(timeNowFloat()/100);
    if(((backup-T1)>=1500))
    {
      break;
    }
    if(O_Resp[7] == 0x2B) 
    {
      
      break;
    }
  }
  
  if((backup-T1)<1500)
  {
  T2=(timeNowFloat()/100);
  QulaTime = T2-T1;
   OBSERVED("qualification time is  : ",QulaTime);
    AddToReport();
  }
  else{
    OBSERVED("\n Fault Not Qualified with in 1500 msec"); 
    AddToReport(FAILED);
  }
  
}

void DTC_DeQualifiction_time_Check(Long DTC_NUM )
{
   float T1=0xff,backup,T2= 0xFF,QulaTime=0; 

  T1=(timeNowFloat()/100);
  
  while(O_Resp[7] != 0x2A) 
  {
    
  DIAG_Req.dlc = 8; 
  DIAG_Req.byte(0)=  0x06; 
  DIAG_Req.byte(1)=  0x19; 
  DIAG_Req.byte(2)=  0x06; 
  DIAG_Req.byte(3)=  (DTC_NUM & 0xFF0000) >> 16; 
  DIAG_Req.byte(4)=  (DTC_NUM & 0x00FF00) >> 8; 
  DIAG_Req.byte(5)=  DTC_NUM & 0x0000FF ; 
  DIAG_Req.byte(6)=  0xFF; 
  output(DIAG_Req); 
  testWaitForTimeout(30);
  //OBSERVED_DATA("",O_Resp,16);    
 //   AddToReport();
    backup=(timeNowFloat()/100);
    if((backup-T1)>=1500)
    {
      break;
    }
    
  }
  
  if((backup-T1)<=1500)
  {
  T2=(timeNowFloat()/100);
  QulaTime = T2-T1;
   OBSERVED("De qualification time is  : ",QulaTime);
    AddToReport();
  }
  else{
    OBSERVED("\n Fault Not DeQualified with in 1500msec"); 
    AddToReport(FAILED);
  }
  
}

void DTC_Qualifiction_time_Check_TEN(Long DTC_NUM )
{
   float T1=0xff,backup,T2= 0xFF,QulaTime=0; 
  int r;
  T1=(timeNowFloat()/100);
  
   for(r=0;r<400;r++)
  {
    
  DIAG_Req.dlc = 8; 
  DIAG_Req.byte(0)=  0x06; 
  DIAG_Req.byte(1)=  0x19; 
  DIAG_Req.byte(2)=  0x06; 
  DIAG_Req.byte(3)=  (DTC_NUM & 0xFF0000) >> 16; 
  DIAG_Req.byte(4)=  (DTC_NUM & 0x00FF00) >> 8; 
  DIAG_Req.byte(5)=  DTC_NUM & 0x0000FF ; 
  DIAG_Req.byte(6)=  0xFF; 
  output(DIAG_Req); 
  testWaitForTimeout(500);
 // OBSERVED_DATA("",O_Resp,16);    
 //   AddToReport();
    backup=(timeNowFloat()/100);
    if(((backup-T1)>=12000))
    {
      break;
    }
    if(O_Resp[7] == 0x2B) 
    {
      
      break;
    }
  }
  
  if((backup-T1)<12000)
  {
  T2=(timeNowFloat()/100);
  QulaTime = T2-T1;
   OBSERVED("qualification time is  : ",QulaTime);
    AddToReport();
  }
  else{
    OBSERVED("\n Fault Not Qualified"); 
    AddToReport(FAILED);
  }
  
}

void DTC_DeQualifiction_time_Check_TEN(Long DTC_NUM )
{
   float T1=0xff,backup,T2= 0xFF,QulaTime=0; 

  T1=(timeNowFloat()/100);
  
  while(O_Resp[7] != 0x2A) 
  {
    
  DIAG_Req.dlc = 8; 
  DIAG_Req.byte(0)=  0x06; 
  DIAG_Req.byte(1)=  0x19; 
  DIAG_Req.byte(2)=  0x06; 
  DIAG_Req.byte(3)=  (DTC_NUM & 0xFF0000) >> 16; 
  DIAG_Req.byte(4)=  (DTC_NUM & 0x00FF00) >> 8; 
  DIAG_Req.byte(5)=  DTC_NUM & 0x0000FF ; 
  DIAG_Req.byte(6)=  0xFF; 
  output(DIAG_Req); 
  testWaitForTimeout(500);
  //OBSERVED_DATA("",O_Resp,16);    
 //   AddToReport();
    backup=(timeNowFloat()/100);
    if((backup-T1)>=12000)
    {
      break;
    }
    
  }
  
  if((backup-T1)<=12000)
  {
  T2=(timeNowFloat()/100);
  QulaTime = T2-T1;
   OBSERVED("De qualification time is  : ",QulaTime);
    AddToReport();
  }
  else{
    OBSERVED("\n Fault Not DeQualified"); 
    AddToReport(FAILED);
  }
  
}

//void PowerMode_config_check(char Config_Variable[],float Config_Value)
//
//{
//  float Dummy1,Dummy2;
//  TITLE_DATA(Config_Variable);
//  SET_MTA(Config_Variable);
//  testWaitForTimeout(100);
//  PowerMode_configValue = Upload(Config_Variable);
//  testWaitForTimeout(100);
//  PowerMode_configValue_float = IEEE_to_Float(PowerMode_configValue);
// 
//  testWaitForTimeout(100);
//  Dummy1 = 0.9*Config_Value;
//  Dummy2 = 1.1*Config_Value;
//
//  if ( Dummy1 <= PowerMode_configValue_float <= Dummy2 )
//    
//  {
//    OBSERVED("Observed Value is",PowerMode_configValue_float);
//    EXPECTED("EXPECTED Value is",Config_Value);
//    Add_To_Report(PASSED);
//    testWaitForTimeout(100);
//  }
//  else
//  {
//    OBSERVED("Observed Value is",PowerMode_configValue_float);
//    EXPECTED("EXPECTED Value is",Config_Value);
//    Add_To_Report(FAILED);
//    testWaitForTimeout(100);
//    
//  }
//  
//}

//void PowerMode_config_check_DTC(char Config_Variable[],float Config_Value)
//
//{
//  float Dummy1,Dummy2;
//  //TITLE_DATA(Config_Variable);
//  SET_MTA(Config_Variable);
//  testWaitForTimeout(100);
//  PowerMode_configValue = Upload(Config_Variable);
//  testWaitForTimeout(100);
//  PowerMode_configValue_float = IEEE_to_Float(PowerMode_configValue);
// 
//  testWaitForTimeout(100);
//  Dummy1 = 0.9*Config_Value;
//  Dummy2 = 1.1*Config_Value;
//
//  if (PowerMode_configValue == 0 )
//    
//  {
//    OBSERVED("Observed Value is",PowerMode_configValue_float);
//    EXPECTED("EXPECTED Value is",Config_Value);
//    Add_To_Report(PASSED);
//    testWaitForTimeout(100);
//  }
//  else
//  {
//    OBSERVED("Observed Value is",PowerMode_configValue_float);
//    EXPECTED("EXPECTED Value is",Config_Value);
//    Add_To_Report(FAILED);
//    testWaitForTimeout(100);
//    
//  }
//  
//}
//void PowerMode_config_check(char Config_Variable[],int Config_Value)
//
//{
//  float Dummy1,Dummy2;
//  TITLE_DATA(Config_Variable);
//  SET_MTA(Config_Variable);
//  testWaitForTimeout(100);
//  PowerMode_configValue = Upload(Config_Variable);
//  testWaitForTimeout(100);
//  PowerMode_configValue_float = IEEE_to_Float(PowerMode_configValue);
// 
//  testWaitForTimeout(100);
//
//
//  if ( PowerMode_configValue_float == Config_Value )
//    
//  {
//    OBSERVED("Observed Value is",PowerMode_configValue_float);
//    EXPECTED("EXPECTED Value is",Config_Value);
//    Add_To_Report(PASSED);
//    testWaitForTimeout(100);
//  }
//  else
//  {
//    OBSERVED("Observed Value is",PowerMode_configValue_float);
//    EXPECTED("EXPECTED Value is",Config_Value);
//    Add_To_Report(FAILED);
//    testWaitForTimeout(100);
//    
//  }
//  
//}
 Void ICAN_SIGNAL_MIN_MAX_CHECK(char Signal_name[ ], float FACTOR, float OFFSET, float Min, long Max)
{
  float Signal_Value,TrueValue;
 
  Signal_Value = getSignal(Signal_name);
  
  TrueValue = (Signal_Value*FACTOR) + OFFSET;
  
  if(( TrueValue >= Min ) &&( TrueValue <= Max ))
  {
    
    Add_To_Report(PASSED);
  }
  else
  {
    Add_To_Report(FAILED);
  }
  
  
}
void Checkvalue(double v1,double v2)
{
  if(((0.98*v2)<=v1)&&((1.02*v2)>=v1))
  {
    OBSERVED("Observed Value,",(int)v1);
    EXPECTED("Expected Value,",(int)v2);
    Add_To_Report(PASSED);
    }
  else
  {
    OBSERVED("Observed Value,",(int)v1);
    EXPECTED("Expected Value,",(int)v2);
    Add_To_Report(FAILED);
}
  
}
void Checkvalue_float(double v1,double v2)
{
  
  if(((0.98*v2)<=v1)&&((1.02*v2)>=v1))
  {
    
    OBSERVED("Observed Value,",v1);
    EXPECTED("Expected Value,",v2);
    Add_To_Report(PASSED);
    }
  else
  {
    
    OBSERVED("Observed Value,",v1);
    EXPECTED("Expected Value,",v2);
    Add_To_Report(FAILED);
}
  
}


//float IEEE_to_Float(dword Value) 
//{ 
//  int sign,exp;
//  dword mantissa; 
//  float result_IEEE;
//  long IEEE_val_ret;
//  float Float_val;
//  
//  sign = Value >> 31;                            
//  mantissa = (Value & 0x7FFFFF) | 0x800000;      
//  exp = ((Value >> 23) & 0xFF) - 127 - 23;       
//  result_IEEE = mantissa * _pow(2.0, exp); 
//  if(sign == 1) 
//  { 
//    result_IEEE = (result_IEEE*(-1)); 
//  } 
//  
//  write("IEEE = %f",result_IEEE);
//  return result_IEEE;
//
//}




void DTC_Qualifiction_time_Check_TEMP1(Long DTC_NUM )
{
   float T1=0xff,backup,T2= 0xFF,QulaTime=0; 
  int r;
  T1=(timeNowFloat()/100);
  
   for(r=0;r<400;r++)
  {
    
  DIAG_Req.dlc = 8; 
  DIAG_Req.byte(0)=  0x06; 
  DIAG_Req.byte(1)=  0x19; 
  DIAG_Req.byte(2)=  0x06; 
  DIAG_Req.byte(3)=  (DTC_NUM & 0xFF0000) >> 16; 
  DIAG_Req.byte(4)=  (DTC_NUM & 0x00FF00) >> 8; 
  DIAG_Req.byte(5)=  DTC_NUM & 0x0000FF ; 
  DIAG_Req.byte(6)=  0xFF; 
  output(DIAG_Req); 
  testWaitForTimeout(10);
 // OBSERVED_DATA("",O_Resp,16);    
 //   AddToReport();
    backup=(timeNowFloat()/100);
    if(((backup-T1)>=1000))
    {
      break;
    }
    if(O_Resp[7] == 0x2B) 
    {
      
      break;
    }
  }
  
  if((backup-T1)<1000)
  {
  T2=(timeNowFloat()/100);
  QulaTime = T2-T1;
   OBSERVED("Fault Qualified for inValid Value and qualification time is  : ",QulaTime);
    AddToReport();
  }
  else{
    OBSERVED("\n Fault Not Qualified for inValid Value"); 
    AddToReport(FAILED);
  }
  
}

void DTC_Qualifiction_time_Check_TEMP2(Long DTC_NUM )
{
   float T1=0xff,backup,T2= 0xFF,QulaTime=0; 
  int r;
  T1=(timeNowFloat()/100);
  
   for(r=0;r<400;r++)
  {
    
  DIAG_Req.dlc = 8; 
  DIAG_Req.byte(0)=  0x06; 
  DIAG_Req.byte(1)=  0x19; 
  DIAG_Req.byte(2)=  0x06; 
  DIAG_Req.byte(3)=  (DTC_NUM & 0xFF0000) >> 16; 
  DIAG_Req.byte(4)=  (DTC_NUM & 0x00FF00) >> 8; 
  DIAG_Req.byte(5)=  DTC_NUM & 0x0000FF ; 
  DIAG_Req.byte(6)=  0xFF; 
  output(DIAG_Req); 
  testWaitForTimeout(20);
 // OBSERVED_DATA("",O_Resp,16);    
 //   AddToReport();
    backup=(timeNowFloat()/100);
    if(((backup-T1)>=2000))
    {
      break;
    }
    if(O_Resp[7] == 0x2B) 
    {
      
      break;
    }
  }
  
  if((backup-T1)<=2000)
  {
  T2=(timeNowFloat()/100);
  QulaTime = T2-T1;
   OBSERVED("Fault Qualified for Valid value, for which fault should Reset and qualification time is  : ",QulaTime);
    AddToReport(FAILED);
  }
  else{
    OBSERVED("\n Fault Not Qualified for valid Value"); 
    AddToReport(PASSED);
  }
  
}

IFV300_REQ_SEED_PROG()
{
  send_on_CAN_bl (0x02,0x27,0x35,0x00,0x00,0x00,0x00,0x00);
  testWaitForTimeout(50);
  OBSERVED_DATA("",O_Resp,8);
  Expect(0x06,0x67,0x35,O_Resp[3],O_Resp[4],O_Resp[5],O_Resp[6],O_Resp[7]);
  EXPECTED_DATA("",E_Resp,8);
  check(E_Resp,O_Resp,8);
  GWM_KEY_VAL = IFV300_Calculate_KEY_PROG(O_Resp[3],O_Resp[4],O_Resp[5],O_Resp[6]);
  testWaitForTimeout(100);
  
}

long IFV300_Calculate_KEY_PROG( byte seed1,byte seed2,byte seed3,byte seed4)
{
  long key_val = 0;
  long seed_val;
  int i;
  seed_val = ((seed1<<24) +(seed2<<16) +(seed3<<8) + seed4) & 0xFFFFFFFF ;
  
                if (seed_val !=0)
                                {
                                                for (i=0;i<35;i++)
                                                {
                                                if (seed_val & 0x80000000)
                                                                {
                                                                seed_val = seed_val << 1;
                                                                seed_val = seed_val ^ 0x46354641;
                                                                }
                                                                else
                                                                {
                                                                seed_val = seed_val << 1;
                                                                }
                                                }
                                                key_val = seed_val;
                                }
  
  return key_val; 
}


IFV300_SEND_KEY_PROG()
{  
  
  byte key1,key2,key3,key4;
  key1= ((GWM_KEY_VAL>>24) & 0x000000FF);
  key2= ((GWM_KEY_VAL>>16) & 0x000000FF);
  key3= ((GWM_KEY_VAL>>8) & 0x000000FF);
  key4= (GWM_KEY_VAL&0x000000FF);
  Step();
  //ACTION("Send KEY"); 
  send_on_CAN_bl (0x06,0x27,0x36,key1,key2,key3,key4,0x00); 
  testWaitForTimeout(200);
  Expect(0x02,0x67,0x36,O_Resp[3],O_Resp[4],O_Resp[5],O_Resp[6],O_Resp[7]);
  OBSERVED_DATA("",O_Resp,8);
  EXPECTED_DATA("",E_Resp,8);
  check(E_Resp,O_Resp,8);
}

Void checkSignalvalue(float OBS, float EXP)
{
  if((OBS <= EXP+1.0)&& (OBS >= EXP-1.0))
    {
      OBSERVED("Observed Value of ",OBS);
      EXPECTED("Expected Value of ",EXP);
    Add_To_Report(PASSED);
    }
    else
    {
      OBSERVED("Observed Value of ",OBS);
      EXPECTED("Expected Value of ",EXP);
      Add_To_Report(FAILED);
    }
}
Check_DTC_SNAPSHOT(byte E_Resp[],byte O_Resp[],int len)
{ 
  for(i=0;i<len;i++)
  {
    if (i != 22)
    {
    if(E_Resp[i] == O_Resp[i])
    {
      count = count+1;
    }
    }
  }
  
  if(count == len-1)
  {
    Add_to_report(PASSED); 
    count=0;
  }
  else
  {
    Add_to_report(FAILED);  
    count=0;
  }
}
IFV300_SEND_KEY_NRC_24_01()
{  
  byte key1,key2,key3,key4;
  key1= ((GWM_KEY_VAL>>24) & 0x000000FF);
  key2= ((GWM_KEY_VAL>>16) & 0x000000FF);
  key3= ((GWM_KEY_VAL>>8) & 0x000000FF);
  key4= (GWM_KEY_VAL&0x000000FF);
  Step();
  //ACTION("Send KEY"); 
  send_on_CAN (0x02,0x27,0x01,0x00,0x00,0x00,0x00,0x00); 
  testWaitForTimeout(200);
  Expect(0x03,0x7F,0x27,0x24,0xCC,0xCC,0xCC,0xCC);
  OBSERVED_DATA("",O_Resp,8);
  EXPECTED_DATA("",E_Resp,8);
  check(E_Resp,O_Resp,8);
}
//Added by shekar
IFV300_SEND_KEY_NRC_24_06()
{  
  byte key1,key2,key3,key4;
  key1= ((GWM_KEY_VAL>>24) & 0x000000FF);
  key2= ((GWM_KEY_VAL>>16) & 0x000000FF);
  key3= ((GWM_KEY_VAL>>8) & 0x000000FF);
  key4= (GWM_KEY_VAL&0x000000FF);
  Step();
  //ACTION("Send KEY"); 
  send_on_CAN (0x06,0x27,0x01,0x00,0x00,0x00,0x00,0x00); 
  testWaitForTimeout(200);
  Expect(0x03,0x7F,0x27,0x24,0xCC,0xCC,0xCC,0xCC);
  OBSERVED_DATA("",O_Resp,8);
  EXPECTED_DATA("",E_Resp,8);
  check(E_Resp,O_Resp,8);
}
//Added by shekar
IFV300_SEND_KEY_NRC_13_01()
{  
  byte key1,key2,key3,key4;
  key1= ((GWM_KEY_VAL>>24) & 0x000000FF);
  key2= ((GWM_KEY_VAL>>16) & 0x000000FF);
  key3= ((GWM_KEY_VAL>>8) & 0x000000FF);
  key4= (GWM_KEY_VAL&0x000000FF);
  Step();
  //ACTION("Send KEY"); 
  send_on_CAN (0x06,0x27,0x01,0x00,0x00,0x00,0x00,0x00); 
  testWaitForTimeout(200);
  Expect(0x03,0x7F,0x27,0x13,0x00,0x00,0x00,0x00);
  OBSERVED_DATA("",O_Resp,8);
  EXPECTED_DATA("",E_Resp,8);
  check(E_Resp,O_Resp,8);
}
//Added by shekar
IFV300_SEND_KEY_NRC_24_03()
{  
  byte key1,key2,key3,key4;
  key1= ((GWM_KEY_VAL>>24) & 0x000000FF);
  key2= ((GWM_KEY_VAL>>16) & 0x000000FF);
  key3= ((GWM_KEY_VAL>>8) & 0x000000FF);
  key4= (GWM_KEY_VAL&0x000000FF);
  Step();
  //ACTION("Send KEY"); 
  send_on_CAN (0x02,0x27,0x03,0x00,0x00,0x00,0x00,0x00); 
  testWaitForTimeout(200);
  Expect(0x03,0x7F,0x27,0x24,0xCC,0xCC,0xCC,0xCC);
  OBSERVED_DATA("",O_Resp,8);
  EXPECTED_DATA("",E_Resp,8);
  check(E_Resp,O_Resp,8);
}
//Added by shekar
IFV300_SEND_KEY_07_13()
{  
  
  byte key1,key2,key3,key4;
  key1= ((GWM_KEY_VAL>>24) & 0x000000FF);
  key2= ((GWM_KEY_VAL>>16) & 0x000000FF);
  key3= ((GWM_KEY_VAL>>8) & 0x000000FF);
  key4= (GWM_KEY_VAL&0x000000FF);
  Step();
  //ACTION("Send KEY"); 
  send_on_CAN (0x07,0x27,0x02,key1,key2,key3,key4,0x00); 
  testWaitForTimeout(200);
  Expect(0x03,0x7F,0x27,0x13,0xCC,0xCC,0xCC,0xCC);
  OBSERVED_DATA("",O_Resp,8);
  EXPECTED_DATA("",E_Resp,8);
  check(E_Resp,O_Resp,8);
}
//Added by shekar
IFV300_SEND_KEY_07_24()
{  
  
  byte key1,key2,key3,key4;
  key1= ((GWM_KEY_VAL>>24) & 0x000000FF);
  key2= ((GWM_KEY_VAL>>16) & 0x000000FF);
  key3= ((GWM_KEY_VAL>>8) & 0x000000FF);
  key4= (GWM_KEY_VAL&0x000000FF);
  Step();
  //ACTION("Send KEY"); 
  send_on_CAN (0x07,0x27,0x02,key1,key2,key3,key4,0x00); 
  testWaitForTimeout(200);
  Expect(0x03,0x7F,0x27,0x24,0x00,0x00,0x00,0x00);
  OBSERVED_DATA("",O_Resp,8);
  EXPECTED_DATA("",E_Resp,8);
  check(E_Resp,O_Resp,8);
}
//Added by shekar
IFV300_SEND_KEY_05_13()
{  
  
  byte key1,key2,key3,key4;
  key1= ((GWM_KEY_VAL>>24) & 0x000000FF);
  key2= ((GWM_KEY_VAL>>16) & 0x000000FF);
  key3= ((GWM_KEY_VAL>>8) & 0x000000FF);
  key4= (GWM_KEY_VAL&0x000000FF);
  Step();
  //ACTION("Send KEY"); 
  send_on_CAN (0x05,0x27,0x02,key1,key2,key3,key4,0x00); 
  testWaitForTimeout(200);
  Expect(0x03,0x7F,0x27,0x13,0xCC,0xCC,0xCC,0xCC);
  OBSERVED_DATA("",O_Resp,8);
  EXPECTED_DATA("",E_Resp,8);
  check(E_Resp,O_Resp,8);
}
//Added by shekar
IFV300_SEND_KEY_01_13()
{  
  
  byte key1,key2,key3,key4;
  key1= ((GWM_KEY_VAL>>24) & 0x000000FF);
  key2= ((GWM_KEY_VAL>>16) & 0x000000FF);
  key3= ((GWM_KEY_VAL>>8) & 0x000000FF);
  key4= (GWM_KEY_VAL&0x000000FF);
  Step();
  //ACTION("Send KEY"); 
  send_on_CAN (0x01,0x27,0x02,key1,key2,key3,key4,0x00); 
  testWaitForTimeout(200);
  Expect(0x03,0x7F,0x27,0x13,0xCC,0xCC,0xCC,0xCC);
  OBSERVED_DATA("",O_Resp,8);
  EXPECTED_DATA("",E_Resp,8);
  check(E_Resp,O_Resp,8);
}

//long Short_Upload(char var_sea_buf[],int size)
//{
//  long return_var_buf, variable_search;
//  long var_cnt,Valid_i;
//  Valid_i = 0;

//  for(var_cnt=0 ; var_cnt < elcount(variable) ; var_cnt++ )
//  {
//  //Accesing String from Environment Variable
//  if(!strncmp(var_sea_buf,variable[var_cnt].name,strlen(var_sea_buf)))
//  {
//    write("var count - %d",var_cnt);
//        write("var count1 - %d",strlen(var_sea_buf));
//        write("var - %s",var_sea_buf);
//    write("var count1 - %d",strlen(variable[var_cnt].name));

//  if(strlen(var_sea_buf) == strlen(variable[var_cnt].name))
//  {
//    write("var count2 - %d",strlen(var_sea_buf));
//    write("var count2 - %d",strlen(variable[var_cnt].name));

//    Valid_i =1;
//  //testStep("Variable Name"," %s ",variable[var_cnt].name);
//  DIAG_Req_XCP.dlc = 15;
//  xcpreq[0]=DIAG_Req_XCP.byte(0)= 0xF4;
//  xcpreq[1]=DIAG_Req_XCP.byte(1)= size;
//  xcpreq[2]=DIAG_Req_XCP.byte(2)= 0x00;
//  xcpreq[3]=DIAG_Req_XCP.byte(3)= 0x00;
////  xcpreq[4]=DIAG_Req_XCP.byte(4)= ((variable[var_cnt].address & 0xFF000000)>> 24);
////  xcpreq[5]=DIAG_Req_XCP.byte(5)= ((variable[var_cnt].address & 0xFF0000)>> 16);
////  xcpreq[6]=DIAG_Req_XCP.byte(6)= ((variable[var_cnt].address & 0xFF00)>> 8);
////  xcpreq[7]=DIAG_Req_XCP.byte(7)= (variable[var_cnt].address & 0x00FF);
//  xcpreq[4]=DIAG_Req_XCP.byte(4)= (variable[var_cnt].address & 0x00FF);
//  xcpreq[5]=DIAG_Req_XCP.byte(5)= ((variable[var_cnt].address & 0xFF00)>> 8);
//  xcpreq[6]=DIAG_Req_XCP.byte(6)= ((variable[var_cnt].address & 0xFF0000)>> 16);
//  xcpreq[7]=DIAG_Req_XCP.byte(7)= ((variable[var_cnt].address & 0xFF000000)>> 24);
//  output(DIAG_Req_XCP);
//  testWaitForTimeout(1000);
//  DIAGNOSTIC_REQUEST("",xcpreq,8);

//if(O_Resp[0]== 0x02)
//  {
//  testStep("","%s value is %X " ,variable[var_cnt].name,O_Resp[2] );
//    return_var_buf = O_Resp[2];
//  }
//  if(O_Resp[0]== 0x03)
//  {
//  testStep("","%s value is %X " ,variable[var_cnt].name,O_Resp[2] );
//    return_var_buf = O_Resp[2]+( O_Resp[3] << 8 );
    
//  }
//  if(O_Resp[0]== 0x04)
//  {
//  testStep("","%s value is %X " ,variable[var_cnt].name,O_Resp[2] );
//    return_var_buf = O_Resp[2]+( O_Resp[3] << 8 )+( O_Resp[4] << 16 );
//  }
//  if(O_Resp[0]== 0x05)
//  {
////  testStep("","%s value is %X " ,variable[var_cnt].name,O_Resp[2] );
//    return_var_buf = O_Resp[2]+( O_Resp[3] << 8 )+( O_Resp[4] << 16 )+( O_Resp[5] << 24 );
//  }
  
    
//  if(O_Resp[0]== 0x10 && O_Resp[1]== 0x09 )
//  {
//  testStep("","%s value is %X " ,variable[var_cnt].name,O_Resp[2] );
//    return_var_buf = O_Resp[7];
//  }
//  if(O_Resp[0]== 0x10 && O_Resp[1]== 0x0A )
//  {
//  testStep("","%s value is %X " ,variable[var_cnt].name,O_Resp[2] );
//    return_var_buf = O_Resp[7]+( O_Resp[9] << 8 );
    
//  }
//  if(O_Resp[0]== 0x10 && O_Resp[1]== 0x0B )
//  {
//  testStep("","%s value is %X " ,variable[var_cnt].name,O_Resp[2] );
//    return_var_buf = O_Resp[10]+( O_Resp[9] << 8 )+( O_Resp[7] << 16 );
//  }
//  if(O_Resp[0]== 0x10 && O_Resp[1]== 0x0C )
//  {
//  testStep("","%s value is %X " ,variable[var_cnt].name,O_Resp[2] );
//    return_var_buf = O_Resp[11]+( O_Resp[10] << 8 )+( O_Resp[9] << 16 )+( O_Resp[7] << 24 );
//  }
//  if(O_Resp[0] == 0xFF)
//  {
//    return_var_buf = O_Resp[1];
//  }
//  if(O_Resp[0] == 0xFE)
//  {
//    return_var_buf = O_Resp[1];
//  }
  
//  write("%d",return_var_buf);
  
//  }
//  }
//  }

//  if(Valid_i == 0)
//  {
//    write("Variable Not Found in variable data.h");
//    //obj_heading("Variable Not Found in variable data.h");
//  }
//    OBSERVED_DATA("",O_Resp,8);

//  return return_var_buf;
//}

IFV300_REQ_SEED_Clear()
{
  send_on_CAN (0x02,0x27,0x01,0x00,0x00,0x00,0x00,0x00);
  testWaitForTimeout(50);
  OBSERVED_DATA("",O_Resp,8);
  Expect(0x06,0x67,0x01,O_Resp[3],O_Resp[4],O_Resp[5],O_Resp[6],0xCC);
  EXPECTED_DATA("",E_Resp,8);
 // check(E_Resp,O_Resp,8);
  GWM_KEY_VAL = IFV300_Calculate_KEY(O_Resp[3],O_Resp[4],O_Resp[5],O_Resp[6]);
  testWaitForTimeout(100);
  
}

IFV300_SEND_KEY_Clear()
{  
  
  byte key1,key2,key3,key4;
  key1= ((GWM_KEY_VAL>>24) & 0x000000FF);
  key2= ((GWM_KEY_VAL>>16) & 0x000000FF);
  key3= ((GWM_KEY_VAL>>8) & 0x000000FF);
  key4= (GWM_KEY_VAL&0x000000FF);
  Step();
  //ACTION("Send KEY"); 
  send_on_CAN (0x06,0x27,0x02,key1,key2,key3,key4,0x00); 
  testWaitForTimeout(200);
  Expect(0x02,0x67,0x02,0xCC,0xCC,0xCC,0xCC,0xCC);
  OBSERVED_DATA("",O_Resp,8);
  EXPECTED_DATA("",E_Resp,8);
  //check(E_Resp,O_Resp,8);
  
}

send_on_CAN_no_strings(int d0,int d1,int d2,int d3,int d4,int d5,int d6,int d7)
{
  DIAG_Req.DLC = 8; 
  req[0] = DIAG_Req.BYTE(0) = d0;
  req[1] = DIAG_Req.BYTE(1) = d1;
  req[2] = DIAG_Req.BYTE(2) = d2; 
  req[3] = DIAG_Req.BYTE(3) = d3;
  req[4] = DIAG_Req.BYTE(4) = d4;
  req[5] = DIAG_Req.BYTE(5) = d5;
  req[6] = DIAG_Req.BYTE(6) = d6;
  req[7] = DIAG_Req.BYTE(7) = d7;
  //DIAGNOSTIC_REQUEST("",req,8);
  
  Output(DIAG_Req);  
}
IFV300_SEND_KEY_ACC()
{  
  
  byte key1,key2,key3,key4;
  key1= ((GWM_KEY_VAL>>24) & 0x000000FF);
  key2= ((GWM_KEY_VAL>>16) & 0x000000FF);
  key3= ((GWM_KEY_VAL>>8) & 0x000000FF);
  key4= (GWM_KEY_VAL&0x000000FF);
  Step();
  //ACTION("Send KEY"); 
  send_on_CAN_no_strings (0x06,0x27,0x02,key1,key2,key3,key4,0x00); 
  testWaitForTimeout(200);
}



